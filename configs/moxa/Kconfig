## configs/moxa/Kconfig
```kconfig
#
# For a description of the syntax of this configuration file,
# see the file kconfig-language.txt in the NuttX tools repository.
#

if ARCH_BOARD_MOXA

config MOXA_NP51X0
	bool "NP51x0"
	default y
	---help---
		Moxa NP51x0 series.

endif
```

## configs/mx1ads/ostest/defconfig
```kconfig
# CONFIG_SPI_EXCHANGE is not set
CONFIG_ARCH_BOARD_MX1ADS=y
CONFIG_ARCH_BOARD="mx1ads"
CONFIG_ARCH_CHIP_IMX1=y
CONFIG_ARCH_LOWVECTORS=y
CONFIG_ARCH_STACKDUMP=y
CONFIG_ARCH="arm"
CONFIG_BOARD_LOOPSPERMSEC=16945
CONFIG_DISABLE_ENVIRON=y
CONFIG_DISABLE_MOUNTPOINT=y
CONFIG_DISABLE_POLL=y
CONFIG_EXAMPLES_OSTEST_STACKSIZE=2048
CONFIG_EXAMPLES_OSTEST=y
CONFIG_IDLETHREAD_STACKSIZE=4096
CONFIG_IMX1_SPI1=y
CONFIG_IMX1_UART1=y
CONFIG_MAX_TASKS=64
CONFIG_MM_REGIONS=2
CONFIG_NFILE_DESCRIPTORS=32
CONFIG_PTHREAD_STACK_DEFAULT=4096
CONFIG_RAM_SIZE=16777216
CONFIG_RAM_START=0x08000000
CONFIG_RAM_VSTART=0x00000000
CONFIG_RR_INTERVAL=200
CONFIG_SDCLONE_DISABLE=y
CONFIG_START_DAY=29
CONFIG_START_MONTH=8
CONFIG_START_YEAR=2008
CONFIG_TASK_NAME_SIZE=0
CONFIG_UART1_SERIAL_CONSOLE=y
CONFIG_USER_ENTRYPOINT="ostest_main"
CONFIG_USERMAIN_STACKSIZE=4096
```

## configs/ne64badge/ostest/defconfig
```kconfig
# CONFIG_DEV_CONSOLE is not set
# CONFIG_STANDARD_SERIAL is not set
CONFIG_ARCH_BOARD_NE64BADGE=y
CONFIG_ARCH_BOARD="ne64badge"
CONFIG_ARCH_CHIP_MCS92S12NEC64=y
CONFIG_ARCH_HC=y
CONFIG_ARCH_STACKDUMP=y
CONFIG_ARCH="hc"
CONFIG_BOARD_LOOPSPERMSEC=5483
CONFIG_DISABLE_ENVIRON=y
CONFIG_DISABLE_MOUNTPOINT=y
CONFIG_DISABLE_MQUEUE=y
CONFIG_DISABLE_POLL=y
CONFIG_DISABLE_POSIX_TIMERS=y
CONFIG_DISABLE_PTHREAD=y
CONFIG_EXAMPLES_OSTEST_NBARRIER_THREADS=3
CONFIG_EXAMPLES_OSTEST_STACKSIZE=512
CONFIG_EXAMPLES_OSTEST=y
CONFIG_HCS12_NONBANKED=y
CONFIG_HCS12_SCI0=y
CONFIG_IDLETHREAD_STACKSIZE=256
CONFIG_MAX_TASKS=8
CONFIG_MAX_WDOGPARMS=2
CONFIG_MOTOROLA_SREC=y
CONFIG_NFILE_DESCRIPTORS=0
CONFIG_NFILE_STREAMS=0
CONFIG_NOPRINTF_FIELDWIDTH=y
CONFIG_NUNGET_CHARS=0
CONFIG_PREALLOC_TIMERS=0
CONFIG_PREALLOC_WDOGS=4
CONFIG_PTHREAD_STACK_DEFAULT=256
CONFIG_RAM_SIZE=65536
CONFIG_RAM_START=0x20000000
CONFIG_RR_INTERVAL=200
CONFIG_SCI0_BAUD=38400
CONFIG_SCI0_RXBUFSIZE=32
CONFIG_SCI0_SERIAL_CONSOLE=y
CONFIG_SCI0_TXBUFSIZE=32
CONFIG_SDCLONE_DISABLE=y
CONFIG_START_DAY=11
CONFIG_START_MONTH=12
CONFIG_START_YEAR=2009
CONFIG_STDIO_DISABLE_BUFFERING=y
CONFIG_TASK_NAME_SIZE=0
CONFIG_USER_ENTRYPOINT="ostest_main"
CONFIG_USERMAIN_STACKSIZE=512
CONFIG_WDOG_INTRESERVE=0
```

## configs/nr5m100-nexys4/nsh/defconfig
```kconfig
# CONFIG_NSH_DISABLE_IFCONFIG is not set
# CONFIG_NSH_DISABLE_LOSMART is not set
# CONFIG_NSH_DISABLE_PS is not set
# CONFIG_STANDARD_SERIAL is not set
CONFIG_ARCH_BOARD_NR5M100_NEXYS4=y
CONFIG_ARCH_BOARD="nr5m100-nexys4"
CONFIG_ARCH_CHIP_NR5=y
CONFIG_ARCH_CHIP_NR5M100=y
CONFIG_ARCH_RISCV=y
CONFIG_ARCH_STACKDUMP=y
CONFIG_ARCH="risc-v"
CONFIG_BOARD_LOOPSPERMSEC=15000
CONFIG_BUILTIN=y
CONFIG_DEBUG_FULLOPT=y
CONFIG_DEBUG_SYMBOLS=y
CONFIG_DEV_ZERO=y
CONFIG_DISABLE_POLL=y
CONFIG_SYSTEM_NSH_CXXINITIALIZE=y
CONFIG_SYSTEM_NSH=y
CONFIG_FS_WRITABLE=y
CONFIG_HAVE_CXX=y
CONFIG_HAVE_CXXINITIALIZE=y
CONFIG_IDLETHREAD_STACKSIZE=2048
CONFIG_INTELHEX_BINARY=y
CONFIG_LIBC_PERROR_STDOUT=y
CONFIG_LIBC_STRERROR=y
CONFIG_MAX_TASKS=16
CONFIG_MAX_WDOGPARMS=2
CONFIG_NFILE_DESCRIPTORS=8
CONFIG_NFILE_STREAMS=8
CONFIG_NR5_TIMER1=y
CONFIG_NR5_TIMER2=y
CONFIG_NR5_UART1=y
CONFIG_NSH_ARCHINIT=y
CONFIG_NSH_BUILTIN_APPS=y
CONFIG_NSH_DISABLE_MKRD=y
CONFIG_NSH_FILEIOSIZE=512
CONFIG_NSH_LINELEN=64
CONFIG_NSH_READLINE=y
CONFIG_NSH_STRERROR=y
CONFIG_PREALLOC_TIMERS=4
CONFIG_PREALLOC_WDOGS=4
CONFIG_RAM_SIZE=114688
CONFIG_RAM_START=0x20000000
CONFIG_RAW_BINARY=y
CONFIG_RR_INTERVAL=200
CONFIG_RV32IM_HW_MULDIV=y
CONFIG_RV32IM_SYSTEM_CSRRS_SUPPORT=y
CONFIG_START_DAY=27
CONFIG_START_YEAR=2013
CONFIG_SYSLOG_NONE=y
CONFIG_TASK_NAME_SIZE=0
CONFIG_UART1_SERIAL_CONSOLE=y
CONFIG_USER_ENTRYPOINT="nsh_main"
CONFIG_WDOG_INTRESERVE=0
```

## configs/ntosd-dm320/nettest/defconfig
```kconfig
CONFIG_ARCH="arm"
CONFIG_ARCH_BOARD="ntosd-dm320"
CONFIG_ARCH_BOARD_NTOSD_DM320=y
CONFIG_ARCH_CHIP_DM320=y
CONFIG_ARM_TOOLCHAIN_CODESOURCERYL=y
CONFIG_BOARD_LOOPSPERMSEC=16945
CONFIG_BOOT_RUNFROMSDRAM=y
CONFIG_DISABLE_ENVIRON=y
CONFIG_DISABLE_MOUNTPOINT=y
CONFIG_DISABLE_MQUEUE=y
CONFIG_DISABLE_POLL=y
CONFIG_DISABLE_PTHREAD=y
CONFIG_DM9X_BASE=0xd0000300
CONFIG_DM9X_IRQ=27
CONFIG_EXAMPLES_NETTEST=y
CONFIG_IDLETHREAD_STACKSIZE=4096
CONFIG_MAX_TASKS=64
CONFIG_NET=y
CONFIG_NETDEVICES=y
CONFIG_NETUTILS_NETLIB=y
CONFIG_NET_DM90x0=y
CONFIG_NET_ICMP=y
CONFIG_NET_MAX_LISTENPORTS=8
CONFIG_NET_SOCKOPTS=y
CONFIG_NET_TCP=y
CONFIG_NFILE_DESCRIPTORS=8
CONFIG_NFILE_STREAMS=8
CONFIG_PREALLOC_WDOGS=8
CONFIG_PTHREAD_STACK_DEFAULT=4096
CONFIG_RAM_SIZE=33554432
CONFIG_RAM_START=0x01100000
CONFIG_RAM_VSTART=0x00000000
CONFIG_RAW_BINARY=y
CONFIG_RR_INTERVAL=200
CONFIG_SCHED_HPWORK=y
CONFIG_SDCLONE_DISABLE=y
CONFIG_START_DAY=29
CONFIG_START_MONTH=8
CONFIG_START_YEAR=2008
CONFIG_TASK_NAME_SIZE=0
CONFIG_UART0_SERIAL_CONSOLE=y
CONFIG_USERMAIN_STACKSIZE=4096
CONFIG_USER_ENTRYPOINT="nettest_main"
CONFIG_WDOG_INTRESERVE=0
```

## configs/ntosd-dm320/thttpd/defconfig
```kconfig
# CONFIG_ARCH_LEDS is not set
CONFIG_ARCH_BOARD_NTOSD_DM320=y
CONFIG_ARCH_BOARD="ntosd-dm320"
CONFIG_ARCH_CHIP_DM320=y
CONFIG_ARCH="arm"
CONFIG_ARM_TOOLCHAIN_CODESOURCERYL=y
CONFIG_BOARD_LOOPSPERMSEC=16945
CONFIG_BOOT_RUNFROMSDRAM=y
CONFIG_DISABLE_MQUEUE=y
CONFIG_DISABLE_POSIX_TIMERS=y
CONFIG_DISABLE_PTHREAD=y
CONFIG_DM9X_BASE=0xd0000300
CONFIG_DM9X_IRQ=27
CONFIG_EXAMPLES_THTTPD=y
CONFIG_FS_ROMFS=y
CONFIG_IDLETHREAD_STACKSIZE=4096
CONFIG_MAX_TASKS=64
CONFIG_NET_DM90x0=y
CONFIG_NET_ICMP=y
CONFIG_NET_MAX_LISTENPORTS=8
CONFIG_NET_SOCKOPTS=y
CONFIG_NET_TCP_CONNS=16
CONFIG_NET_TCP=y
CONFIG_NET_TCPBACKLOG=y
CONFIG_NET=y
CONFIG_NETDEVICES=y
CONFIG_NETUTILS_NETLIB=y
CONFIG_NETUTILS_THTTPD=y
CONFIG_NFILE_DESCRIPTORS=8
CONFIG_NFILE_STREAMS=8
CONFIG_NSOCKET_DESCRIPTORS=16
CONFIG_NXFLAT=y
CONFIG_PIPES=y
CONFIG_PREALLOC_WDOGS=8
CONFIG_PTHREAD_STACK_DEFAULT=4096
CONFIG_RAM_SIZE=33554432
CONFIG_RAM_START=0x01100000
CONFIG_RAM_VSTART=0x00000000
CONFIG_RAW_BINARY=y
CONFIG_RR_INTERVAL=200
CONFIG_SCHED_HPWORK=y
CONFIG_START_DAY=2
CONFIG_START_MONTH=8
CONFIG_START_YEAR=2009
CONFIG_TASK_NAME_SIZE=0
CONFIG_THTTPD_CGI_BYTECOUNT=20000
CONFIG_THTTPD_CGI_PRIORITY=50
CONFIG_THTTPD_CGI_STACKSIZE=1024
CONFIG_UART0_SERIAL_CONSOLE=y
CONFIG_USER_ENTRYPOINT="thttp_main"
CONFIG_USERMAIN_STACKSIZE=4096
CONFIG_WDOG_INTRESERVE=0
```

## configs/nucleo-144/Kconfig
```kconfig
#
# For a description of the syntax of this configuration file,
# see the file kconfig-language.txt in the NuttX tools repository.
#

if ARCH_BOARD_NUCLEO_144

choice
	prompt "Select Console wiring."
	default NUCLEO_CONSOLE_ARDUINO
	---help---
		Select where you will connect the console.

		Virtual COM Port:

		Advantage: Use the ST-Link as a console. No Extra wiring
		needed.

		Disdvantage: Not the best choice for initial bring up.

		ARDUINO Connector:

		Advantage: You have a shield so it is easy.

		Disdvantage: You loose the use of the
		other functions on PC6, PC7

				STM32F7
			ARDUIONO FUNCTION  GPIO
			-- ----- --------- ----
			DO RX    USART6_RX PG9
			D1 TX    USART6_TX PG14
			-- ----- --------- ---

					OR

		Morpho Connector:

				STM32F7
			MORPHO   FUNCTION  GPIO
			-------- --------- -----
			CN12-64  UART8_RX  PE0
			CN11-61  UART8_TX  PE1
			-------- --------- -----

					OR

		Morpho Connector UART4:

				STM32F7
			MORPHO   FUNCTION  GPIO
			-------- --------- -----
			CN11-30  UART4_RX  PA0
			CN11-28  UART4_TX  PA1
			-------- --------- -----
			Note: SB13 must be removed to disable Ethernet.

config NUCLEO_CONSOLE_ARDUINO
	bool "Arduino Connector"
	select STM32F7_USART6
	select USART6_SERIALDRIVER
	select USART6_SERIAL_CONSOLE

config NUCLEO_CONSOLE_VIRTUAL
	bool "Virtual Comport"
	select STM32F7_USART3
	select USART3_SERIALDRIVER
	select USART3_SERIAL_CONSOLE

config NUCLEO_CONSOLE_MORPHO
	bool "Morpho Connector"
	select STM32F7_UART8
	select UART8_SERIALDRIVER
	select UART8_SERIAL_CONSOLE

config NUCLEO_CONSOLE_MORPHO_UART4
	bool "Morpho Connector UART4"
	select STM32F7_UART4
	select UART4_SERIALDRIVER
	select UART4_SERIAL_CONSOLE

config NUCLEO_CONSOLE_NONE
	bool "No Console"

endchoice # "Select Console wiring"

config NUCLEO_SPI_TEST
	bool "Enable SPI test"
	default n
	---help---
		Enable Spi test - initialize and configure SPI to send
		NUCLEO_SPI_TEST_MESSAGE text. The text is sent on the
		selected SPI Buses with the configured parameters.
		Note the CS lines will not be asserted.

if NUCLEO_SPI_TEST

config NUCLEO_SPI_TEST_MESSAGE
	string "Text to Send on SPI Bus(es)"
	default "Hello World"
	depends on NUCLEO_SPI_TEST
	---help---
		Text to sent on SPI bus(es)

config NUCLEO_SPI1_TEST
	bool "Test SPI bus 1"
	default n
	depends on NUCLEO_SPI_TEST
	---help---
		Enable Spi test - on SPI BUS 1

if NUCLEO_SPI1_TEST

config NUCLEO_SPI1_TEST_FREQ
	int "SPI 1 Clock Freq in Hz"
	default 1000000
	depends on NUCLEO_SPI1_TEST
	---help---
		Sets SPI 1 Clock Freq

config NUCLEO_SPI1_TEST_BITS
	int "SPI 1 number of bits"
	default 8
	depends on NUCLEO_SPI1_TEST
	---help---
		Sets SPI 1 bit length

choice
	prompt "SPI BUS 1 Clock Mode"
	default NUCLEO_SPI1_TEST_MODE3
	---help---
		Sets SPI 1 clock mode

config NUCLEO_SPI1_TEST_MODE0
	bool "CPOL=0 CHPHA=0"

config NUCLEO_SPI1_TEST_MODE1
	bool "CPOL=0 CHPHA=1"

config NUCLEO_SPI1_TEST_MODE2
	bool "CPOL=1 CHPHA=0"

config NUCLEO_SPI1_TEST_MODE3
	bool "CPOL=1 CHPHA=1"

endchoice # "SPI BUS 1 Clock Mode"

endif # NUCLEO_SPI1_TEST

config NUCLEO_SPI2_TEST
	bool "Test SPI bus 2"
	default n
	depends on NUCLEO_SPI_TEST
	---help---
		Enable Spi test - on SPI BUS 2

if NUCLEO_SPI2_TEST

config NUCLEO_SPI2_TEST_FREQ
	int "SPI 2 Clock Freq in Hz"
	default 12000000
	depends on NUCLEO_SPI2_TEST
	---help---
		Sets SPI 2 Clock Freq

config NUCLEO_SPI2_TEST_BITS
	int "SPI 2 number of bits"
	default 8
	depends on NUCLEO_SPI2_TEST
	---help---
		Sets SPI 2 bit length

choice
	prompt "SPI BUS 2 Clock Mode"
	default NUCLEO_SPI2_TEST_MODE3
	---help---
		Sets SPI 2 clock mode

config NUCLEO_SPI2_TEST_MODE0
	bool "CPOL=0 CHPHA=0"

config NUCLEO_SPI2_TEST_MODE1
	bool "CPOL=0 CHPHA=1"

config NUCLEO_SPI2_TEST_MODE2
	bool "CPOL=1 CHPHA=0"

config NUCLEO_SPI2_TEST_MODE3
	bool "CPOL=1 CHPHA=1"

endchoice # "SPI BUS 2 Clock Mode"

endif # NUCLEO_SPI2_TEST

config NUCLEO_SPI3_TEST
	bool "Test SPI bus 3"
	default n
	depends on NUCLEO_SPI_TEST
	---help---
		Enable Spi test - on SPI BUS 3

if NUCLEO_SPI3_TEST

config NUCLEO_SPI3_TEST_FREQ
	int "SPI 3 Clock Freq in Hz"
	default 40000000
	depends on NUCLEO_SPI3_TEST
	---help---
		Sets SPI 3 Clock Freq

config NUCLEO_SPI3_TEST_BITS
	int "SPI 3 number of bits"
	default 8
	depends on NUCLEO_SPI3_TEST
	---help---
		Sets SPI 3 bit length

choice
	prompt "SPI BUS 3 Clock Mode"
	default NUCLEO_SPI3_TEST_MODE3
	---help---
		Sets SPI 3 clock mode

config NUCLEO_SPI3_TEST_MODE0
	bool "CPOL=0 CHPHA=0"

config NUCLEO_SPI3_TEST_MODE1
	bool "CPOL=0 CHPHA=1"

config NUCLEO_SPI3_TEST_MODE2
	bool "CPOL=1 CHPHA=0"

config NUCLEO_SPI3_TEST_MODE3
	bool "CPOL=1 CHPHA=1"

endchoice # "SPI BUS 3 Clock Mode"

endif # NUCLEO_SPI3_TEST
endif # NUCLEO_SPI_TEST
endif # ARCH_BOARD_NUCLEO_144
```

## configs/nucleo-144/f767-evalos/defconfig
```kconfig
# CONFIG_ARCH_FPU is not set
# CONFIG_ARCH_LEDS is not set
# CONFIG_DISABLE_OS_API is not set
# CONFIG_NSH_DISABLE_DATE is not set
# CONFIG_NSH_DISABLE_IFCONFIG is not set
# CONFIG_NSH_DISABLE_PS is not set
CONFIG_ARCH="arm"
CONFIG_ARCH_BOARD="nucleo-144"
CONFIG_ARCH_BOARD_NUCLEO_144=y
CONFIG_ARCH_BUTTONS=y
CONFIG_ARCH_CHIP_STM32F767ZI=y
CONFIG_ARCH_CHIP_STM32F7=y
CONFIG_ARCH_STACKDUMP=y
CONFIG_ARMV7M_DCACHE=y
CONFIG_ARMV7M_DCACHE_WRITETHROUGH=y
CONFIG_ARMV7M_DTCM=y
CONFIG_ARMV7M_ICACHE=y
CONFIG_BOARD_LOOPSPERMSEC=43103
CONFIG_BUILTIN=y
CONFIG_DEBUG_SYMBOLS=y
CONFIG_DISABLE_POLL=y
CONFIG_EXAMPLES_HELLOXX=y
CONFIG_EXAMPLES_LEDS=y
CONFIG_HAVE_CXX=y
CONFIG_HAVE_CXXINITIALIZE=y
CONFIG_MAX_TASKS=16
CONFIG_MAX_WDOGPARMS=2
CONFIG_MM_REGIONS=3
CONFIG_NFILE_DESCRIPTORS=8
CONFIG_NFILE_STREAMS=8
CONFIG_NSH_ARCHINIT=y
CONFIG_NSH_BUILTIN_APPS=y
CONFIG_NSH_FILEIOSIZE=512
CONFIG_NSH_LINELEN=64
CONFIG_NSH_READLINE=y
CONFIG_NUCLEO_CONSOLE_VIRTUAL=y
CONFIG_PREALLOC_MQ_MSGS=4
CONFIG_PREALLOC_TIMERS=4
CONFIG_PREALLOC_WDOGS=4
CONFIG_PRIORITY_INHERITANCE=y
CONFIG_RAM_SIZE=245760
CONFIG_RAM_START=0x20010000
CONFIG_RAW_BINARY=y
CONFIG_READLINE_CMD_HISTORY=y
CONFIG_READLINE_TABCOMPLETION=y
CONFIG_RR_INTERVAL=200
CONFIG_SCHED_HPWORK=y
CONFIG_SCHED_LPWORK=y
CONFIG_SCHED_WAITPID=y
CONFIG_SDCLONE_DISABLE=y
CONFIG_SPI=y
CONFIG_STACK_COLORATION=y
CONFIG_START_DAY=30
CONFIG_START_MONTH=11
CONFIG_START_YEAR=2015
CONFIG_STM32F7_SERIALBRK_BSDCOMPAT=y
CONFIG_STM32F7_SERIAL_DISABLE_REORDERING=y
CONFIG_STM32F7_USART_BREAKS=y
CONFIG_SYSTEM_NSH=y
CONFIG_SYSTEM_NSH_CXXINITIALIZE=y
CONFIG_TASK_NAME_SIZE=0
CONFIG_USART3_SERIAL_CONSOLE=y
CONFIG_USERLED=y
CONFIG_USERLED_LOWER=y
CONFIG_USER_ENTRYPOINT="nsh_main"
CONFIG_WDOG_INTRESERVE=0
```

## configs/nucleo-f303re/hello/defconfig
```kconfig
# CONFIG_ARCH_FPU is not set
CONFIG_ARCH="arm"
CONFIG_ARCH_BOARD="nucleo-f303re"
CONFIG_ARCH_BOARD_NUCLEO_F303RE=y
CONFIG_ARCH_BUTTONS=y
CONFIG_ARCH_CHIP_STM32=y
CONFIG_ARCH_CHIP_STM32F303RE=y
CONFIG_ARCH_STACKDUMP=y
CONFIG_BOARD_LOOPSPERMSEC=6522
CONFIG_DEBUG_SYMBOLS=y
CONFIG_DISABLE_POLL=y
CONFIG_EXAMPLES_HELLO=y
CONFIG_IDLETHREAD_STACKSIZE=2048
CONFIG_INTELHEX_BINARY=y
CONFIG_MAX_TASKS=16
CONFIG_MAX_WDOGPARMS=2
CONFIG_MM_REGIONS=2
CONFIG_NFILE_DESCRIPTORS=8
CONFIG_NFILE_STREAMS=8
CONFIG_PREALLOC_MQ_MSGS=4
CONFIG_PREALLOC_TIMERS=4
CONFIG_PREALLOC_WDOGS=8
CONFIG_RAM_SIZE=65536
CONFIG_RAM_START=0x20000000
CONFIG_RAW_BINARY=y
CONFIG_RR_INTERVAL=200
CONFIG_SCHED_WAITPID=y
CONFIG_SDCLONE_DISABLE=y
CONFIG_START_DAY=27
CONFIG_START_YEAR=2013
CONFIG_STM32_JTAG_SW_ENABLE=y
CONFIG_STM32_USART2=y
CONFIG_SYSLOG_NONE=y
CONFIG_TASK_NAME_SIZE=0
CONFIG_USART2_SERIAL_CONSOLE=y
CONFIG_USER_ENTRYPOINT="hello_main"
CONFIG_WDOG_INTRESERVE=1
```

## configs/nucleo-f334r8/Kconfig
```kconfig
#
# For a description of the syntax of this configuration file,
# see the file kconfig-language.txt in the NuttX tools repository.
#

if ARCH_BOARD_NUCLEO_F334R8

config NUCLEOF334R8_HIGHPRI
       bool "High priority interrupt test"
       default n

endif
```

## configs/nucleo-h743zi/nsh/defconfig
```kconfig
# CONFIG_ARCH_FPU is not set
# CONFIG_NSH_DISABLE_IFCONFIG is not set
# CONFIG_NSH_DISABLE_PS is not set
# CONFIG_STANDARD_SERIAL is not set
CONFIG_ARCH="arm"
CONFIG_ARCH_BOARD="nucleo-h743zi"
CONFIG_ARCH_BOARD_NUCLEO_H743ZI=y
CONFIG_ARCH_CHIP_STM32H743ZI=y
CONFIG_ARCH_CHIP_STM32H7=y
CONFIG_ARCH_STACKDUMP=y
CONFIG_ARMV7M_DCACHE=y
CONFIG_ARMV7M_DCACHE_WRITETHROUGH=y
CONFIG_ARMV7M_DTCM=y
CONFIG_ARMV7M_ICACHE=y
CONFIG_BOARD_LOOPSPERMSEC=43103
CONFIG_BUILTIN=y
CONFIG_DEBUG_SYMBOLS=y
CONFIG_DISABLE_POLL=y
CONFIG_SYSTEM_NSH=y
CONFIG_SYSTEM_NSH_CXXINITIALIZE=y
CONFIG_EXPERIMENTAL=y
CONFIG_HAVE_CXX=y
CONFIG_HAVE_CXXINITIALIZE=y
CONFIG_INTELHEX_BINARY=y
CONFIG_MAX_TASKS=16
CONFIG_MAX_WDOGPARMS=2
CONFIG_MM_REGIONS=3
CONFIG_NFILE_DESCRIPTORS=8
CONFIG_NFILE_STREAMS=8
CONFIG_NSH_BUILTIN_APPS=y
CONFIG_NSH_FILEIOSIZE=512
CONFIG_NSH_LINELEN=64
CONFIG_NSH_READLINE=y
CONFIG_PREALLOC_MQ_MSGS=4
CONFIG_PREALLOC_TIMERS=4
CONFIG_PREALLOC_WDOGS=4
CONFIG_RAM_SIZE=245760
CONFIG_RAM_START=0x20010000
CONFIG_RAW_BINARY=y
CONFIG_RR_INTERVAL=200
CONFIG_SCHED_WAITPID=y
CONFIG_SDCLONE_DISABLE=y
CONFIG_SPI=y
CONFIG_START_DAY=6
CONFIG_START_MONTH=12
CONFIG_START_YEAR=2011
CONFIG_STM32H7_USART3=y
CONFIG_SYSLOG_NONE=y
CONFIG_TASK_NAME_SIZE=0
CONFIG_USART3_SERIAL_CONSOLE=y
CONFIG_USER_ENTRYPOINT="nsh_main"
CONFIG_WDOG_INTRESERVE=0
```
