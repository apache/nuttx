## configs/sim/cxxtest/defconfig
```kconfig
# CONFIG_UCLIBCXX_EXCEPTION is not set
CONFIG_ARCH="sim"
CONFIG_ARCH_BOARD="sim"
CONFIG_ARCH_BOARD_SIM=y
CONFIG_ARCH_FLOAT_H=y
CONFIG_ARCH_SIM=y
CONFIG_BOARD_LOOPSPERMSEC=100
CONFIG_DISABLE_POLL=y
CONFIG_EXAMPLES_CXXTEST=y
CONFIG_HAVE_CXX=y
CONFIG_IDLETHREAD_STACKSIZE=4096
CONFIG_LIBM=y
CONFIG_MAX_TASKS=64
CONFIG_NFILE_DESCRIPTORS=32
CONFIG_PTHREAD_MUTEX_TYPES=y
CONFIG_PTHREAD_STACK_DEFAULT=8192
CONFIG_RAM_START=0x00000000
CONFIG_SCHED_ONEXIT=y
CONFIG_SCHED_ONEXIT_MAX=4
CONFIG_SDCLONE_DISABLE=y
CONFIG_START_DAY=27
CONFIG_START_MONTH=2
CONFIG_START_YEAR=2007
CONFIG_UCLIBCXX=y
CONFIG_USERMAIN_STACKSIZE=4096
CONFIG_USER_ENTRYPOINT="cxxtest_main"
```

## configs/sim/fb/defconfig
```kconfig
CONFIG_ARCH_BOARD_SIM=y
CONFIG_ARCH_BOARD="sim"
CONFIG_ARCH_SIM=y
CONFIG_ARCH="sim"
CONFIG_BOARD_INITIALIZE=y
CONFIG_DEBUG_SYMBOLS=y
CONFIG_DISABLE_ENVIRON=y
CONFIG_DISABLE_MOUNTPOINT=y
CONFIG_DISABLE_POLL=y
CONFIG_DISABLE_POSIX_TIMERS=y
CONFIG_DRIVERS_VIDEO=y
CONFIG_EXAMPLES_FB=y
CONFIG_IDLETHREAD_STACKSIZE=4096
CONFIG_MAX_TASKS=16
CONFIG_PTHREAD_STACK_DEFAULT=8192
CONFIG_SDCLONE_DISABLE=y
CONFIG_SIM_FRAMEBUFFER=y
CONFIG_START_DAY=28
CONFIG_START_MONTH=11
CONFIG_START_YEAR=2008
CONFIG_USER_ENTRYPOINT="fb_main"
CONFIG_USERMAIN_STACKSIZE=4096
CONFIG_VIDEO_FB=y
```

## configs/sim/loadable/defconfig
```kconfig
CONFIG_ARCH="sim"
CONFIG_ARCH_BOARD="sim"
CONFIG_ARCH_BOARD_SIM=y
CONFIG_ARCH_SIM=y
CONFIG_BINFMT_EXEPATH=y
CONFIG_BOARDCTL_APP_SYMTAB=y
CONFIG_BOARDCTL_POWEROFF=y
CONFIG_BOARD_INITIALIZE=y
CONFIG_BUILD_LOADABLE=y
CONFIG_BUILTIN=y
CONFIG_CLOCK_MONOTONIC=y
CONFIG_DEBUG_FEATURES=y
CONFIG_DEBUG_SYMBOLS=y
CONFIG_ELF=y
CONFIG_EXAMPLES_HELLO=m
CONFIG_EXAMPLES_HELLO_STACKSIZE=8192
CONFIG_EXECFUNCS_HAVE_SYMTAB=y
CONFIG_FS_HOSTFS=y
CONFIG_FS_PROCFS=y
CONFIG_IDLETHREAD_STACKSIZE=4096
CONFIG_INIT_FILEPATH=y
CONFIG_INIT_MOUNT=y
CONFIG_INIT_MOUNT_DATA="fs=../apps/exe/system"
CONFIG_INIT_MOUNT_FLAGS=0x1
CONFIG_INIT_MOUNT_FSTYPE="hostfs"
CONFIG_INIT_MOUNT_SOURCE=""
CONFIG_INIT_MOUNT_TARGET="/system"
CONFIG_LIBC_EXECFUNCS=y
CONFIG_MEMSET_OPTSPEED=y
CONFIG_NSH_ARCHINIT=y
CONFIG_NSH_BUILTIN_APPS=y
CONFIG_NSH_LINELEN=128
CONFIG_NSH_READLINE=y
CONFIG_PATH_INITIAL="/system/bin"
CONFIG_RAW_BINARY=y
CONFIG_READLINE_CMD_HISTORY=y
CONFIG_READLINE_TABCOMPLETION=y
CONFIG_SCHED_HAVE_PARENT=y
CONFIG_SCHED_ONEXIT=y
CONFIG_SCHED_WAITPID=y
CONFIG_SDCLONE_DISABLE=y
CONFIG_SIM_M32=y
CONFIG_SIM_WALLTIME=y
CONFIG_START_MONTH=6
CONFIG_START_YEAR=2008
CONFIG_SYSTEM_NSH=m
CONFIG_TIME_EXTENDED=y
CONFIG_USERMAIN_STACKSIZE=4096
CONFIG_USER_INITPATH="/system/bin/nsh"
```

## configs/sim/minibasic/defconfig
```kconfig
# CONFIG_NSH_CMDOPT_HEXDUMP is not set
# CONFIG_NSH_DISABLE_DATE is not set
CONFIG_ARCH="sim"
CONFIG_ARCH_BOARD="sim"
CONFIG_ARCH_BOARD_SIM=y
CONFIG_ARCH_SIM=y
CONFIG_BINFMT_EXEPATH=y
CONFIG_BOARDCTL_POWEROFF=y
CONFIG_BOARD_LOOPSPERMSEC=0
CONFIG_BOOT_RUNFROMEXTSRAM=y
CONFIG_BUILTIN=y
CONFIG_DEBUG_SYMBOLS=y
CONFIG_DEV_LOOP=y
CONFIG_DEV_ZERO=y
CONFIG_DISABLE_POLL=y
CONFIG_EXAMPLES_HELLO=y
CONFIG_EXAMPLES_HELLO_STACKSIZE=8192
CONFIG_FAT_LCNAMES=y
CONFIG_FAT_LFN=y
CONFIG_FSUTILS_PASSWD=y
CONFIG_FSUTILS_PASSWD_READONLY=y
CONFIG_FS_FAT=y
CONFIG_FS_PROCFS=y
CONFIG_FS_ROMFS=y
CONFIG_IDLETHREAD_STACKSIZE=4096
CONFIG_INTERPRETERS_MINIBASIC=y
CONFIG_INTERPRETER_MINIBASIC_TESTSCRIPT=y
CONFIG_LIBC_EXECFUNCS=y
CONFIG_LIBM=y
CONFIG_MAX_TASKS=64
CONFIG_NFILE_DESCRIPTORS=32
CONFIG_NSH_ARCHINIT=y
CONFIG_NSH_ARCHROMFS=y
CONFIG_NSH_BUILTIN_APPS=y
CONFIG_NSH_FATDEVNO=2
CONFIG_NSH_FILE_APPS=y
CONFIG_NSH_READLINE=y
CONFIG_NSH_ROMFSDEVNO=1
CONFIG_NSH_ROMFSETC=y
CONFIG_PATH_INITIAL="/bin"
CONFIG_POSIX_SPAWN_PROXY_STACKSIZE=2048
CONFIG_PTHREAD_STACK_DEFAULT=8192
CONFIG_READLINE_TABCOMPLETION=y
CONFIG_SCHED_HAVE_PARENT=y
CONFIG_SCHED_ONEXIT=y
CONFIG_SCHED_WAITPID=y
CONFIG_SDCLONE_DISABLE=y
CONFIG_SIM_WALLTIME=y
CONFIG_START_MONTH=6
CONFIG_START_YEAR=2008
CONFIG_SYSTEM_NSH=y
CONFIG_TIME_EXTENDED=y
CONFIG_USERMAIN_STACKSIZE=4096
CONFIG_USER_ENTRYPOINT="nsh_main"
```

## configs/sim/nx11/defconfig
```kconfig
# CONFIG_NX_DISABLE_32BPP is not set
# CONFIG_NX_PACKEDMSFIRST is not set
CONFIG_ARCH="sim"
CONFIG_ARCH_BOARD="sim"
CONFIG_ARCH_BOARD_SIM=y
CONFIG_ARCH_SIM=y
CONFIG_DISABLE_ENVIRON=y
CONFIG_DISABLE_MOUNTPOINT=y
CONFIG_DISABLE_POLL=y
CONFIG_DISABLE_POSIX_TIMERS=y
CONFIG_EXAMPLES_NX=y
CONFIG_IDLETHREAD_STACKSIZE=4096
CONFIG_MAX_TASKS=16
CONFIG_MQ_MAXMSGSIZE=64
CONFIG_NX=y
CONFIG_NXFONT_SANS23X27=y
CONFIG_NX_BLOCKING=y
CONFIG_NX_KBD=y
CONFIG_NX_XYINPUT_MOUSE=y
CONFIG_PREALLOC_MQ_MSGS=4
CONFIG_PTHREAD_STACK_DEFAULT=8192
CONFIG_SDCLONE_DISABLE=y
CONFIG_SIM_FBBPP=32
CONFIG_SIM_FRAMEBUFFER=y
CONFIG_SIM_X11FB=y
CONFIG_START_DAY=28
CONFIG_START_MONTH=11
CONFIG_START_YEAR=2008
CONFIG_USERMAIN_STACKSIZE=16384
CONFIG_USER_ENTRYPOINT="nx_main"
```

## configs/sim/nxffs/defconfig
```kconfig
CONFIG_ARCH="sim"
CONFIG_ARCH_BOARD="sim"
CONFIG_ARCH_BOARD_SIM=y
CONFIG_ARCH_SIM=y
CONFIG_DEBUG_SYMBOLS=y
CONFIG_DISABLE_MQUEUE=y
CONFIG_DISABLE_POLL=y
CONFIG_DISABLE_POSIX_TIMERS=y
CONFIG_DISABLE_PTHREAD=y
CONFIG_DISABLE_SIGNALS=y
CONFIG_EXAMPLES_NXFFS=y
CONFIG_FS_FAT=y
CONFIG_FS_NXFFS=y
CONFIG_IDLETHREAD_STACKSIZE=4096
CONFIG_LIB_RAND_ORDER=3
CONFIG_MAX_TASKS=64
CONFIG_MTD=y
CONFIG_NFILE_DESCRIPTORS=32
CONFIG_NXFFS_SCAN_VOLUME=y
CONFIG_PTHREAD_STACK_DEFAULT=8192
CONFIG_RAMMTD=y
CONFIG_RAMMTD_FLASHSIM=y
CONFIG_SDCLONE_DISABLE=y
CONFIG_START_DAY=29
CONFIG_START_MONTH=4
CONFIG_START_YEAR=2011
CONFIG_USERMAIN_STACKSIZE=4096
CONFIG_USER_ENTRYPOINT="nxffs_main"
```

## configs/sim/nxlines/defconfig
```kconfig
# CONFIG_EXAMPLES_NXLINES_DEFAULT_COLORS is not set
# CONFIG_NXTK_DEFAULT_BORDERCOLORS is not set
# CONFIG_NX_DISABLE_32BPP is not set
# CONFIG_NX_PACKEDMSFIRST is not set
CONFIG_ARCH="sim"
CONFIG_ARCH_BOARD="sim"
CONFIG_ARCH_BOARD_SIM=y
CONFIG_ARCH_SIM=y
CONFIG_BOARD_LOOPSPERMSEC=0
CONFIG_DEBUG_SYMBOLS=y
CONFIG_DISABLE_POLL=y
CONFIG_DISABLE_POSIX_TIMERS=y
CONFIG_EXAMPLES_NXLINES=y
CONFIG_EXAMPLES_NXLINES_BGCOLOR=0x00006400
CONFIG_EXAMPLES_NXLINES_BORDERCOLOR=0x00ffff00
CONFIG_EXAMPLES_NXLINES_BPP=32
CONFIG_EXAMPLES_NXLINES_CIRCLECOLOR=0x00f5f5dc
CONFIG_EXAMPLES_NXLINES_LINECOLOR=0x00ffff00
CONFIG_FAT_LCNAMES=y
CONFIG_FAT_LFN=y
CONFIG_FS_FAT=y
CONFIG_FS_PROCFS=y
CONFIG_FS_ROMFS=y
CONFIG_HAVE_CXX=y
CONFIG_HOST_WINDOWS=y
CONFIG_IDLETHREAD_STACKSIZE=8192
CONFIG_MAX_TASKS=16
CONFIG_MQ_MAXMSGSIZE=64
CONFIG_NSH_ARCHINIT=y
CONFIG_NSH_FATDEVNO=2
CONFIG_NSH_LIBRARY=y
CONFIG_NSH_READLINE=y
CONFIG_NSH_ROMFSDEVNO=1
CONFIG_NSH_ROMFSETC=y
CONFIG_NX=y
CONFIG_NXFONT_SANS23X27=y
CONFIG_NXFONT_SANS28X37B=y
CONFIG_NXTK_BORDERCOLOR1=0x005a96bd
CONFIG_NXTK_BORDERCOLOR2=0x00233a49
CONFIG_NXTK_BORDERCOLOR3=0x00f8f8f8
CONFIG_NX_BLOCKING=y
CONFIG_NX_KBD=y
CONFIG_NX_XYINPUT_MOUSE=y
CONFIG_PREALLOC_MQ_MSGS=4
CONFIG_PTHREAD_STACK_DEFAULT=8192
CONFIG_SCHED_ONEXIT=y
CONFIG_SCHED_WAITPID=y
CONFIG_SDCLONE_DISABLE=y
CONFIG_SIM_FBBPP=32
CONFIG_SIM_FRAMEBUFFER=y
CONFIG_SIM_X11FB=y
CONFIG_START_MONTH=5
CONFIG_START_YEAR=2012
CONFIG_USERMAIN_STACKSIZE=16384
CONFIG_USER_ENTRYPOINT="nxlines_main"
```

## configs/sim/ostest/defconfig
```kconfig
CONFIG_ARCH="sim"
CONFIG_ARCH_BOARD="sim"
CONFIG_ARCH_BOARD_SIM=y
CONFIG_ARCH_SIM=y
CONFIG_BOARD_LOOPSPERMSEC=100
CONFIG_DEBUG_SYMBOLS=y
CONFIG_DISABLE_POLL=y
CONFIG_EXAMPLES_OSTEST=y
CONFIG_EXAMPLES_OSTEST_LOOPS=100
CONFIG_FS_NAMED_SEMAPHORES=y
CONFIG_IDLETHREAD_STACKSIZE=4096
CONFIG_MAX_TASKS=64
CONFIG_NFILE_DESCRIPTORS=32
CONFIG_PTHREAD_MUTEX_TYPES=y
CONFIG_PTHREAD_STACK_DEFAULT=8192
CONFIG_RAM_START=0x00000000
CONFIG_SCHED_HAVE_PARENT=y
CONFIG_SCHED_WAITPID=y
CONFIG_SDCLONE_DISABLE=y
CONFIG_START_DAY=27
CONFIG_START_MONTH=2
CONFIG_START_YEAR=2007
CONFIG_USERMAIN_STACKSIZE=4096
CONFIG_USER_ENTRYPOINT="ostest_main"
```

## configs/sim/pashello/defconfig
```kconfig
CONFIG_ARCH="sim"
CONFIG_ARCH_BOARD="sim"
CONFIG_ARCH_BOARD_SIM=y
CONFIG_ARCH_SIM=y
CONFIG_DISABLE_POLL=y
CONFIG_EXAMPLES_PASHELLO=y
CONFIG_FS_FAT=y
CONFIG_IDLETHREAD_STACKSIZE=4096
CONFIG_INTERPRETERS_PCODE=y
CONFIG_MAX_TASKS=64
CONFIG_NFILE_DESCRIPTORS=32
CONFIG_PTHREAD_STACK_DEFAULT=8192
CONFIG_SDCLONE_DISABLE=y
CONFIG_START_DAY=27
CONFIG_START_MONTH=2
CONFIG_START_YEAR=2007
CONFIG_SYSTEM_PRUN=y
CONFIG_USERMAIN_STACKSIZE=4096
CONFIG_USER_ENTRYPOINT="pashello_main"
```

## configs/sim/traveler/defconfig
```kconfig
CONFIG_AJOYSTICK=y
CONFIG_ARCH="sim"
CONFIG_ARCH_BOARD="sim"
CONFIG_ARCH_BOARD_SIM=y
CONFIG_ARCH_SIM=y
CONFIG_BOARD_INITIALIZE=y
CONFIG_DEBUG_FULLOPT=y
CONFIG_DEBUG_SYMBOLS=y
CONFIG_DISABLE_ENVIRON=y
CONFIG_DISABLE_POLL=y
CONFIG_DISABLE_POSIX_TIMERS=y
CONFIG_DRIVERS_VIDEO=y
CONFIG_FS_ROMFS=y
CONFIG_GRAPHICS_TRAVELER=y
CONFIG_GRAPHICS_TRAVELER_RGB32_888=y
CONFIG_IDLETHREAD_STACKSIZE=4096
CONFIG_INPUT=y
CONFIG_LIBC_FLOATINGPOINT=y
CONFIG_LIBM=y
CONFIG_MAX_TASKS=16
CONFIG_PTHREAD_STACK_DEFAULT=8192
CONFIG_SDCLONE_DISABLE=y
CONFIG_SIM_AJOYSTICK=y
CONFIG_SIM_FBBPP=32
CONFIG_SIM_FBHEIGHT=400
CONFIG_SIM_FBWIDTH=640
CONFIG_SIM_FRAMEBUFFER=y
CONFIG_SIM_X11FB=y
CONFIG_START_DAY=28
CONFIG_START_MONTH=11
CONFIG_START_YEAR=2008
CONFIG_USERMAIN_STACKSIZE=16384
CONFIG_USER_ENTRYPOINT="traveler_main"
CONFIG_VIDEO_FB=y
```

## configs/skp16c26/ostest/defconfig
```kconfig
# CONFIG_DISABLE_POSIX_TIMERS is not set
CONFIG_ARCH_BOARD_SKP16C26=y
CONFIG_ARCH_BOARD="skp16c26"
CONFIG_ARCH_CHIP_M30262F8=y
CONFIG_ARCH_INTERRUPTSTACK=128
CONFIG_ARCH_RENESAS=y
CONFIG_ARCH_STACKDUMP=y
CONFIG_ARCH="renesas"
CONFIG_BOARD_LOOPSPERMSEC=16945
CONFIG_DEFAULT_SMALL=y
CONFIG_DEV_LOWCONSOLE=y
CONFIG_DISABLE_MOUNTPOINT=y
CONFIG_DISABLE_MQUEUE=y
CONFIG_DISABLE_POLL=y
CONFIG_ENDIAN_BIG=y
CONFIG_EXAMPLES_OSTEST=y
CONFIG_IDLETHREAD_STACKSIZE=256
CONFIG_LCD_CONSOLE=y
CONFIG_LCD=y
CONFIG_MAX_TASKS=8
CONFIG_MAX_WDOGPARMS=2
CONFIG_MOTOROLA_SREC=y
CONFIG_NFILE_DESCRIPTORS=8
CONFIG_NFILE_STREAMS=8
CONFIG_NOPRINTF_FIELDWIDTH=y
CONFIG_NPTHREAD_KEYS=0
CONFIG_NUNGET_CHARS=0
CONFIG_PREALLOC_TIMERS=0
CONFIG_PREALLOC_WDOGS=8
CONFIG_PTHREAD_STACK_DEFAULT=256
CONFIG_PTHREAD_STACK_MIN=64
CONFIG_RAM_SIZE=2048
CONFIG_RAM_START=0x00400
CONFIG_RR_INTERVAL=200
CONFIG_SDCLONE_DISABLE=y
CONFIG_START_DAY=20
CONFIG_START_MONTH=2
CONFIG_START_YEAR=2009
CONFIG_TASK_NAME_SIZE=0
CONFIG_USER_ENTRYPOINT="ostest_main"
CONFIG_USERMAIN_STACKSIZE=256
CONFIG_WDOG_INTRESERVE=1
```

## configs/spark/Kconfig
```kconfig
#
# For a description of the syntax of this configuration file,
# see the file kconfig-language.txt in the NuttX tools repository.
#

if ARCH_BOARD_SPARK

config SPARK_FLASH
	bool "MTD driver for onboard 2M FLASH"
	default y
	select MTD
	select MTD_SST25
	select FS_FAT
	select STM32_SPI2
	select MTD_BYTE_WRITE
	---help---
		Configures an MTD device for use with the onboard flash

config SPARK_FLASH_SPI
	int "Flash SPI bus number"
	default 2
	depends on SPARK_FLASH
	---help---
		Selects the SPI bus number identying that SPI interface that
		connects the Flash to the MCU.

config SPARK_FLASH_MINOR
	int "Minor number for the FLASH /dev/fat entry"
	default 0
	depends on SPARK_FLASH
	---help---
		Sets the minor number for the FLASH MTD /dev entry

config SPARK_FLASH_PART
	bool "Enable partition support on FLASH"
	default n
	depends on SPARK_FLASH
	---help---
		Enables creation of partitions on the FLASH

config SPARK_FLASH_PART_LIST
	string "Flash partition size list"
	default "512,1536"
	depends on SPARK_FLASH_PART
	---help---
		Comma separated list of partition sizes in KB

endif
```

## configs/spark/composite/defconfig
```kconfig
# CONFIG_DISABLE_OS_API is not set
# CONFIG_NSH_DISABLE_ADDROUTE is not set
# CONFIG_NSH_DISABLE_CMP is not set
# CONFIG_NSH_DISABLE_DD is not set
# CONFIG_NSH_DISABLE_DELROUTE is not set
# CONFIG_NSH_DISABLE_EXEC is not set
# CONFIG_NSH_DISABLE_EXIT is not set
# CONFIG_NSH_DISABLE_GET is not set
# CONFIG_NSH_DISABLE_HEXDUMP is not set
# CONFIG_NSH_DISABLE_IFCONFIG is not set
# CONFIG_NSH_DISABLE_LOSETUP is not set
# CONFIG_NSH_DISABLE_MKFATFS is not set
# CONFIG_NSH_DISABLE_MKRD is not set
# CONFIG_NSH_DISABLE_PS is not set
# CONFIG_NSH_DISABLE_PUT is not set
# CONFIG_NSH_DISABLE_SEMICOLON is not set
# CONFIG_NSH_DISABLE_WGET is not set
# CONFIG_NSH_DISABLE_XD is not set
# CONFIG_NSH_DISABLEBG is not set
CONFIG_ANALOG=y
CONFIG_ARCH_BOARD_SPARK=y
CONFIG_ARCH_BOARD="spark"
CONFIG_ARCH_BUTTONS=y
CONFIG_ARCH_CHIP_STM32=y
CONFIG_ARCH_CHIP_STM32F103CB=y
CONFIG_ARCH_INTERRUPTSTACK=340
CONFIG_ARCH_IRQBUTTONS=y
CONFIG_ARCH_STACKDUMP=y
CONFIG_ARCH="arm"
CONFIG_ARMV7M_TOOLCHAIN_CODESOURCERYL=y
CONFIG_BOARD_INITIALIZE=y
CONFIG_BOARD_LOOPSPERMSEC=5483
CONFIG_BUILTIN_PROXY_STACKSIZE=768
CONFIG_BUILTIN=y
CONFIG_CC3000_SELECT_STACKSIZE=390
CONFIG_CDCACM_COMPOSITE=y
CONFIG_CDCACM_EPBULKIN_HSSIZE=64
CONFIG_CDCACM_EPBULKOUT_HSSIZE=64
CONFIG_CDCACM_NRDREQS=2
CONFIG_CDCACM_NWRREQS=2
CONFIG_CDCACM_RXBUFSIZE=96
CONFIG_CDCACM_TXBUFSIZE=96
CONFIG_CDCACM=y
CONFIG_COMPOSITE_CONFIGSTR="system/composite"
CONFIG_COMPOSITE_IAD=y
CONFIG_COMPOSITE_PRODUCTID=0x2022
CONFIG_COMPOSITE_PRODUCTSTR="Composite Device"
CONFIG_COMPOSITE_SERIALSTR="12345"
CONFIG_COMPOSITE_VENDORID=0x03eb
CONFIG_DEFAULT_SMALL=y
CONFIG_DISABLE_POLL=y
CONFIG_DRIVERS_WIRELESS=y
CONFIG_EXAMPLES_CC3000BASIC=y
CONFIG_EXAMPLES_NSH=y
CONFIG_FAT_LCNAMES=y
CONFIG_FAT_LFN=y
CONFIG_FS_FATTIME=y
CONFIG_FS_NAMED_SEMAPHORES=y
CONFIG_IDLETHREAD_STACKSIZE=280
CONFIG_INTELHEX_BINARY=y
CONFIG_LIB_RAND_ORDER=2
CONFIG_LIB_SENDFILE_BUFSIZE=0
CONFIG_MAX_TASKS=12
CONFIG_MAX_WDOGPARMS=2
CONFIG_MM_SMALL=y
CONFIG_MQ_MAXMSGSIZE=8
CONFIG_MTD_PARTITION=y
CONFIG_NAME_MAX=8
CONFIG_NFILE_DESCRIPTORS=5
CONFIG_NFILE_STREAMS=5
CONFIG_NPTHREAD_KEYS=0
CONFIG_NSH_ARCHINIT=y
CONFIG_NSH_BUILTIN_APPS=y
CONFIG_NSH_CODECS_BUFSIZE=0
CONFIG_NSH_FILEIOSIZE=128
CONFIG_NSH_LINELEN=80
CONFIG_POSIX_SPAWN_PROXY_STACKSIZE=768
CONFIG_PREALLOC_MQ_MSGS=1
CONFIG_PREALLOC_TIMERS=2
CONFIG_PREALLOC_WDOGS=2
CONFIG_PTHREAD_STACK_DEFAULT=340
CONFIG_RAM_SIZE=20480
CONFIG_RAM_START=0x20000000
CONFIG_RAW_BINARY=y
CONFIG_RR_INTERVAL=200
CONFIG_SDCLONE_DISABLE=y
CONFIG_SST25_SECTOR512=y
CONFIG_SST25_SPIFREQUENCY=80000000
CONFIG_START_DAY=30
CONFIG_START_MONTH=11
CONFIG_START_YEAR=2013
CONFIG_STDIO_DISABLE_BUFFERING=y
CONFIG_STM32_CRC=y
CONFIG_STM32_DISABLE_IDLE_SLEEP_DURING_DEBUG=y
CONFIG_STM32_DMA1=y
CONFIG_STM32_JTAG_FULL_ENABLE=y
CONFIG_STM32_SPI_DMA=y
CONFIG_STM32_USART2=y
CONFIG_STM32_USB=y
CONFIG_SYMTAB_ORDEREDBYNAME=y
CONFIG_SYSTEM_COMPOSITE=y
CONFIG_TASK_NAME_SIZE=7
CONFIG_TASK_SPAWN_DEFAULT_STACKSIZE=768
CONFIG_USART2_RXBUFSIZE=32
CONFIG_USART2_SERIAL_CONSOLE=y
CONFIG_USART2_TXBUFSIZE=32
CONFIG_USBDEV_COMPOSITE=y
CONFIG_USBDEV_TRACE_NRECORDS=32
CONFIG_USBDEV_TRACE=y
CONFIG_USBMSC_COMPOSITE=y
CONFIG_USBMSC_NRDREQS=2
CONFIG_USBMSC_NWRREQS=2
CONFIG_USBMSC_SCSI_STACKSIZE=340
CONFIG_USBMSC=y
CONFIG_USER_ENTRYPOINT="nsh_main"
CONFIG_USERMAIN_STACKSIZE=1024
CONFIG_WDOG_INTRESERVE=0
CONFIG_WL_CC3000=y
```
