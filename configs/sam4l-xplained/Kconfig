## configs/sam4l-xplained/Kconfig
```kconfig
#
# For a description of the syntax of this configuration file,
# see misc/tools/kconfig-language.txt.
#

if ARCH_BOARD_SAM4L_XPLAINED

menu "SAM4L Xplained Pro Modules"

config SAM4L_XPLAINED_IOMODULE
	bool "I/O1 Module"
	default n
	---help---
		The I/O 1 module is attached.  This module provides an MMC/SD card
		slot.

if SAM4L_XPLAINED_IOMODULE
choice
	prompt "I/O1 Module Location"
	default SAM4L_XPLAINED_IOMODULE_EXT1

config SAM4L_XPLAINED_IOMODULE_EXT1
	bool "EXT1"

config SAM4L_XPLAINED_IOMODULE_EXT2
	bool "EXT2"

endchoice
endif

config SAM4L_XPLAINED_OLED1MODULE
	bool "OLED1 Module"
	default n
	---help---
		The OLED 1 module is attached.  This module provides an OLED plus 3
		additional switches and 3 additional LEDs.

config SAM4L_XPLAINED_SLCD1MODULE
	bool "SLCD1 Module"
	default n
	---help---
		The SLCD 1 module is attached.  This module provides a segment LCD
		that connects directly to the "EXT5 SEGMENT LCD" connector

endmenu
endif
```

## configs/sam4l-xplained/nsh/defconfig
```kconfig
# CONFIG_NSH_DISABLE_IFCONFIG is not set
# CONFIG_NSH_DISABLE_PS is not set
CONFIG_ARCH="arm"
CONFIG_ARCH_BOARD="sam4l-xplained"
CONFIG_ARCH_BOARD_SAM4L_XPLAINED=y
CONFIG_ARCH_BUTTONS=y
CONFIG_ARCH_CHIP_ATSAM4LC4C=y
CONFIG_ARCH_CHIP_SAM34=y
CONFIG_ARCH_CHIP_SAM4L=y
CONFIG_ARCH_STACKDUMP=y
CONFIG_ARMV7M_OABI_TOOLCHAIN=y
CONFIG_ARMV7M_TOOLCHAIN_BUILDROOT=y
CONFIG_BOARD_LOOPSPERMSEC=3410
CONFIG_BUILTIN=y
CONFIG_CXX_NEWLONG=y
CONFIG_DISABLE_ENVIRON=y
CONFIG_DISABLE_POLL=y
CONFIG_HAVE_CXX=y
CONFIG_HAVE_CXXINITIALIZE=y
CONFIG_MAX_TASKS=16
CONFIG_MAX_WDOGPARMS=2
CONFIG_MM_REGIONS=3
CONFIG_NFILE_DESCRIPTORS=8
CONFIG_NFILE_STREAMS=8
CONFIG_NSH_BUILTIN_APPS=y
CONFIG_NSH_FILEIOSIZE=512
CONFIG_NSH_LINELEN=64
CONFIG_NSH_READLINE=y
CONFIG_PREALLOC_MQ_MSGS=4
CONFIG_PREALLOC_TIMERS=4
CONFIG_PREALLOC_WDOGS=4
CONFIG_PTHREAD_STACK_DEFAULT=1536
CONFIG_RAM_SIZE=32768
CONFIG_RAM_START=0x20000000
CONFIG_RAW_BINARY=y
CONFIG_RR_INTERVAL=200
CONFIG_SAM34_USART0=y
CONFIG_SCHED_WAITPID=y
CONFIG_SDCLONE_DISABLE=y
CONFIG_START_DAY=9
CONFIG_START_MONTH=6
CONFIG_START_YEAR=2013
CONFIG_SYSTEM_NSH=y
CONFIG_SYSTEM_NSH_CXXINITIALIZE=y
CONFIG_TASK_NAME_SIZE=0
CONFIG_TASK_SPAWN_DEFAULT_STACKSIZE=1536
CONFIG_USART0_SERIAL_CONSOLE=y
CONFIG_USERMAIN_STACKSIZE=1536
CONFIG_USER_ENTRYPOINT="nsh_main"
CONFIG_WDOG_INTRESERVE=0
```

## configs/sam4s-xplained-pro/Kconfig
```kconfig
#
# For a description of the syntax of this configuration file,
# see misc/tools/kconfig-language.txt.
#

if ARCH_BOARD_SAM4S_XPLAINED_PRO

config SAM4S_XPLAINED_PRO_CDCACM_DEVMINOR
	int "CDC/ACM Device Minor"
	default 0
	depends on SAM34_UDP && USBDEV && CDCACM

config SAM4S_XPLAINED_PRO_SCHED_TIMER_DEVPATH
    string "Scheduler Timer Device Path"
	default "/dev/rtt0"
	depends on TIMER && SYSTEMTICK_EXTCLK

config SAM4S_XPLAINED_PRO_CPULOAD_TIMER_DEVPATH
    string "CPU Load Timer Device Path"
	default "/dev/tc0"
	depends on TIMER && SCHED_CPULOAD && SCHED_CPULOAD_EXTCLK

endif
```

## configs/sam4s-xplained/nsh/defconfig
```kconfig
# CONFIG_NSH_DISABLE_IFCONFIG is not set
# CONFIG_NSH_DISABLE_PS is not set
# CONFIG_SAM34_UART0 is not set
CONFIG_ARCH="arm"
CONFIG_ARCH_BOARD="sam4s-xplained"
CONFIG_ARCH_BOARD_SAM4S_XPLAINED=y
CONFIG_ARCH_BUTTONS=y
CONFIG_ARCH_CHIP_ATSAM4S16C=y
CONFIG_ARCH_CHIP_SAM34=y
CONFIG_ARCH_CHIP_SAM4S=y
CONFIG_ARCH_STACKDUMP=y
CONFIG_ARMV7M_OABI_TOOLCHAIN=y
CONFIG_ARMV7M_TOOLCHAIN_BUILDROOT=y
CONFIG_BOARD_LOOPSPERMSEC=9186
CONFIG_BUILTIN=y
CONFIG_CXX_NEWLONG=y
CONFIG_DISABLE_ENVIRON=y
CONFIG_DISABLE_MOUNTPOINT=y
CONFIG_DISABLE_POLL=y
CONFIG_HAVE_CXX=y
CONFIG_HAVE_CXXINITIALIZE=y
CONFIG_MAX_TASKS=16
CONFIG_MAX_WDOGPARMS=2
CONFIG_NFILE_DESCRIPTORS=8
CONFIG_NFILE_STREAMS=8
CONFIG_NSH_BUILTIN_APPS=y
CONFIG_NSH_FILEIOSIZE=512
CONFIG_NSH_READLINE=y
CONFIG_PREALLOC_MQ_MSGS=4
CONFIG_PREALLOC_TIMERS=4
CONFIG_PREALLOC_WDOGS=4
CONFIG_RAM_SIZE=131072
CONFIG_RAM_START=0x20000000
CONFIG_RAW_BINARY=y
CONFIG_RR_INTERVAL=200
CONFIG_SAM34_UART1=y
CONFIG_SCHED_WAITPID=y
CONFIG_SDCLONE_DISABLE=y
CONFIG_START_DAY=12
CONFIG_START_MONTH=6
CONFIG_START_YEAR=2013
CONFIG_SYSTEM_NSH=y
CONFIG_SYSTEM_NSH_CXXINITIALIZE=y
CONFIG_TASK_NAME_SIZE=0
CONFIG_UART1_SERIAL_CONSOLE=y
CONFIG_USER_ENTRYPOINT="nsh_main"
CONFIG_WDOG_INTRESERVE=0
```

## configs/sama5d2-xult/Kconfig
```kconfig
#
# For a description of the syntax of this configuration file,
# see the file kconfig-language.txt in the NuttX tools repository.
#

if ARCH_BOARD_SAMA5D2_XULT

choice
	prompt "CPU Frequency"
	default SAMA5D2XULT_396MHZ

config SAMA5D2XULT_384MHZ
	bool "384 MHz"

config SAMA5D2XULT_396MHZ
	bool "396 MHz"

config SAMA5D2XULT_528MHZ
	bool "528 MHz"

endchoice # CPU Frequency

endif # ARCH_BOARD_SAMA5D2_XULT
```

## configs/sama5d3-xplained/Kconfig
```kconfig
#
# For a description of the syntax of this configuration file,
# see misc/tools/kconfig-language.txt.
#

if ARCH_BOARD_SAMA5D3_XPLAINED

choice
	prompt "CPU Frequency"
	default SAMA5D3XPLAINED_396MHZ

config SAMA5D3XPLAINED_384MHZ
	bool "384 MHz"

config SAMA5D3XPLAINED_396MHZ
	bool "396 MHz"

config SAMA5D3XPLAINED_528MHZ
	bool "528 MHz"

endchoice # CPU Frequency

choice
	prompt "SAMA5D3-Xplained DRAM Type"
	default SAMA5D3XPLAINED_MT47H128M16RT
	depends on SAMA5_DDRCS

config SAMA5D3XPLAINED_MT47H128M16RT
	bool "MT47H128M16RT"
	---help---
		Micron 2Gbit x16 DDR2-1066 128Mb

config SAMA5D3XPLAINED_MT47H64M16HR
	bool "MT47H64M16HR"
	---help---
		Micron 1Gbit x16 DDR2-800 64Mb

endchoice # SAMA5D3-Xplained DRAM Type

config SAMA5D3XPLAINED_NAND_AUTOMOUNT
	bool "NAND FLASH auto-mount"
	default n
	depends on NSH_ARCHINIT && SAMA5_EBICS3_NAND
	---help---
		Automatically initialize the NAND FLASH driver when NSH starts.

choice
	prompt "NAND FLASH configuration"
	default SAMA5D3XPLAINED_NAND_NXFFS
	depends on SAMA5D3XPLAINED_NAND_AUTOMOUNT

config SAMA5D3XPLAINED_NAND_FTL
	bool "Create NAND FLASH block driver"
	depends on MTD && MTD_NAND
	---help---
		Create the MTD driver for the NAND and "wrap" the NAND as a standard
		block driver that could then, for example, be mounted using FAT or
		any other file system.  Any file system may be used, but there will
		be no wear-leveling.

		NOTE: This options is not currently recommended.  There is not now
		NuttX file system that can handle the NAND back blocks or performs
		wear-leveling other than NXFFS and NXFFS does not use a block driver
		but, rather, operates directly upon the NAND MTD device.

config SAMA5D3XPLAINED_NAND_NXFFS
	bool "Create NAND FLASH NXFFS file system"
	depends on MTD && MTD_NAND && FS_NXFFS && NXFFS_NAND
	---help---
		Create the MTD driver for the NAND and mount the NAND device as
		a wear-leveling, NuttX FLASH file system (NXFFS).  The downside of
		NXFFS is that it can be very slow.

		NOTE: NXFFS is recommended because (1) it can handle the NAND back
		blocks and (1) performs wear-leveling.

endchoice # NAND FLASH configuration

config SAMA5D3XPLAINED_AT25_AUTOMOUNT
	bool "AT25 serial FLASH auto-mount"
	default n
	depends on NSH_ARCHINIT && SAMA5_SPI0 && MTD_AT25
	---help---
		Automatically initialize the AT25 SPI FLASH driver when NSH starts.

choice
	prompt "AT25 serial FLASH configuration"
	default SAMA5D3XPLAINED_AT25_FTL
	depends on SAMA5D3XPLAINED_AT25_AUTOMOUNT

config SAMA5D3XPLAINED_AT25_FTL
	bool "Create AT25 Serial FLASH block driver"
	---help---
		Create the MTD driver for the AT25 and "wrap" the AT25 as a standard
		block driver that could then, for example, be mounted using FAT or
		any other file system.  Any file system may be used, but there will
		be no wear-leveling.

config SAMA5D3XPLAINED_AT25_NXFFS
	bool "Create AT25 serial FLASH NXFFS file system"
	depends on FS_NXFFS
	---help---
		Create the MTD driver for the AT25 and mount the AT25 device as
		a wear-leveling, NuttX FLASH file system (NXFFS).  The downside of
		NXFFS is that it can be very slow.

endchoice # AT25 serial FLASH configuration

config SAMA5D3XPLAINED_CHANNEL
	int "PWM channel number"
	default 0 if SAMA5_PWM_CHAN0
	default 1 if SAMA5_PWM_CHAN1
	default 2 if SAMA5_PWM_CHAN2
	default 3 if SAMA5_PWM_CHAN3
	range 0 3
	depends on PWM && SAMA5_PWM
	---help---
		Selects the PWM channel number that will be used to perform the PWM
		test.  See apps/examples/pwm.

if AUDIO_I2SCHAR && (SAMA5_SSC0 || SAMA5_SSC1)

if SAMA5_SSC0 && SAMA5_SSC1

config SAMA5D3XPLAINED_SSC_PORT
	int "SSC port number"
	default 0
	range 0 1
	---help---
		Specify the I2S port to use, i.e., 0 for SSC0 or 1 for SSC1

endif # SAMA5_SSC0 && SAMA5_SSC1

if SAMA5_SSC0 && !SAMA5_SSC1

config SAMA5D3XPLAINED_SSC_PORT
	int
	default 0

endif # SAMA5_SSC0 && !SAMA5_SSC1

if !SAMA5_SSC0 && SAMA5_SSC1

config SAMA5D3XPLAINED_SSC_PORT
	int
	default 1

endif # SAMA5_SSC0 && !SAMA5_SSC1

config SAMA5D3XPLAINED_I2SCHAR_MINOR
	int "I2S character driver minor number"
	default 0
	---help---
		The minor device number to use when registering the I2S character
		device.  The driver will be registered at /dev/is2charN where N is
		the value provided by this setting.

endif # AUDIO_I2SCHAR && (SAMA5_SSC0 || SAMA5_SSC1)

endif # ARCH_BOARD_SAMA5D3_XPLAINED
```
