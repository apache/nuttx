## configs/samd20-xplained/Kconfig
```kconfig
#
# For a description of the syntax of this configuration file,
# see misc/tools/kconfig-language.txt.
#

if ARCH_BOARD_SAMD20_XPLAINED

menu "SAMD20 Xplained Pro Modules"

config SAMD20_XPLAINED_IOMODULE
	bool "I/O1 Module"
	default n
	---help---
		The I/O 1 module is attached.  This module provides an MMC/SD card
		slot.

if SAMD20_XPLAINED_IOMODULE

choice
	prompt "I/O1 Module Location"
	default SAMD20_XPLAINED_IOMODULE_EXT1

config SAMD20_XPLAINED_IOMODULE_EXT1
	bool "EXT1"

config SAMD20_XPLAINED_IOMODULE_EXT2
	bool "EXT2"

endchoice
endif

config SAMD20_XPLAINED_OLED1MODULE
	bool "OLED1 Module"
	default n
	---help---
		The OLED 1 module is attached.  This module provides an OLED plus 3
		additional switches and 3 additional LEDs.

if SAMD20_XPLAINED_OLED1MODULE

choice
	prompt "OLED1 Module Location"
	default SAMD20_XPLAINED_OLED1MODULE_EXT1

config SAMD20_XPLAINED_OLED1MODULE_EXT1
	bool "EXT1"

config SAMD20_XPLAINED_OLED1MODULE_EXT2
	bool "EXT2"

endchoice
endif

endmenu
endif
```

## configs/same70-xplained/Kconfig
```kconfig
#
# For a description of the syntax of this configuration file,
# see the file kconfig-language.txt in the NuttX tools repository.
#

if ARCH_BOARD_SAME70_XPLAINED

config SAME70XPLAINED_HSMCI0_AUTOMOUNT
	bool "HSMCI0 automounter"
	default n
	depends on FS_AUTOMOUNTER && SAMA5_HSMCI0

if SAME70XPLAINED_HSMCI0_AUTOMOUNT

config SAME70XPLAINED_HSMCI0_AUTOMOUNT_FSTYPE
	string "HSMCI0 file system type"
	default "vfat"

config SAME70XPLAINED_HSMCI0_AUTOMOUNT_BLKDEV
	string "HSMCI0 block device"
	default "/dev/mmcsd0"

config SAME70XPLAINED_HSMCI0_AUTOMOUNT_MOUNTPOINT
	string "HSMCI0 mount point"
	default "/mnt/sdcard0"

config SAME70XPLAINED_HSMCI0_AUTOMOUNT_DDELAY
	int "HSMCI0 debounce delay (milliseconds)"
	default 1000

config SAME70XPLAINED_HSMCI0_AUTOMOUNT_UDELAY
	int "HSMCI0 unmount retry delay (milliseconds)"
	default 2000

endif # SAME70XPLAINED_HSMCI0_AUTOMOUNT

endif # ARCH_BOARD_SAME70_XPLAINED
```

## configs/saml21-xplained/Kconfig
```kconfig
#
# For a description of the syntax of this configuration file,
# see the file kconfig-language.txt in the NuttX tools repository.
#

if ARCH_BOARD_SAML21_XPLAINED

menu "CPU Clock Configuration"

choice
	prompt "OSC16M Frequency"
	default SAML21_XPLAINED_OSC16M_4MHZ

config SAML21_XPLAINED_OSC16M_4MHZ
	bool "4 MHz"

config SAML21_XPLAINED_OSC16M_8MHZ
	bool "8 MHz"

config SAML21_XPLAINED_OSC16M_12MHZ
	bool "12 MHz"

config SAML21_XPLAINED_OSC16M_16MHZ
	bool "16 MHz"

endchoice # OSC16M Frequency

config SAML21_XPLAINED_XOSC32K
	bool "Enable XOSC32K"
	default n

config SAML21_XPLAINED_DFLL
	bool "Use DFLL"
	default n

choice
	prompt "DFLL Clock Source"
	default SAML21_XPLAINED_DFLL_OSC16MSRC
	depends on SAML21_XPLAINED_DFLL

config SAML21_XPLAINED_DFLL_OSC16MSRC
	bool "OSC16M"

config SAML21_XPLAINED_DFLL_XOSC32KSRC
	bool "XOSCK32K"
	select SAML21_XPLAINED_XOSC32K

endchoice # DFLL Clock Source

choice
	prompt "DFLL Operating Mode"
	default SAML21_XPLAINED_DFLL_OPENLOOP
	depends on SAML21_XPLAINED_DFLL

config SAML21_XPLAINED_DFLL_OPENLOOP
	bool "DFLL Open Loop Mode"

config SAML21_XPLAINED_DFLL_CLOSEDLOOP
	bool "DFLL Closed Loop Mode"

config SAML21_XPLAINED_DFLL_RECOVERY
	bool "DFLL USB Recovery Mode"
	depends on EXPERIMENTAL

endchoice # DLL Operating Mode
endmenu # CPU Clock Configuration

menu "SAML21 Xplained Pro Modules"

config SAML21_XPLAINED_IOMODULE
	bool "I/O1 Module"
	default n
	---help---
		The I/O 1 module is attached.  This module provides an MMC/SD card
		slot.

if SAML21_XPLAINED_IOMODULE

choice
	prompt "I/O1 Module Location"
	default SAML21_XPLAINED_IOMODULE_EXT1

config SAML21_XPLAINED_IOMODULE_EXT1
	bool "EXT1"

config SAML21_XPLAINED_IOMODULE_EXT2
	bool "EXT2"

endchoice
endif

config SAML21_XPLAINED_OLED1MODULE
	bool "OLED1 Module"
	default n
	---help---
		The OLED 1 module is attached.  This module provides an OLED plus 3
		additional switches and 3 additional LEDs.

if SAML21_XPLAINED_OLED1MODULE

choice
	prompt "OLED1 Module Location"
	default SAML21_XPLAINED_OLED1MODULE_EXT1

config SAML21_XPLAINED_OLED1MODULE_EXT1
	bool "EXT1"

config SAML21_XPLAINED_OLED1MODULE_EXT2
	bool "EXT2"

endchoice
endif
endmenu

endif # ARCH_BOARD_SAML21_XPLAINED
```

## configs/samv71-xult/Kconfig
```kconfig
#
# For a description of the syntax of this configuration file,
# see misc/tools/kconfig-language.txt.
#

if ARCH_BOARD_SAMV71_XULT

config SAMV71XULT_MXTXPLND
	bool "MaXTouch Xplained connected"
	default n

if SAMV71XULT_MXTXPLND

choice
	prompt "MaXTouch Xplained connection"
	default SAMV71XULT_MXTXPLND_EXT1

config SAMV71XULT_MXTXPLND_EXT1
	bool "Connected on EXT1 (2x10 pin)"
	depends on EXPERIMENTAL

config SAMV71XULT_MXTXPLND_EXT2
	bool "Connected on EXT2 (2x10 pin)"
	depends on EXPERIMENTAL

config SAMV71XULT_MXTXPLND_LCD
	bool "Connected on LCD (50-pin)"

endchoice # MaXTouch Xplained connection

if INPUT_MXT

config SAMV71XULT_MXT_SWAPXY
	bool "Swap X/Y coordinates"
	default n
	---help---
		If you are working in a landscape orientation, it should be
		necessary to swap X/Y coordinates.  But you will probably want
		to do this in any portrait orientation.

config SAMV71XULT_MXT_I2CFREQUENCY
	int "maXTouch I2C frequency"
	default 400000

config SAMV71XULT_MXT_DEVMINOR
	int "/dev/input minor number"
	default 0

endif # INPUT_MXT

if LCD

config SAMV71XULT_LCD_BGCOLOR
	hex "Initial background color"
	default 0x00

endif # LCD

endif # SAMV71XULT_MXTXPLND

config SAMV71XULT_HSMCI0_AUTOMOUNT
	bool "HSMCI0 automounter"
	default n
	depends on FS_AUTOMOUNTER && SAMA5_HSMCI0

if SAMV71XULT_HSMCI0_AUTOMOUNT

config SAMV71XULT_HSMCI0_AUTOMOUNT_FSTYPE
	string "HSMCI0 file system type"
	default "vfat"

config SAMV71XULT_HSMCI0_AUTOMOUNT_BLKDEV
	string "HSMCI0 block device"
	default "/dev/mmcsd0"

config SAMV71XULT_HSMCI0_AUTOMOUNT_MOUNTPOINT
	string "HSMCI0 mount point"
	default "/mnt/sdcard0"

config SAMV71XULT_HSMCI0_AUTOMOUNT_DDELAY
	int "HSMCI0 debounce delay (milliseconds)"
	default 1000

config SAMV71XULT_HSMCI0_AUTOMOUNT_UDELAY
	int "HSMCI0 unmount retry delay (milliseconds)"
	default 2000

endif # SAMV71XULT_HSMCI0_AUTOMOUNT

if AUDIO_WM8904

config SAMV71XULT_WM8904_I2CFREQUENCY
	int "WM8904 I2C Frequency"
	default 400000
	range 1 400000
	---help---
		This option selects the I2C frequency to use when communicating with
		the WM8904 device.  The default, 400KHz, is the maximum supported by
		the WM8904.  If you have problems communicating with the WM8904,
		then you might want to try lowering this rate.

choice
	prompt "WM8904 MCLK source"
	default SAMV71XULT_WM8904_SRCMAIN

config SAMV71XULT_WM8904_SRCMAIN
	bool "Main Clock (12MHz)"

config SAMV71XULT_WM8904_SRCSCK
	bool "Slow XTAL (32.768KHz)"
	select SAMV71XULT_SLOWCLOCK

endchoice # WM8904 MCLK source
endif # AUDIO_WM8904

endif # ARCH_BOARD_SAMV71_XULT
```

## configs/shenzhou/nxwm/defconfig
```kconfig
# CONFIG_NSH_CMDOPT_HEXDUMP is not set
# CONFIG_NSH_DISABLE_IFCONFIG is not set
# CONFIG_NSH_DISABLE_PS is not set
# CONFIG_NXFONTS_DISABLE_16BPP is not set
# CONFIG_NXTK_DEFAULT_BORDERCOLORS is not set
# CONFIG_NX_DISABLE_16BPP is not set
# CONFIG_NX_PACKEDMSFIRST is not set
CONFIG_ADS7843E_SPIDEV=3
CONFIG_ADS7843E_SWAPXY=y
CONFIG_ADS7843E_THRESHX=39
CONFIG_ADS7843E_THRESHY=51
CONFIG_ARCH="arm"
CONFIG_ARCH_BOARD="shenzhou"
CONFIG_ARCH_BOARD_SHENZHOU=y
CONFIG_ARCH_CHIP_STM32=y
CONFIG_ARCH_CHIP_STM32F107VC=y
CONFIG_ARCH_STACKDUMP=y
CONFIG_ARMV7M_TOOLCHAIN_CODESOURCERYW=y
CONFIG_BOARD_LOOPSPERMSEC=5483
CONFIG_ETH0_PHY_DM9161=y
CONFIG_HAVE_CXX=y
CONFIG_HAVE_CXXINITIALIZE=y
CONFIG_HOST_WINDOWS=y
CONFIG_INPUT=y
CONFIG_INPUT_ADS7843E=y
CONFIG_INTELHEX_BINARY=y
CONFIG_LCD=y
CONFIG_LCD_MAXCONTRAST=1
CONFIG_LCD_NOGETRUN=y
CONFIG_LCD_SSD1289=y
CONFIG_MAX_TASKS=16
CONFIG_MAX_WDOGPARMS=2
CONFIG_MQ_MAXMSGSIZE=64
CONFIG_NET=y
CONFIG_NETDB_DNSCLIENT=y
CONFIG_NETDB_DNSCLIENT_ENTRIES=4
CONFIG_NETDB_DNSSERVER_NOADDR=y
CONFIG_NETUTILS_TELNETD=y
CONFIG_NETUTILS_TFTPC=y
CONFIG_NETUTILS_WEBCLIENT=y
CONFIG_NET_ICMP=y
CONFIG_NET_ICMP_SOCKET=y
CONFIG_NET_MAX_LISTENPORTS=16
CONFIG_NET_SOCKOPTS=y
CONFIG_NET_STATISTICS=y
CONFIG_NET_TCP=y
CONFIG_NET_TCPBACKLOG=y
CONFIG_NET_TCP_CONNS=16
CONFIG_NET_UDP=y
CONFIG_NET_UDP_CHECKSUMS=y
CONFIG_NFILE_DESCRIPTORS=12
CONFIG_NFILE_STREAMS=12
CONFIG_NSH_ARCHINIT=y
CONFIG_NSH_FILEIOSIZE=512
CONFIG_NSH_LIBRARY=y
CONFIG_NSH_LINELEN=64
CONFIG_NSH_NOMAC=y
CONFIG_NSH_READLINE=y
CONFIG_NSH_TELNETD_CLIENTSTACKSIZE=1596
CONFIG_NSH_TELNETD_DAEMONSTACKSIZE=1596
CONFIG_NSOCKET_DESCRIPTORS=16
CONFIG_NX=y
CONFIG_NXFONT_SANS22X29B=y
CONFIG_NXFONT_SANS23X27=y
CONFIG_NXTERM=y
CONFIG_NXTERM_CACHESIZE=32
CONFIG_NXTERM_CURSORCHAR=95
CONFIG_NXTERM_MXCHARS=325
CONFIG_NXTERM_NXKBDIN=y
CONFIG_NXTK_BORDERCOLOR1=0x5cb7
CONFIG_NXTK_BORDERCOLOR2=0x21c9
CONFIG_NXTK_BORDERCOLOR3=0xffdf
CONFIG_NXWIDGETS=y
CONFIG_NXWIDGETS_BPP=16
CONFIG_NXWIDGETS_LISTENERSTACK=1596
CONFIG_NXWIDGETS_SIZEOFCHAR=1
CONFIG_NXWM=y
CONFIG_NXWM_BACKGROUND_IMAGE=""
CONFIG_NXWM_CALIBRATION_LISTENERSTACK=1024
CONFIG_NXWM_HEXCALCULATOR_CUSTOM_FONTID=y
CONFIG_NXWM_HEXCALCULATOR_FONTID=5
CONFIG_NXWM_KEYBOARD=y
CONFIG_NXWM_KEYBOARD_LISTENERPRIO=100
CONFIG_NXWM_KEYBOARD_LISTENERSTACK=1024
CONFIG_NXWM_NXTERM_STACKSIZE=1596
CONFIG_NXWM_STARTWINDOW_STACKSIZE=1596
CONFIG_NXWM_TASKBAR_LEFT=y
CONFIG_NXWM_TASKBAR_VSPACING=4
CONFIG_NXWM_TOUCHSCREEN_LISTENERPRIO=101
CONFIG_NXWM_TOUCHSCREEN_LISTENERSTACK=1596
CONFIG_NXWM_UNITTEST=y
CONFIG_NX_BLOCKING=y
CONFIG_NX_KBD=y
CONFIG_NX_XYINPUT_TOUCHSCREEN=y
CONFIG_PREALLOC_TIMERS=4
CONFIG_PREALLOC_WDOGS=8
CONFIG_PTHREAD_STACK_DEFAULT=1024
CONFIG_RAM_SIZE=65536
CONFIG_RAM_START=0x20000000
CONFIG_RR_INTERVAL=200
CONFIG_SCHED_HPWORK=y
CONFIG_SCHED_HPWORKPRIORITY=192
CONFIG_SCHED_HPWORKSTACKSIZE=1024
CONFIG_SCHED_ONEXIT=y
CONFIG_SDCLONE_DISABLE=y
CONFIG_START_DAY=26
CONFIG_START_MONTH=9
CONFIG_START_YEAR=2012
CONFIG_STM32_ETHMAC=y
CONFIG_STM32_ETH_REMAP=y
CONFIG_STM32_JTAG_FULL_ENABLE=y
CONFIG_STM32_PHYADDR=0
CONFIG_STM32_PHYSR=17
CONFIG_STM32_PHYSR_100FD=0x8000
CONFIG_STM32_PHYSR_100HD=0x4000
CONFIG_STM32_PHYSR_10FD=0x2000
CONFIG_STM32_PHYSR_10HD=0x1000
CONFIG_STM32_PHYSR_ALTCONFIG=y
CONFIG_STM32_PHYSR_ALTMODE=0xf000
CONFIG_STM32_SPI3=y
CONFIG_STM32_SPI3_REMAP=y
CONFIG_STM32_USART2=y
CONFIG_STM32_USART2_REMAP=y
CONFIG_SYSTEM_PING=y
CONFIG_TASK_NAME_SIZE=0
CONFIG_USART2_RXBUFSIZE=128
CONFIG_USART2_SERIAL_CONSOLE=y
CONFIG_USART2_TXBUFSIZE=128
CONFIG_USERMAIN_STACKSIZE=1024
CONFIG_USER_ENTRYPOINT="nxwm_main"
CONFIG_WDOG_INTRESERVE=1
```

## configs/sim/Kconfig
```kconfig
#
# For a description of the syntax of this configuration file,
# see the file kconfig-language.txt in the NuttX tools repository.
#

if ARCH_BOARD_SIM

config EXAMPLES_TOUCHSCREEN_BGCOLOR
	hex "Background color for apps/examples/touchscreen"
	default 0x007b68ee
	depends on EXAMPLES_TOUCHSCREEN

endif
```

## configs/sim/configdata/defconfig
```kconfig
CONFIG_ARCH="sim"
CONFIG_ARCH_BOARD="sim"
CONFIG_ARCH_BOARD_SIM=y
CONFIG_ARCH_SIM=y
CONFIG_DEBUG_SYMBOLS=y
CONFIG_DISABLE_MQUEUE=y
CONFIG_DISABLE_POLL=y
CONFIG_DISABLE_POSIX_TIMERS=y
CONFIG_DISABLE_PTHREAD=y
CONFIG_DISABLE_SIGNALS=y
CONFIG_EXAMPLES_CONFIGDATA=y
CONFIG_EXAMPLES_CONFIGDATA_NLOOPS=10000
CONFIG_EXAMPLES_CONFIGDATA_SILENT=y
CONFIG_EXAMPLES_NXFFS=y
CONFIG_FS_FAT=y
CONFIG_FS_NXFFS=y
CONFIG_IDLETHREAD_STACKSIZE=4096
CONFIG_LIB_RAND_ORDER=3
CONFIG_MAX_TASKS=64
CONFIG_MTD=y
CONFIG_MTD_BYTE_WRITE=y
CONFIG_MTD_CONFIG=y
CONFIG_NFILE_DESCRIPTORS=32
CONFIG_PLATFORM_CONFIGDATA=y
CONFIG_PTHREAD_STACK_DEFAULT=8192
CONFIG_RAMMTD=y
CONFIG_RAMMTD_BLOCKSIZE=256
CONFIG_RAMMTD_FLASHSIM=y
CONFIG_SDCLONE_DISABLE=y
CONFIG_START_DAY=4
CONFIG_START_MONTH=11
CONFIG_START_YEAR=2013
CONFIG_USERMAIN_STACKSIZE=4096
CONFIG_USER_ENTRYPOINT="configdata_main"
```
