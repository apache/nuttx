## configs/stm3240g-eval/nxterm/defconfig
```kconfig
# CONFIG_ARCH_FPU is not set
# CONFIG_NSH_DISABLE_IFCONFIG is not set
# CONFIG_NSH_DISABLE_PS is not set
# CONFIG_NXFONTS_DISABLE_16BPP is not set
# CONFIG_NXTK_DEFAULT_BORDERCOLORS is not set
# CONFIG_NX_DISABLE_16BPP is not set
# CONFIG_NX_PACKEDMSFIRST is not set
# CONFIG_NX_WRITEONLY is not set
CONFIG_ARCH="arm"
CONFIG_ARCH_BOARD="stm3240g-eval"
CONFIG_ARCH_BOARD_STM3240G_EVAL=y
CONFIG_ARCH_CHIP_STM32=y
CONFIG_ARCH_CHIP_STM32F407IG=y
CONFIG_ARCH_STACKDUMP=y
CONFIG_ARMV7M_TOOLCHAIN_CODESOURCERYW=y
CONFIG_BOARD_LOOPSPERMSEC=16717
CONFIG_BUILTIN=y
CONFIG_ETH0_PHY_DP83848C=y
CONFIG_EXAMPLES_NXTERM=y
CONFIG_HAVE_CXX=y
CONFIG_HAVE_CXXINITIALIZE=y
CONFIG_HEAP2_BASE=0x64000000
CONFIG_HEAP2_SIZE=2097152
CONFIG_HOST_WINDOWS=y
CONFIG_I2C=y
CONFIG_I2CTOOL_DEFFREQ=100000
CONFIG_I2CTOOL_MINBUS=1
CONFIG_I2C_POLLED=y
CONFIG_INTELHEX_BINARY=y
CONFIG_LCD=y
CONFIG_LCD_MAXCONTRAST=1
CONFIG_LCD_NOGETRUN=y
CONFIG_MAX_TASKS=16
CONFIG_MAX_WDOGPARMS=2
CONFIG_MM_REGIONS=3
CONFIG_MQ_MAXMSGSIZE=64
CONFIG_NET=y
CONFIG_NETDB_DNSCLIENT=y
CONFIG_NETDB_DNSCLIENT_ENTRIES=4
CONFIG_NETDB_DNSSERVER_NOADDR=y
CONFIG_NETUTILS_TELNETD=y
CONFIG_NETUTILS_TFTPC=y
CONFIG_NETUTILS_WEBCLIENT=y
CONFIG_NET_BROADCAST=y
CONFIG_NET_ICMP=y
CONFIG_NET_ICMP_SOCKET=y
CONFIG_NET_MAX_LISTENPORTS=40
CONFIG_NET_SOCKOPTS=y
CONFIG_NET_STATISTICS=y
CONFIG_NET_TCP=y
CONFIG_NET_TCPBACKLOG=y
CONFIG_NET_TCP_CONNS=40
CONFIG_NET_UDP=y
CONFIG_NET_UDP_CHECKSUMS=y
CONFIG_NFILE_DESCRIPTORS=12
CONFIG_NFILE_STREAMS=12
CONFIG_NSH_BUILTIN_APPS=y
CONFIG_NSH_FILEIOSIZE=512
CONFIG_NSH_LIBRARY=y
CONFIG_NSH_LINELEN=64
CONFIG_NSH_NOMAC=y
CONFIG_NSH_READLINE=y
CONFIG_NSOCKET_DESCRIPTORS=10
CONFIG_NX=y
CONFIG_NXFONT_SANS23X27=y
CONFIG_NXTERM=y
CONFIG_NXTERM_CACHESIZE=32
CONFIG_NXTERM_CURSORCHAR=95
CONFIG_NXTERM_MXCHARS=256
CONFIG_NXTK_BORDERCOLOR1=0xad55
CONFIG_NXTK_BORDERCOLOR2=0x6b4d
CONFIG_NXTK_BORDERCOLOR3=0xdedb
CONFIG_NX_BLOCKING=y
CONFIG_NX_KBD=y
CONFIG_NX_XYINPUT_MOUSE=y
CONFIG_PREALLOC_MQ_MSGS=8
CONFIG_PREALLOC_TIMERS=4
CONFIG_PREALLOC_WDOGS=8
CONFIG_RAM_SIZE=196608
CONFIG_RAM_START=0x20000000
CONFIG_RR_INTERVAL=200
CONFIG_RTC_DATETIME=y
CONFIG_SCHED_HPWORK=y
CONFIG_SCHED_WAITPID=y
CONFIG_SDCLONE_DISABLE=y
CONFIG_STM32_DFU=y
CONFIG_STM32_ETHMAC=y
CONFIG_STM32_FSMC=y
CONFIG_STM32_FSMC_SRAM=y
CONFIG_STM32_I2C1=y
CONFIG_STM32_JTAG_FULL_ENABLE=y
CONFIG_STM32_MII=y
CONFIG_STM32_PHYSR=16
CONFIG_STM32_PHYSR_100MBPS=0x0000
CONFIG_STM32_PHYSR_FULLDUPLEX=0x0004
CONFIG_STM32_PHYSR_MODE=0x0004
CONFIG_STM32_PHYSR_SPEED=0x0002
CONFIG_STM32_PWR=y
CONFIG_STM32_RTC=y
CONFIG_STM32_USART3=y
CONFIG_SYSTEM_I2CTOOL=y
CONFIG_SYSTEM_PING=y
CONFIG_TASK_NAME_SIZE=0
CONFIG_USART3_RXBUFSIZE=128
CONFIG_USART3_SERIAL_CONSOLE=y
CONFIG_USART3_TXBUFSIZE=128
CONFIG_USER_ENTRYPOINT="nxterm_main"
CONFIG_WDOG_INTRESERVE=1
```

## configs/stm32f103-minimum/Kconfig
```kconfig
#
# For a description of the syntax of this configuration file,
# see the file kconfig-language.txt in the NuttX tools repository.
#

if ARCH_BOARD_STM32F103_MINIMUM

config STM32F103MINIMUM_FLASH
	bool "MTD driver for external 4Mbyte W25Q32FV FLASH on SPI1"
	default n
	select MTD
	select MTD_W25
	select MTD_SMART
	select FS_SMARTFS
	select STM32_SPI1
	select MTD_BYTE_WRITE
	---help---
		Configures an MTD device for use with the onboard flash

config STM32F103MINIMUM_FLASH_MINOR
	int "Minor number for the FLASH /dev/smart entry"
	default 0
	depends on STM32F103MINIMUM_FLASH
	---help---
		Sets the minor number for the FLASH MTD /dev entry

config STM32F103MINIMUM_FLASH_PART
	bool "Enable partition support on FLASH"
	default y
	depends on STM32F103MINIMUM_FLASH
	select MTD_PARTITION
	---help---
		Enables creation of partitions on the FLASH

config STM32F103MINIMUM_FLASH_CONFIG_PART
	bool "Create application config data partition on FLASH"
	default n
	depends on STM32F103MINIMUM_FLASH_PART
	depends on PLATFORM_CONFIGDATA
	---help---
		Enables creation of a /dev/config partition on the FLASH

config STM32F103MINIMUM_FLASH_CONFIG_PART_NUMBER
	int "Index number of config partition (in list below)"
	default 0
	depends on STM32F103MINIMUM_FLASH_CONFIG_PART
	---help---
		Specifies the index number of the config data partition
		from the partition list.

config STM32F103MINIMUM_FLASH_PART_LIST
	string "Flash partition size list"
	default "1024,1024,1024,1024"
	depends on STM32F103MINIMUM_FLASH_PART
	---help---
		Comma separated list of partition sizes in KB.

config STM32F103MINIMUM_FLASH_PART_NAMES
	string "Flash partition name list"
	default "first,second,third,forth"
	depends on STM32F103MINIMUM_FLASH_PART
	depends on MTD_PARTITION_NAMES
	---help---
		Comma separated list of partition names.

config STM32F103MINIMUM_QETIMER
	int "Timer to use with QE encoder"
	default 4
	depends on QENCODER

endif
```

## configs/stm32f103-minimum/nsh/defconfig
```kconfig
# CONFIG_DISABLE_OS_API is not set
# CONFIG_NSH_DISABLESCRIPT is not set
# CONFIG_NSH_DISABLE_DD is not set
# CONFIG_NSH_DISABLE_EXEC is not set
# CONFIG_NSH_DISABLE_EXIT is not set
# CONFIG_NSH_DISABLE_GET is not set
# CONFIG_NSH_DISABLE_HEXDUMP is not set
# CONFIG_NSH_DISABLE_MKRD is not set
# CONFIG_NSH_DISABLE_PS is not set
# CONFIG_NSH_DISABLE_PUT is not set
# CONFIG_NSH_DISABLE_WGET is not set
# CONFIG_NSH_DISABLE_XD is not set
CONFIG_ARCH="arm"
CONFIG_ARCH_BOARD="stm32f103-minimum"
CONFIG_ARCH_BOARD_STM32F103_MINIMUM=y
CONFIG_ARCH_CHIP_STM32=y
CONFIG_ARCH_CHIP_STM32F103C8=y
CONFIG_ARCH_STACKDUMP=y
CONFIG_BOARD_LOOPSPERMSEC=5483
CONFIG_BUILTIN=y
CONFIG_DEFAULT_SMALL=y
CONFIG_MAX_TASKS=16
CONFIG_MAX_WDOGPARMS=2
CONFIG_NFILE_DESCRIPTORS=8
CONFIG_NFILE_STREAMS=8
CONFIG_NSH_ARCHINIT=y
CONFIG_NSH_BUILTIN_APPS=y
CONFIG_NSH_FILEIOSIZE=1024
CONFIG_NSH_LINELEN=80
CONFIG_PREALLOC_MQ_MSGS=4
CONFIG_PREALLOC_TIMERS=4
CONFIG_PREALLOC_WDOGS=4
CONFIG_RAM_SIZE=20480
CONFIG_RAM_START=0x20000000
CONFIG_RAW_BINARY=y
CONFIG_RR_INTERVAL=200
CONFIG_SCHED_HPWORK=y
CONFIG_SCHED_HPWORKPRIORITY=192
CONFIG_SCHED_WAITPID=y
CONFIG_SDCLONE_DISABLE=y
CONFIG_SERIAL_TERMIOS=y
CONFIG_START_DAY=5
CONFIG_START_MONTH=7
CONFIG_START_YEAR=2011
CONFIG_STM32_DISABLE_IDLE_SLEEP_DURING_DEBUG=y
CONFIG_STM32_JTAG_FULL_ENABLE=y
CONFIG_STM32_USART1=y
CONFIG_SYMTAB_ORDEREDBYNAME=y
CONFIG_SYSTEM_NSH=y
CONFIG_TASK_NAME_SIZE=0
CONFIG_USART1_SERIAL_CONSOLE=y
CONFIG_USER_ENTRYPOINT="nsh_main"
CONFIG_WDOG_INTRESERVE=0
```

## configs/stm32f3discovery/nsh/defconfig
```kconfig
# CONFIG_ARCH_FPU is not set
# CONFIG_NSH_DISABLE_IFCONFIG is not set
# CONFIG_NSH_DISABLE_PS is not set
CONFIG_ARCH="arm"
CONFIG_ARCH_BOARD="stm32f3discovery"
CONFIG_ARCH_BOARD_STM32F3_DISCOVERY=y
CONFIG_ARCH_BUTTONS=y
CONFIG_ARCH_CHIP_STM32=y
CONFIG_ARCH_CHIP_STM32F303VC=y
CONFIG_ARCH_STACKDUMP=y
CONFIG_ARMV7M_TOOLCHAIN_CODESOURCERYW=y
CONFIG_BOARD_LOOPSPERMSEC=6522
CONFIG_BUILTIN=y
CONFIG_CDCACM=y
CONFIG_CDCACM_RXBUFSIZE=256
CONFIG_CDCACM_TXBUFSIZE=256
CONFIG_DISABLE_POLL=y
CONFIG_HAVE_CXX=y
CONFIG_HAVE_CXXINITIALIZE=y
CONFIG_HOST_WINDOWS=y
CONFIG_INTELHEX_BINARY=y
CONFIG_LIB_BOARDCTL=y
CONFIG_MAX_TASKS=16
CONFIG_MAX_WDOGPARMS=2
CONFIG_MM_REGIONS=2
CONFIG_NFILE_DESCRIPTORS=8
CONFIG_NFILE_STREAMS=8
CONFIG_NSH_BUILTIN_APPS=y
CONFIG_NSH_FILEIOSIZE=512
CONFIG_NSH_LINELEN=64
CONFIG_NSH_READLINE=y
CONFIG_PREALLOC_MQ_MSGS=4
CONFIG_PREALLOC_TIMERS=4
CONFIG_PREALLOC_WDOGS=8
CONFIG_RAM_SIZE=40960
CONFIG_RAM_START=0x20000000
CONFIG_RAW_BINARY=y
CONFIG_RR_INTERVAL=200
CONFIG_SCHED_WAITPID=y
CONFIG_SDCLONE_DISABLE=y
CONFIG_START_DAY=6
CONFIG_START_MONTH=12
CONFIG_START_YEAR=2011
CONFIG_STM32_JTAG_SW_ENABLE=y
CONFIG_STM32_PWR=y
CONFIG_STM32_USART2=y
CONFIG_STM32_USB=y
CONFIG_SYSTEM_CDCACM=y
CONFIG_SYSTEM_NSH=y
CONFIG_SYSTEM_NSH_CXXINITIALIZE=y
CONFIG_TASK_NAME_SIZE=0
CONFIG_USART2_RXBUFSIZE=128
CONFIG_USART2_SERIAL_CONSOLE=y
CONFIG_USART2_TXBUFSIZE=128
CONFIG_USER_ENTRYPOINT="nsh_main"
CONFIG_WDOG_INTRESERVE=1
```

## configs/stm32f411e-disco/nsh/defconfig
```kconfig
# CONFIG_ARCH_FPU is not set
# CONFIG_ARCH_LEDS is not set
# CONFIG_DISABLE_OS_API is not set
# CONFIG_NSH_ARGCAT is not set
# CONFIG_NSH_CMDOPT_HEXDUMP is not set
# CONFIG_NSH_CMDPARMS is not set
# CONFIG_NSH_DISABLE_IFCONFIG is not set
# CONFIG_NSH_DISABLE_PS is not set
# CONFIG_STM32_SYSCFG is not set
CONFIG_ARCH="arm"
CONFIG_ARCH_BOARD="stm32f411e-disco"
CONFIG_ARCH_BOARD_STM32F411E_DISCO=y
CONFIG_ARCH_CHIP_STM32=y
CONFIG_ARCH_CHIP_STM32F411VE=y
CONFIG_ARCH_INTERRUPTSTACK=2048
CONFIG_ARCH_STACKDUMP=y
CONFIG_BOARD_LOOPSPERMSEC=8499
CONFIG_BUILTIN=y
CONFIG_DISABLE_POLL=y
CONFIG_HAVE_CXX=y
CONFIG_INTELHEX_BINARY=y
CONFIG_MAX_TASKS=16
CONFIG_MAX_WDOGPARMS=2
CONFIG_NFILE_DESCRIPTORS=8
CONFIG_NFILE_STREAMS=8
CONFIG_NSH_BUILTIN_APPS=y
CONFIG_NSH_FILEIOSIZE=512
CONFIG_NSH_LINELEN=64
CONFIG_NSH_READLINE=y
CONFIG_PREALLOC_MQ_MSGS=4
CONFIG_PREALLOC_TIMERS=4
CONFIG_PREALLOC_WDOGS=8
CONFIG_RAM_SIZE=131072
CONFIG_RAM_START=0x20000000
CONFIG_RAW_BINARY=y
CONFIG_RR_INTERVAL=200
CONFIG_SCHED_WAITPID=y
CONFIG_SDCLONE_DISABLE=y
CONFIG_START_DAY=14
CONFIG_START_MONTH=10
CONFIG_START_YEAR=2014
CONFIG_STM32_FLASH_CONFIG_E=y
CONFIG_STM32_JTAG_SW_ENABLE=y
CONFIG_STM32_USART2=y
CONFIG_SYSTEM_NSH=y
CONFIG_TASK_NAME_SIZE=0
CONFIG_USART2_SERIAL_CONSOLE=y
CONFIG_USER_ENTRYPOINT="nsh_main"
CONFIG_WDOG_INTRESERVE=1
```

## configs/stm32f429i-disco/Kconfig
```kconfig
#
# For a description of the syntax of this configuration file,
# see misc/tools/kconfig-language.txt.
#

if ARCH_BOARD_STM32F429I_DISCO

config STM32F429I_DISCO_FLASH
	bool "MTD driver for external 8Mbyte SST25 FLASH on SPI4"
	default n
	select MTD
	select MTD_SST25XX
	select MTD_SMART
	select FS_SMARTFS
	select STM32_SPI4
	select MTD_BYTE_WRITE
	---help---
		Configures an MTD device for use with the onboard flash

config STM32F429I_DISCO_FLASH_MINOR
	int "Minor number for the FLASH /dev/smart entry"
	default 0
	depends on STM32F429I_DISCO_FLASH
	---help---
		Sets the minor number for the FLASH MTD /dev entry

config STM32F429I_DISCO_FLASH_PART
	bool "Enable partition support on FLASH"
	default n
	depends on STM32F429I_DISCO_FLASH
	---help---
		Enables creation of partitions on the FLASH

config STM32F429I_DISCO_FLASH_CONFIG_PART
	bool "Create application config data partition on FLASH"
	default y
	depends on STM32F429I_DISCO_FLASH_PART
	depends on PLATFORM_CONFIGDATA
	---help---
		Enables creation of a /dev/config partition on the FLASH

config STM32F429I_DISCO_FLASH_CONFIG_PART_NUMBER
	int "Index number of config partition (in list below)"
	default 0
	depends on STM32F429I_DISCO_FLASH_CONFIG_PART
	---help---
		Specifies the index number of the config data partition
		from the partition list.

config STM32F429I_DISCO_FLASH_PART_LIST
	string "Flash partition size list"
	default "4,8188"
	depends on STM32F429I_DISCO_FLASH_PART
	---help---
		Comma separated list of partition sizes in KB.

config STM32F429I_DISCO_FLASH_PART_NAMES
	string "Flash partition name list"
	default "config,rfs"
	depends on STM32F429I_DISCO_FLASH_PART
	depends on MTD_PARTITION_NAMES
	---help---
		Comma separated list of partition names.

config STM32F429I_DISCO_RAMMTD
	bool "MTD driver for SMARTFS RAM disk"
	default n
	select MTD
	select RAMMTD
	---help---
		Configures an MTD based RAM device for use with SMARTFS.

config STM32F429I_DISCO_RAMMTD_MINOR
	int "Minor number for RAM /dev/smart entry"
	default 1
	depends on STM32F429I_DISCO_RAMMTD
	---help---
		Sets the minor number for the RAM MTD /dev entry

config STM32F429I_DISCO_RAMMTD_SIZE
	int "Size in KB of the RAM device to create"
	default 32
	depends on STM32F429I_DISCO_RAMMTD
	---help---
		Sets the size of static RAM allocation for the SMART RAM device

config STM32F429IDISCO_USBHOST_STACKSIZE
	int "USB host waiter stack size"
	default 1024
	depends on USBHOST

config STM32F429IDISCO_USBHOST_PRIO
	int "USB host waiter task priority"
	default 100
	depends on USBHOST

config PM_BUTTONS
	bool "PM Button support"
	default n
	depends on PM && ARCH_IRQBUTTONS
	---help---
		Enable PM button EXTI interrupts to support PM testing

config PM_BUTTON_ACTIVITY
	int "Button PM activity weight"
	default 10
	depends on PM_BUTTONS
	---help---
		The activity weight to report to the power management subsystem when a button is pressed.

config PM_ALARM_SEC
	int "PM_STANDBY delay (seconds)"
	default 15
	depends on PM && RTC_ALARM
	---help---
		Number of seconds to wait in PM_STANDBY before going to PM_STANDBY mode.

config PM_ALARM_NSEC
	int "PM_STANDBY delay (nanoseconds)"
	default 0
	depends on PM && RTC_ALARM
	---help---
		Number of additional nanoseconds to wait in PM_STANDBY before going to PM_STANDBY mode.

config PM_SLEEP_WAKEUP
	bool "PM_SLEEP wake-up alarm"
	default n
	depends on PM && RTC_ALARM
	---help---
		Wake-up of PM_SLEEP mode after a delay and resume normal operation.

config PM_SLEEP_WAKEUP_SEC
	int "PM_SLEEP delay (seconds)"
	default 10
	depends on PM && RTC_ALARM
	---help---
		Number of seconds to wait in PM_SLEEP before going to PM_STANDBY mode.

config PM_SLEEP_WAKEUP_NSEC
	int "PM_SLEEP delay (nanoseconds)"
	default 0
	depends on PM && RTC_ALARM
	---help---
		Number of additional nanoseconds to wait in PM_SLEEP before going to PM_STANDBY mode.

menuconfig STM32F429I_DISCO_ILI9341
	bool "LCD driver for ILI9341 Liquid Crystal Display Controller"
	default n
	---help---
		Enables  support for a connected display based on ili9341 LCD Single Chip
		Driver. This sub driver supports only communication with the display driver
		connected via 4-wire serial (spi) mcu interface.

if STM32F429I_DISCO_ILI9341

choice
	prompt "LCD Interface Type"
	default STM32F429I_DISCO_ILI9341_NONE if !LCD_ILI9341 && !STM32_LTDC
	default STM32F429I_DISCO_ILI9341_LCDIFACE if LCD_ILI9341 && !STM32_LTDC
	default STM32F429I_DISCO_ILI9341_FBIFACE if STM32_LTDC

config STM32F429I_DISCO_ILI9341_NONE
	bool "No LCD interface"

config STM32F429I_DISCO_ILI9341_LCDIFACE
	bool "Enable support for nuttx LCD interface"
	depends on LCD_ILI9341
	---help---
		Enable lcd driver support for the nuttx lcd interface.

config STM32F429I_DISCO_ILI9341_FBIFACE
	bool "Enable support for nuttx framebuffer interface"
	depends on STM32_LTDC
	---help---
		Enable lcd driver support for the nuttx framebuffer interface to displaying
		data via ltdc controller of the stm32f429i mcu.

endchoice # LCD Interface Type

if STM32F429I_DISCO_ILI9341_LCDIFACE

config STM32F429I_DISCO_ILI9341_LCDDEVICE
	int "LCD interface"
	default 0
	range 0 1
	depends on STM32F429I_DISCO_ILI9341_LCDIFACE
	---help---
		Define the lcd interface which should be used. This must be
		corresponding to the configured ili9341 LCD device in the driver
		section.

config STM32F429I_DISCO_ILI9341_SPIFREQUENCY
	int "SPI frequency"
	default 12000000
	---help---
		Define the bus frequency of the SPI device.

config STM32F429I_DISCO_ILI9341_SPIBITS16
	bool "Enable 16 bit pixel read/write"
	default n
	---help---
		This enables faster 16-bit SPI mode for transmitting or receiving pixel data
		to or from the display gram. But uses default 8-bit SPI mode for all other
		display operations.

endif # STM32F429I_DISCO_ILI9341_LCDIFACE

if STM32F429I_DISCO_ILI9341_FBIFACE

choice
	prompt "LCD Orientation"
	default STM32F429I_DISCO_ILI9341_FBIFACE_PORTRAIT
	---help---
		Configure display orientation.

config STM32F429I_DISCO_ILI9341_FBIFACE_LANDSCAPE
	bool "Landscape orientation"
	---help---
		Define for "landscape" orientation support.

config STM32F429I_DISCO_ILI9341_FBIFACE_PORTRAIT
	bool "Portrait orientation"
	---help---
		Define for "portrait" orientation support.

config STM32F429I_DISCO_ILI9341_FBIFACE_RLANDSCAPE
	bool "Reverse landscape orientation"
	---help---
		Define for "reverse landscape" orientation support.

config STM32F429I_DISCO_ILI9341_FBIFACE_RORTRAIT
	bool "Reverse portrait display"
	---help---
		Define for "reverse portrait" orientation support.

endchoice

endif # STM32F429I_DISCO_ILI9341_FBIFACE
endif # STM32F429I_DISCO_ILI9341
endif # ARCH_BOARD_STM32F429I_DISCO
```
