## configs/ubw32/nsh/defconfig
```kconfig
############################################################################
# configs/ubw32/nsh/defconfig
#
#   Copyright (C) 2012 Gregory Nutt. All rights reserved.
#   Author: Gregory Nutt <gnutt@nuttx.org>
#
# Redistribution and use in source and binary forms, with or without
# modification, are permitted provided that the following conditions
# are met:
#
# 1. Redistributions of source code must retain the above copyright
#    notice, this list of conditions and the following disclaimer.
# 2. Redistributions in binary form must reproduce the above copyright
#    notice, this list of conditions and the following disclaimer in
#    the documentation and/or other materials provided with the
#    distribution.
# 3. Neither the name NuttX nor the names of its contributors may be
#    used to endorse or promote products derived from this software
#    without specific prior written permission.
#
# THIS SOFTWARE IS PROVIDED BY THE COPYRIGHT HOLDERS AND CONTRIBUTORS
# "AS IS" AND ANY EXPRESS OR IMPLIED WARRANTIES, INCLUDING, BUT NOT
# LIMITED TO, THE IMPLIED WARRANTIES OF MERCHANTABILITY AND FITNESS
# FOR A PARTICULAR PURPOSE ARE DISCLAIMED. IN NO EVENT SHALL THE
# COPYRIGHT OWNER OR CONTRIBUTORS BE LIABLE FOR ANY DIRECT, INDIRECT,
# INCIDENTAL, SPECIAL, EXEMPLARY, OR CONSEQUENTIAL DAMAGES (INCLUDING,
# BUT NOT LIMITED TO, PROCUREMENT OF SUBSTITUTE GOODS OR SERVICES; LOSS
# OF USE, DATA, OR PROFITS; OR BUSINESS INTERRUPTION) HOWEVER CAUSED
# AND ON ANY THEORY OF LIABILITY, WHETHER IN CONTRACT, STRICT
# LIABILITY, OR TORT (INCLUDING NEGLIGENCE OR OTHERWISE) ARISING IN
# ANY WAY OUT OF THE USE OF THIS SOFTWARE, EVEN IF ADVISED OF THE
# POSSIBILITY OF SUCH DAMAGE.
#
############################################################################

CONFIG_EXAMPLES_NSH=y
CONFIG_NSH_READLINE=y
# CONFIG_NSH_CLE is not set
CONFIG_SYSTEM_READLINE=y
# CONFIG_SYSTEM_CLE is not set
CONFIG_NSH_LIBRARY=y

CONFIG_HOST_WINDOWS=y
CONFIG_WINDOWS_CYGWIN=y

############################################################################
#
# Architecture Selection
#
CONFIG_ARCH="mips"
CONFIG_ARCH_MIPS=y
CONFIG_ARCH_MIPS32=y
CONFIG_ARCH_CHIP="pic32mx"
CONFIG_ARCH_CHIP_PIC32MX460F512L=y
CONFIG_ARCH_BOARD="ubw32"
CONFIG_ARCH_BOARD_UBW32=y
CONFIG_BOARD_LOOPSPERMSEC=8079
CONFIG_RAM_SIZE=32768
CONFIG_RAM_START=0xa0000000
CONFIG_ARCH_NOINTC=n
CONFIG_ARCH_VECNOTIRQ=y
CONFIG_ARCH_IRQPRIO=y
CONFIG_ARCH_INTERRUPTSTACK=0
CONFIG_ARCH_STACKDUMP=y
CONFIG_ARCH_BOOTLOADER=n
CONFIG_ARCH_LEDS=y
CONFIG_ARCH_BUTTONS=n
CONFIG_ARCH_CALIBRATION=n
CONFIG_ARCH_DMA=n

#
# Enable support for RAM-based functions
# (If selected, then modifications are needed in ld.script as well)
#
CONFIG_ARCH_RAMFUNCS=n

#
# Identify toolchain and linker options
#
CONFIG_MIPS32_TOOLCHAIN_MICROCHIPW=n
CONFIG_MIPS32_TOOLCHAIN_MICROCHIPL=n
CONFIG_MIPS32_TOOLCHAIN_MICROCHIPW_LITE=y
CONFIG_MIPS32_TOOLCHAIN_MICROCHIPL_LITE=n

#
# Individual subsystems can be enabled:
#

CONFIG_PIC32MX_WDT=n
CONFIG_PIC32MX_RTCC=n
CONFIG_PIC32MX_TIMER1=n
CONFIG_PIC32MX_TIMER2=n
CONFIG_PIC32MX_TIMER3=n
CONFIG_PIC32MX_TIMER4=n
CONFIG_PIC32MX_TIMER5=n
CONFIG_PIC32MX_IC1=n
CONFIG_PIC32MX_IC2=n
CONFIG_PIC32MX_IC3=n
CONFIG_PIC32MX_IC4=n
CONFIG_PIC32MX_IC5=n
CONFIG_PIC32MX_OC1=n
CONFIG_PIC32MX_OC2=n
CONFIG_PIC32MX_OC3=n
CONFIG_PIC32MX_OC4=n
CONFIG_PIC32MX_OC5=n
CONFIG_PIC32MX_I2C1=n
CONFIG_PIC32MX_I2C2=n
CONFIG_PIC32MX_SPI1=n
CONFIG_PIC32MX_SPI2=n
CONFIG_PIC32MX_UART1=y
CONFIG_PIC32MX_UART2=n
CONFIG_PIC32MX_PMP=n
CONFIG_PIC32MX_ADC=n
CONFIG_PIC32MX_CVR=n
CONFIG_PIC32MX_CM1=n
CONFIG_PIC32MX_CM2=n
CONFIG_PIC32MX_DDP=n
CONFIG_PIC32MX_FLASH=n
CONFIG_PIC32MX_BMX=n
CONFIG_PIC32MX_DMA=n
CONFIG_PIC32MX_CHE=n
CONFIG_PIC32MX_USBDEV=n
CONFIG_PIC32MX_USBHOST=n

#
# PIC32MX Configuration Settings
#
CONFIG_PIC32MX_DEBUGGER=2
CONFIG_PIC32MX_ICESEL=1

#
# PIC32MX specific serial device driver settings
#
CONFIG_UART1_SERIAL_CONSOLE=y

CONFIG_UART1_TXBUFSIZE=256

CONFIG_UART1_RXBUFSIZE=256

CONFIG_UART1_BAUD=115200

CONFIG_UART1_BITS=8

CONFIG_UART1_PARITY=0

CONFIG_UART1_2STOP=0

#
# General build options
#
CONFIG_RRLOAD_BINARY=n
CONFIG_INTELHEX_BINARY=y
CONFIG_MOTOROLA_SREC=n
CONFIG_RAW_BINARY=n

#
# General OS setup
#
CONFIG_USER_ENTRYPOINT="nsh_main"
CONFIG_DEBUG=n
CONFIG_DEBUG_VERBOSE=n
CONFIG_DEBUG_SYMBOLS=n
CONFIG_DEBUG_SCHED=n
CONFIG_DEBUG_USB=n

CONFIG_MM_REGIONS=1
CONFIG_ARCH_LOWPUTC=y
CONFIG_RR_INTERVAL=0
CONFIG_SCHED_INSTRUMENTATION=n
CONFIG_TASK_NAME_SIZE=0
CONFIG_START_YEAR=2012
CONFIG_START_MONTH=4
CONFIG_START_DAY=26
CONFIG_GREGORIAN_TIME=n
CONFIG_JULIAN_TIME=n
CONFIG_DEV_CONSOLE=y
CONFIG_DEV_LOWCONSOLE=n
CONFIG_MUTEX_TYPES=n
CONFIG_FDCLONE_DISABLE=n
CONFIG_FDCLONE_STDIO=n
CONFIG_SDCLONE_DISABLE=y
CONFIG_SCHED_WAITPID=y
CONFIG_SCHED_ATEXIT=n

#
# The following can be used to disable categories of
# APIs supported by the OS.  If the compiler supports
# weak functions, then it should not be necessary to
# disable functions unless you want to restrict usage
# of those APIs.
#
# There are certain dependency relationships in these
# features.
#
# o mq_notify logic depends on signals to awaken tasks
#   waiting for queues to become full or empty.
# o pthread_condtimedwait() depends on signals to wake
#   up waiting tasks.
#
CONFIG_DISABLE_CLOCK=n
CONFIG_DISABLE_POSIX_TIMERS=n
CONFIG_DISABLE_PTHREAD=n
CONFIG_DISABLE_SIGNALS=n
CONFIG_DISABLE_MQUEUE=n
CONFIG_DISABLE_MOUNTPOINT=n
CONFIG_DISABLE_ENVIRON=n
CONFIG_DISABLE_POLL=y

#
# Misc libc settings
#
CONFIG_NOPRINTF_FIELDWIDTH=n

#
# Allow for architecture optimized implementations
#
# The architecture can provide optimized versions of the
# following to improve system performance
#
CONFIG_ARCH_MEMCPY=n
CONFIG_ARCH_MEMCMP=n
CONFIG_ARCH_MEMMOVE=n
CONFIG_ARCH_MEMSET=n
CONFIG_ARCH_STRCMP=n
CONFIG_ARCH_STRCPY=n
CONFIG_ARCH_STRNCPY=n
CONFIG_ARCH_STRLEN=n
CONFIG_ARCH_STRNLEN=n
CONFIG_ARCH_BZERO=n

#
# Sizes of configurable things (0 disables)
#
CONFIG_MAX_TASKS=16
CONFIG_MAX_TASK_ARGS=4
CONFIG_NPTHREAD_KEYS=4
CONFIG_NFILE_DESCRIPTORS=8
CONFIG_NFILE_STREAMS=8
CONFIG_NAME_MAX=32
CONFIG_STDIO_BUFFER_SIZE=64
CONFIG_STDIO_LINEBUFFER=y
CONFIG_NUNGET_CHARS=2
CONFIG_PREALLOC_MQ_MSGS=4
CONFIG_MQ_MAXMSGSIZE=32
CONFIG_MAX_WDOGPARMS=2
CONFIG_PREALLOC_WDOGS=8
CONFIG_PREALLOC_TIMERS=4

#
# Filesystem configuration
#
CONFIG_FS_FAT=y
CONFIG_FAT_LCNAMES=y
CONFIG_FAT_LFN=y
CONFIG_FAT_MAXFNAME=32
CONFIG_FS_NXFFS=n
CONFIG_FS_ROMFS=n

#
# Maintain legacy build behavior (revisit)
#

CONFIG_MMCSD=y

#
# SPI-based MMC/SD driver
#
CONFIG_MMCSD_NSLOTS=1
CONFIG_MMCSD_READONLY=n

#
# Block driver buffering
#
CONFIG_FS_READAHEAD=n
CONFIG_FS_WRITEBUFFER=n

#
# SDIO-based MMC/SD driver
#
CONFIG_SDIO_DMA=n
CONFIG_MMCSD_MMCSUPPORT=n
CONFIG_MMCSD_HAVECARDDETECT=n

#
# Settings for apps/nshlib
#
CONFIG_BUILTIN=y
CONFIG_NSH_BUILTIN_APPS=y
CONFIG_NSH_FILEIOSIZE=512
CONFIG_NSH_STRERROR=n
CONFIG_NSH_LINELEN=64
CONFIG_NSH_NESTDEPTH=3
CONFIG_NSH_DISABLESCRIPT=n
CONFIG_NSH_DISABLEBG=n
CONFIG_NSH_ROMFSETC=n
CONFIG_NSH_CONSOLE=y
CONFIG_NSH_TELNET=n
CONFIG_NSH_ARCHINIT=y

#
# Architecture-specific NSH options
#
CONFIG_NSH_MMCSDSLOTNO=0
CONFIG_NSH_MMCSDMINOR=0

#
# Stack and heap information
#
CONFIG_BOOT_RUNFROMFLASH=n
CONFIG_BOOT_COPYTORAM=n
CONFIG_CUSTOM_STACK=n
CONFIG_IDLETHREAD_STACKSIZE=2048
CONFIG_USERMAIN_STACKSIZE=2048
CONFIG_PTHREAD_STACK_MIN=256
CONFIG_PTHREAD_STACK_DEFAULT=2048
```

## configs/us7032evb1/nsh/defconfig
```kconfig
# CONFIG_NSH_DISABLE_IFCONFIG is not set
# CONFIG_NSH_DISABLE_PS is not set
CONFIG_ARCH_BOARD_US7032EVB1=y
CONFIG_ARCH_BOARD="us7032evb1"
CONFIG_ARCH_BUTTONS=y
CONFIG_ARCH_CHIP_SH7032=y
CONFIG_ARCH_RENESAS=y
CONFIG_ARCH_STACKDUMP=y
CONFIG_ARCH="renesas"
CONFIG_BOARD_LOOPSPERMSEC=572
CONFIG_DISABLE_MOUNTPOINT=y
CONFIG_DISABLE_MQUEUE=y
CONFIG_DISABLE_POLL=y
CONFIG_DISABLE_POSIX_TIMERS=y
CONFIG_DISABLE_PTHREAD=y
CONFIG_DISABLE_SIGNALS=y
CONFIG_ENDIAN_BIG=y
CONFIG_SYSTEM_NSH=y
CONFIG_MAX_TASKS=8
CONFIG_MAX_WDOGPARMS=2
CONFIG_MOTOROLA_SREC=y
CONFIG_NFILE_DESCRIPTORS=8
CONFIG_NFILE_STREAMS=8
CONFIG_NOPRINTF_FIELDWIDTH=y
CONFIG_NSH_FILEIOSIZE=512
CONFIG_NSH_LINELEN=64
CONFIG_NSH_READLINE=y
CONFIG_NUNGET_CHARS=0
CONFIG_PREALLOC_TIMERS=0
CONFIG_PREALLOC_WDOGS=4
CONFIG_PTHREAD_STACK_DEFAULT=1024
CONFIG_RAM_SIZE=57344
CONFIG_RAM_START=0x0a002000
CONFIG_RAW_BINARY=y
CONFIG_SCI1_BAUD=9600
CONFIG_SCI1_SERIAL_CONSOLE=y
CONFIG_SDCLONE_DISABLE=y
CONFIG_SH1_SCI1=y
CONFIG_START_DAY=10
CONFIG_START_MONTH=11
CONFIG_START_YEAR=2008
CONFIG_STDIO_DISABLE_BUFFERING=y
CONFIG_TASK_NAME_SIZE=0
CONFIG_USER_ENTRYPOINT="nsh_main"
CONFIG_USERMAIN_STACKSIZE=1024
CONFIG_WDOG_INTRESERVE=0
```

## configs/viewtool-stm32f107/Kconfig
```kconfig
#
# For a description of the syntax of this configuration file,
# see the file kconfig-language.txt in the NuttX tools repository.
#

if ARCH_BOARD_VIEWTOOL_STM32F107

config VIEWTOOL_HIGHPRI
	bool "High priority interrupt test"
	default n
	depends on ARCH_CHIP_STM32F103VC && ARCH_HIPRI_INTERRUPT
	---help---
		This selection enables building of the custom test for the Cortex-M
		high priority, nested interrupts.  ARCH_HIPRI_INTERRUPT must first
		be enabled.  This test is only implemented on the STM32F103VCT6
		(ARCH_CHIP_STM32F103VC) but should be easily ported to other STM32
		architectures.

if VIEWTOOL_HIGHPRI

config VIEWTOOL_TIM6_FREQUENCY
	int "TIM6 Frequency"
	default 36000000
	---help---
		TIM6 is used to drive the high priority, nested interrupt in the
		test enabled with VIEWTOOL_HIGHPRI.  This setting specifies the
		frequency of the TIM6 input clock.

config VIEWTOOL_TIM6_PERIOD
	int "TIM6 Period"
	default 36000
	---help---
		TIM6 is used to drive the high priority, nested interrupt in the
		test enabled with VIEWTOOL_HIGHPRI.  This setting specifies
		period of the TIM6 interrupt in units of VIEWTOOL_TIM6_FREQUENCY.

endif # VIEWTOOL_HIGHPRI

if LCD_FT80X_SPI && ((STM32_SPI1 && !STM32_SPI1_REMAP) || STM32_SPI2)

choice
	prompt "FT80x SPI Selection"
	default VIEWTOOL_FT80X_SPI1 if STM32_SPI1 && !STM32_SPI1_REMAP
	default VIEWTOOL_FT80X_SPI2 if STM32_SPI2 && (!STM32_SPI1 || STM32_SPI1_REMAP)

config VIEWTOOL_FT80X_SPI1
	bool "FT80x on SPI1"
	depends on STM32_SPI1 && !STM32_SPI1_REMAP

config VIEWTOOL_FT80X_SPI2
	bool "FT80x on SPI2"
	depends on STM32_SPI3

endchoice # FT80x SPI Selection

config VIEWTOOL_FT80X_INITFREQUENCY
	int "FT80x initialization frequency"
	default 400000
	range 400000 11000000

config VIEWTOOL_FT80X_OPFREQUENCY
	int "FT80x initialization frequency"
	default 20000000
	range 400000 30000000

endif # LCD_FT80X_SPI && ((STM32_SPI1 && !STM32_SPI1_REMAP) || STM32_SPI2)
endif # ARCH_BOARD_VIEWTOOL_STM32F107
```

## configs/viewtool-stm32f107/ft80x/defconfig
```kconfig
# CONFIG_NSH_CMDOPT_HEXDUMP is not set
CONFIG_ARCH="arm"
CONFIG_ARCH_BOARD="viewtool-stm32f107"
CONFIG_ARCH_BOARD_VIEWTOOL_STM32F107=y
CONFIG_ARCH_BUTTONS=y
CONFIG_ARCH_CHIP_STM32=y
CONFIG_ARCH_CHIP_STM32F107VC=y
CONFIG_ARCH_STACKDUMP=y
CONFIG_BOARD_LOOPSPERMSEC=5483
CONFIG_BUILTIN=y
CONFIG_EXAMPLES_FT80X=y
CONFIG_FS_PROCFS=y
CONFIG_HOST_WINDOWS=y
CONFIG_INTELHEX_BINARY=y
CONFIG_LCD=y
CONFIG_LCD_FT80X=y
CONFIG_LCD_FT80X_AUDIO_GPIOSHUTDOWN=y
CONFIG_MAX_TASKS=16
CONFIG_MAX_WDOGPARMS=2
CONFIG_NFILE_DESCRIPTORS=8
CONFIG_NFILE_STREAMS=8
CONFIG_NSH_ARCHINIT=y
CONFIG_NSH_BUILTIN_APPS=y
CONFIG_NSH_READLINE=y
CONFIG_PREALLOC_MQ_MSGS=4
CONFIG_PREALLOC_TIMERS=4
CONFIG_PREALLOC_WDOGS=8
CONFIG_RAM_SIZE=65536
CONFIG_RAM_START=0x20000000
CONFIG_RR_INTERVAL=200
CONFIG_SCHED_HPWORKPRIORITY=192
CONFIG_SCHED_HPWORKSTACKSIZE=1024
CONFIG_SCHED_WAITPID=y
CONFIG_SDCLONE_DISABLE=y
CONFIG_START_DAY=24
CONFIG_START_MONTH=2
CONFIG_STM32_JTAG_FULL_ENABLE=y
CONFIG_STM32_PWR=y
CONFIG_STM32_SPI1=y
CONFIG_STM32_USART1=y
CONFIG_SYSTEM_NSH=y
CONFIG_USART1_SERIAL_CONSOLE=y
CONFIG_USER_ENTRYPOINT="nsh_main"
CONFIG_WDOG_INTRESERVE=0
```

## configs/z16f2800100zcog/pashello/defconfig
```kconfig
CONFIG_ARCH_BOARD_Z16F2800100ZCOG=y
CONFIG_ARCH_BOARD="z16f2800100zcog"
CONFIG_ARCH_CHIP_Z16F=y
CONFIG_ARCH_CHIP_Z16F2811=y
CONFIG_ARCH_Z16=y
CONFIG_ARCH="z16"
CONFIG_BOARD_LOOPSPERMSEC=1250
CONFIG_DEV_LOWCONSOLE=y
CONFIG_DISABLE_POLL=y
CONFIG_ENDIAN_BIG=y
CONFIG_EXAMPLES_PASHELLO=y
CONFIG_HOST_WINDOWS=y
CONFIG_IDLETHREAD_STACKSIZE=4096
CONFIG_INTERPRETERS_PCODE=y
CONFIG_MAX_TASKS=16
CONFIG_MAX_WDOGPARMS=2
CONFIG_NFILE_DESCRIPTORS=8
CONFIG_NFILE_STREAMS=8
CONFIG_NOPRINTF_FIELDWIDTH=y
CONFIG_PREALLOC_MQ_MSGS=4
CONFIG_PREALLOC_TIMERS=4
CONFIG_PREALLOC_WDOGS=4
CONFIG_PTHREAD_STACK_DEFAULT=4096
CONFIG_RAM_SIZE=65536
CONFIG_RR_INTERVAL=200
CONFIG_SDCLONE_DISABLE=y
CONFIG_START_DAY=28
CONFIG_START_YEAR=2008
CONFIG_SYSTEM_PRUN=y
CONFIG_TASK_NAME_SIZE=0
CONFIG_UART0_BAUD=57600
CONFIG_UART0_SERIAL_CONSOLE=y
CONFIG_UART1_BAUD=57600
CONFIG_USER_ENTRYPOINT="pashello_main"
CONFIG_USERMAIN_STACKSIZE=4096
CONFIG_WDOG_INTRESERVE=0
```

## configs/z80sim/ostest/defconfig
```kconfig
# CONFIG_DEV_CONSOLE is not set
CONFIG_ARCH_BOARD_Z80SIM=y
CONFIG_ARCH_BOARD="z80sim"
CONFIG_ARCH_CHIP_Z80=y
CONFIG_ARCH_Z80=y
CONFIG_ARCH="z80"
CONFIG_BOARD_LOOPSPERMSEC=100
CONFIG_DEFAULT_SMALL=y
CONFIG_DISABLE_MOUNTPOINT=y
CONFIG_DISABLE_MQUEUE=y
CONFIG_DISABLE_POLL=y
CONFIG_DISABLE_PTHREAD=y
CONFIG_EXAMPLES_OSTEST_NBARRIER_THREADS=4
CONFIG_EXAMPLES_OSTEST_STACKSIZE=1024
CONFIG_EXAMPLES_OSTEST=y
CONFIG_MAX_TASKS=8
CONFIG_MAX_WDOGPARMS=2
CONFIG_NFILE_DESCRIPTORS=0
CONFIG_NFILE_STREAMS=0
CONFIG_NOPRINTF_FIELDWIDTH=y
CONFIG_NUNGET_CHARS=0
CONFIG_PREALLOC_TIMERS=0
CONFIG_PREALLOC_WDOGS=4
CONFIG_PTHREAD_STACK_DEFAULT=1024
CONFIG_RAM_SIZE=65536
CONFIG_RAM_START=0x0000
CONFIG_SDCLONE_DISABLE=y
CONFIG_START_DAY=21
CONFIG_START_MONTH=2
CONFIG_START_YEAR=2007
CONFIG_STDIO_DISABLE_BUFFERING=y
CONFIG_TASK_NAME_SIZE=0
CONFIG_UART_RXBUFSIZE=64
CONFIG_UART_SERIAL_CONSOLE=y
CONFIG_UART_TXBUFSIZE=64
CONFIG_USER_ENTRYPOINT="ostest_main"
CONFIG_USERMAIN_STACKSIZE=1024
CONFIG_WDOG_INTRESERVE=0
```

## configs/z8f64200100kit/ostest/defconfig
```kconfig
# CONFIG_ARCH_LEDS is not set
CONFIG_ARCH_BOARD_Z8F64200100KIT=y
CONFIG_ARCH_BOARD="z8f64200100kit"
CONFIG_ARCH_CHIP_Z8=y
CONFIG_ARCH_CHIP_Z8F6423=y
CONFIG_ARCH_CHIP_Z8F642X=y
CONFIG_ARCH_Z80=y
CONFIG_ARCH="z80"
CONFIG_BOARD_LOOPSPERMSEC=1250
CONFIG_DEFAULT_SMALL=y
CONFIG_DISABLE_MOUNTPOINT=y
CONFIG_DISABLE_MQUEUE=y
CONFIG_DISABLE_POLL=y
CONFIG_DISABLE_PTHREAD=y
CONFIG_EXAMPLES_OSTEST_STACKSIZE=256
CONFIG_EXAMPLES_OSTEST=y
CONFIG_HOST_WINDOWS=y
CONFIG_IDLETHREAD_STACKSIZE=256
CONFIG_MAX_TASKS=8
CONFIG_MAX_WDOGPARMS=2
CONFIG_NFILE_DESCRIPTORS=0
CONFIG_NFILE_STREAMS=0
CONFIG_NOPRINTF_FIELDWIDTH=y
CONFIG_NUNGET_CHARS=0
CONFIG_PREALLOC_TIMERS=0
CONFIG_PREALLOC_WDOGS=4
CONFIG_PTHREAD_STACK_DEFAULT=256
CONFIG_PTHREAD_STACK_MIN=128
CONFIG_RAM_SIZE=65536
CONFIG_SDCLONE_DISABLE=y
CONFIG_START_DAY=17
CONFIG_START_MONTH=2
CONFIG_START_YEAR=2008
CONFIG_STDIO_DISABLE_BUFFERING=y
CONFIG_TASK_NAME_SIZE=0
CONFIG_UART0_BAUD=57600
CONFIG_UART0_RXBUFSIZE=0
CONFIG_UART0_SERIAL_CONSOLE=y
CONFIG_UART0_TXBUFSIZE=0
CONFIG_UART1_BAUD=57600
CONFIG_UART1_RXBUFSIZE=0
CONFIG_UART1_TXBUFSIZE=0
CONFIG_USER_ENTRYPOINT="ostest_main"
CONFIG_USERMAIN_STACKSIZE=256
CONFIG_WDOG_INTRESERVE=0
CONFIG_Z8_ZDSII_V522=y
```
