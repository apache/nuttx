## configs/sure-pic32mx/nsh/defconfig
```kconfig
# CONFIG_ARCH_RAMFUNCS is not set
# CONFIG_NSH_DISABLE_IFCONFIG is not set
# CONFIG_NSH_DISABLE_PS is not set
CONFIG_ARCH="mips"
CONFIG_ARCH_BOARD="sure-pic32mx"
CONFIG_ARCH_BOARD_SUREPIC32MX=y
CONFIG_ARCH_CHIP_PIC32MX440F512H=y
CONFIG_ARCH_CHIP_PIC32MX4=y
CONFIG_ARCH_CHIP_PIC32MX=y
CONFIG_ARCH_MIPS=y
CONFIG_ARCH_STACKDUMP=y
CONFIG_BOARD_LOOPSPERMSEC=5580
CONFIG_BUILTIN=y
CONFIG_DISABLE_POLL=y
CONFIG_HOST_WINDOWS=y
CONFIG_IDLETHREAD_STACKSIZE=2048
CONFIG_INTELHEX_BINARY=y
CONFIG_MAX_TASKS=16
CONFIG_MAX_WDOGPARMS=2
CONFIG_NFILE_DESCRIPTORS=8
CONFIG_NFILE_STREAMS=8
CONFIG_NSH_ARCHINIT=y
CONFIG_NSH_BUILTIN_APPS=y
CONFIG_NSH_FILEIOSIZE=512
CONFIG_NSH_LINELEN=64
CONFIG_NSH_READLINE=y
CONFIG_PIC32MX_DEBUGGER=2
CONFIG_PIC32MX_UART2=y
CONFIG_PREALLOC_MQ_MSGS=4
CONFIG_PREALLOC_TIMERS=4
CONFIG_PREALLOC_WDOGS=4
CONFIG_RAM_SIZE=32768
CONFIG_RAM_START=0xa0000000
CONFIG_SCHED_WAITPID=y
CONFIG_SDCLONE_DISABLE=y
CONFIG_START_DAY=22
CONFIG_START_MONTH=12
CONFIG_START_YEAR=2011
CONFIG_SYSTEM_NSH=y
CONFIG_TASK_NAME_SIZE=0
CONFIG_UART2_RXBUFSIZE=64
CONFIG_UART2_SERIAL_CONSOLE=y
CONFIG_UART2_TXBUFSIZE=64
CONFIG_USER_ENTRYPOINT="nsh_main"
CONFIG_WDOG_INTRESERVE=0
```

## configs/teensy-2.0/hello/defconfig
```kconfig
CONFIG_ARCH="avr"
CONFIG_ARCH_AVR=y
CONFIG_ARCH_BOARD="teensy-2.0"
CONFIG_ARCH_BOARD_TEENSY_20=y
CONFIG_ARCH_CHIP_AT90USB1286=y
CONFIG_ARCH_CHIP_AT90USB=y
CONFIG_ARCH_STACKDUMP=y
CONFIG_AVR_BUILDROOT_TOOLCHAIN=y
CONFIG_AVR_USART1=y
CONFIG_BOARD_LOOPSPERMSEC=864
CONFIG_DEFAULT_SMALL=y
CONFIG_DEV_LOWCONSOLE=y
CONFIG_DISABLE_MOUNTPOINT=y
CONFIG_DISABLE_MQUEUE=y
CONFIG_DISABLE_POLL=y
CONFIG_DISABLE_PTHREAD=y
CONFIG_DISABLE_SIGNALS=y
CONFIG_EXAMPLES_HELLO=y
CONFIG_HOST_WINDOWS=y
CONFIG_IDLETHREAD_STACKSIZE=512
CONFIG_INTELHEX_BINARY=y
CONFIG_MAX_TASKS=4
CONFIG_MAX_WDOGPARMS=2
CONFIG_NFILE_DESCRIPTORS=4
CONFIG_NFILE_STREAMS=4
CONFIG_NUNGET_CHARS=0
CONFIG_PREALLOC_TIMERS=0
CONFIG_PREALLOC_WDOGS=4
CONFIG_PTHREAD_STACK_DEFAULT=1024
CONFIG_RAM_SIZE=8192
CONFIG_RAM_START=0x800100
CONFIG_SDCLONE_DISABLE=y
CONFIG_START_DAY=16
CONFIG_START_MONTH=6
CONFIG_START_YEAR=2011
CONFIG_STDIO_DISABLE_BUFFERING=y
CONFIG_TASK_NAME_SIZE=0
CONFIG_USART1_BAUD=38400
CONFIG_USART1_SERIAL_CONSOLE=y
CONFIG_USERMAIN_STACKSIZE=512
CONFIG_USER_ENTRYPOINT="hello_main"
CONFIG_WDOG_INTRESERVE=0
```

## configs/teensy-2.0/usbmsc/defconfig
```kconfig
# CONFIG_SPI_EXCHANGE is not set
CONFIG_ARCH="avr"
CONFIG_ARCH_AVR=y
CONFIG_ARCH_BOARD="teensy-2.0"
CONFIG_ARCH_BOARD_TEENSY_20=y
CONFIG_ARCH_CHIP_AT90USB1286=y
CONFIG_ARCH_CHIP_AT90USB=y
CONFIG_ARCH_STACKDUMP=y
CONFIG_AVR_BUILDROOT_TOOLCHAIN=y
CONFIG_AVR_SPI=y
CONFIG_AVR_USART1=y
CONFIG_AVR_USBDEV=y
CONFIG_BOARD_LOOPSPERMSEC=864
CONFIG_DEFAULT_SMALL=y
CONFIG_DEV_LOWCONSOLE=y
CONFIG_DISABLE_MQUEUE=y
CONFIG_DISABLE_POLL=y
CONFIG_HOST_WINDOWS=y
CONFIG_IDLETHREAD_STACKSIZE=512
CONFIG_INTELHEX_BINARY=y
CONFIG_LIB_BOARDCTL=y
CONFIG_MAX_TASKS=8
CONFIG_MAX_WDOGPARMS=2
CONFIG_MMCSD=y
CONFIG_MMCSD_SPICLOCK=12500000
CONFIG_NFILE_DESCRIPTORS=6
CONFIG_NFILE_STREAMS=6
CONFIG_NOPRINTF_FIELDWIDTH=y
CONFIG_NPTHREAD_KEYS=0
CONFIG_NUNGET_CHARS=0
CONFIG_PREALLOC_TIMERS=0
CONFIG_PREALLOC_WDOGS=6
CONFIG_PTHREAD_STACK_DEFAULT=512
CONFIG_RAM_SIZE=8192
CONFIG_RAM_START=0x800100
CONFIG_RR_INTERVAL=200
CONFIG_SDCLONE_DISABLE=y
CONFIG_SPI=y
CONFIG_START_DAY=2
CONFIG_START_MONTH=7
CONFIG_START_YEAR=2011
CONFIG_STDIO_DISABLE_BUFFERING=y
CONFIG_SYSTEM_USBMSC=y
CONFIG_TASK_NAME_SIZE=0
CONFIG_USART1_BAUD=38400
CONFIG_USART1_SERIAL_CONSOLE=y
CONFIG_USBDEV=y
CONFIG_USBMSC=y
CONFIG_USBMSC_BULKINREQLEN=256
CONFIG_USBMSC_EP0MAXPACKET=8
CONFIG_USBMSC_EPBULKIN=2
CONFIG_USBMSC_EPBULKOUT=1
CONFIG_USBMSC_NRDREQS=2
CONFIG_USBMSC_NWRREQS=2
CONFIG_USBMSC_PRODUCTSTR="USBdev Storage"
CONFIG_USBMSC_REMOVABLE=y
CONFIG_USBMSC_SCSI_STACKSIZE=512
CONFIG_USBMSC_VERSIONNO=0x0399
CONFIG_USERMAIN_STACKSIZE=512
CONFIG_USER_ENTRYPOINT="msconn_main"
CONFIG_WDOG_INTRESERVE=0
```

## configs/teensy-3.x/Kconfig
```kconfig
#
# For a description of the syntax of this configuration file,
# see the file kconfig-language.txt in the NuttX tools repository.
#

if ARCH_BOARD_TEENSY_3X

config TEENSY_3X_OVERCLOCK
	bool "Overclock"
	default n

endif
```

## configs/teensy-lc/nsh/defconfig
```kconfig
# CONFIG_DISABLE_POSIX_TIMERS is not set
# CONFIG_NSH_DISABLEBG is not set
# CONFIG_NSH_DISABLE_CMP is not set
# CONFIG_NSH_DISABLE_EXEC is not set
# CONFIG_NSH_DISABLE_EXIT is not set
# CONFIG_NSH_DISABLE_HEXDUMP is not set
# CONFIG_NSH_DISABLE_PS is not set
# CONFIG_NSH_DISABLE_XD is not set
CONFIG_ARCH="arm"
CONFIG_ARCH_BOARD="teensy-lc"
CONFIG_ARCH_BOARD_TEENSY_LC=y
CONFIG_ARCH_CHIP_KL=y
CONFIG_ARCH_CHIP_MKL25Z64=y
CONFIG_ARCH_STACKDUMP=y
CONFIG_BOARD_LOOPSPERMSEC=2988
CONFIG_BUILTIN=y
CONFIG_C99_BOOL8=y
CONFIG_DEBUG_CUSTOMOPT=y
CONFIG_DEBUG_OPTLEVEL="-Os"
CONFIG_DEBUG_SYMBOLS=y
CONFIG_DEFAULT_SMALL=y
CONFIG_DISABLE_MOUNTPOINT=y
CONFIG_DISABLE_MQUEUE=y
CONFIG_DISABLE_POLL=y
CONFIG_HAVE_CXX=y
CONFIG_HAVE_CXXINITIALIZE=y
CONFIG_INTELHEX_BINARY=y
CONFIG_KL_I2C0=y
CONFIG_KL_I2C1=y
CONFIG_KL_SPI0=y
CONFIG_KL_SPI1=y
CONFIG_KL_TPM0=y
CONFIG_KL_TPM0_PWM=y
CONFIG_KL_TPM1=y
CONFIG_KL_TPM1_PWM=y
CONFIG_KL_TPM2=y
CONFIG_KL_TPM2_PWM=y
CONFIG_KL_UART0=y
CONFIG_LIB_BOARDCTL=y
CONFIG_MAX_TASKS=8
CONFIG_MAX_WDOGPARMS=2
CONFIG_MM_SMALL=y
CONFIG_NFILE_DESCRIPTORS=6
CONFIG_NFILE_STREAMS=6
CONFIG_NPTHREAD_KEYS=0
CONFIG_NSH_BUILTIN_APPS=y
CONFIG_NSH_DISABLE_CD=y
CONFIG_NSH_DISABLE_CP=y
CONFIG_NSH_DISABLE_MKDIR=y
CONFIG_NSH_DISABLE_MOUNT=y
CONFIG_NSH_DISABLE_RM=y
CONFIG_NSH_DISABLE_RMDIR=y
CONFIG_NSH_DISABLE_UMOUNT=y
CONFIG_NSH_FILEIOSIZE=64
CONFIG_NSH_LINELEN=80
CONFIG_NUNGET_CHARS=0
CONFIG_PREALLOC_TIMERS=0
CONFIG_PREALLOC_WDOGS=4
CONFIG_PTHREAD_STACK_DEFAULT=1536
CONFIG_PWM=y
CONFIG_RAM_SIZE=8192
CONFIG_RAM_START=0x1FFFF800
CONFIG_RR_INTERVAL=200
CONFIG_SCHED_WAITPID=y
CONFIG_SDCLONE_DISABLE=y
CONFIG_STACK_COLORATION=y
CONFIG_START_YEAR=2015
CONFIG_STDIO_DISABLE_BUFFERING=y
CONFIG_SYSTEM_NSH=y
CONFIG_TASK_NAME_SIZE=0
CONFIG_TASK_SPAWN_DEFAULT_STACKSIZE=1536
CONFIG_UART0_SERIAL_CONSOLE=y
CONFIG_USERMAIN_STACKSIZE=1536
CONFIG_USER_ENTRYPOINT="nsh_main"
CONFIG_WDOG_INTRESERVE=0
```

## configs/tm4c123g-launchpad/Kconfig
```kconfig
#
# For a description of the syntax of this configuration file,
# see the file kconfig-language.txt in the NuttX tools repository.
#

if ARCH_BOARD_TM4C123G_LAUNCHPAD

config TM4C123G_LAUNCHPAD_AT24_BLOCKMOUNT
	bool "AT24 Serial EEPROM auto-mount"
	default n
	depends on NSH_ARCHINIT && TIVA_I2C0 && MTD_AT24XX
	---help---
		Automatically initialize the AT24 SPI EEPROM driver when NSH starts.

		The Serial EEPROM was mounted on an external adaptor board and
		connected to the LaunchPad thusly:

		- VCC -- VCC
		- GND -- GND
		- PB2 -- SCL
		- PB3  -- SDA

choice
	prompt "AT24 serial EPPROM configuration"
	default TM4C123G_LAUNCHPAD_AT24_FTL
	depends on TM4C123G_LAUNCHPAD_AT24_BLOCKMOUNT

config TM4C123G_LAUNCHPAD_AT24_FTL
	bool "Create AT24 block driver"
	---help---
		Create the MTD driver for the AT24 and "wrap" the AT24 as a standard
		block driver that could then, for example, be mounted using FAT or
		any other file system.  Any file system may be used, but there will
		be no wear-leveling.

config TM4C123G_LAUNCHPAD_AT24_NXFFS
	bool "Create AT24 NXFFS file system"
	depends on FS_NXFFS
	---help---
		Create the MTD driver for the AT24 and mount the AT24 device as
		a wear-leveling, NuttX FLASH file system (NXFFS).  The downside of
		NXFFS is that it can be very slow.

endchoice # AT24 serial EPPROM configuration

endif
```

## configs/tm4c1294-launchpad/Kconfig
```kconfig
#
# For a description of the syntax of this configuration file,
# see the file kconfig-language.txt in the NuttX tools repository.
#

if ARCH_BOARD_TM4C1294_LAUNCHPAD
if TIMER && TIVA_TIMER32_PERIODIC

config TM4C1294_LAUNCHPAD_TIMER
	bool
	default n

choice
	prompt "Timer driver selection"
	default TM4C1294_LAUNCHPAD_TIMER_NONE

config TM4C1294_LAUNCHPAD_TIMER_NONE
	bool "None"

config TM4C1294_LAUNCHPAD_TIMER0
	bool "Timer 0"
	depends on TIVA_TIMER0
	select TM4C1294_LAUNCHPAD_TIMER

config TM4C1294_LAUNCHPAD_TIMER1
	bool "Timer 1"
	depends on TIVA_TIMER1
	select TM4C1294_LAUNCHPAD_TIMER

config TM4C1294_LAUNCHPAD_TIMER2
	bool "Timer 2"
	depends on TIVA_TIMER2
	select TM4C1294_LAUNCHPAD_TIMER

config TM4C1294_LAUNCHPAD_TIMER3
	bool "Timer 3"
	depends on TIVA_TIMER3
	select TM4C1294_LAUNCHPAD_TIMER

config TM4C1294_LAUNCHPAD_TIMER4
	bool "Timer 4"
	depends on TIVA_TIMER4
	select TM4C1294_LAUNCHPAD_TIMER

config TM4C1294_LAUNCHPAD_TIMER5
	bool "Timer 5"
	depends on TIVA_TIMER5
	select TM4C1294_LAUNCHPAD_TIMER

config TM4C1294_LAUNCHPAD_TIMER6
	bool "Timer 6"
	depends on TIVA_TIMER6
	select TM4C1294_LAUNCHPAD_TIMER

config TM4C1294_LAUNCHPAD_TIMER7
	bool "Timer 7"
	depends on TIVA_TIMER7
	select TM4C1294_LAUNCHPAD_TIMER

endchoice # Timer driver selection

if TM4C1294_LAUNCHPAD_TIMER

config TM4C1294_LAUNCHPAD_TIMER_DEVNAME
	string "Timer device name"
	default "/dev/timer0"

config TM4C1294_LAUNCHPAD_TIMER_ALTCLK
	bool "Use alternate clock source"
	default n
	depends on EXPERIMENTAL

endif # TM4C1294_LAUNCHPAD_TIMER
endif # TIVA_TIMER32_PERIODIC
endif # ARCH_BOARD_TM4C1294_LAUNCHPAD
```

## configs/tm4c1294-launchpad/nsh/defconfig
```kconfig
# CONFIG_ARCH_FPU is not set
# CONFIG_NSH_DISABLE_IFCONFIG is not set
# CONFIG_NSH_DISABLE_PS is not set
CONFIG_ARCH="arm"
CONFIG_ARCH_BOARD="tm4c1294-launchpad"
CONFIG_ARCH_BOARD_TM4C1294_LAUNCHPAD=y
CONFIG_ARCH_CHIP_TIVA=y
CONFIG_ARCH_CHIP_TM4C1294NC=y
CONFIG_ARCH_CHIP_TM4C129=y
CONFIG_ARCH_CHIP_TM4C=y
CONFIG_ARCH_STACKDUMP=y
CONFIG_BOARD_LOOPSPERMSEC=11401
CONFIG_BUILTIN=y
CONFIG_I2C=y
CONFIG_I2CTOOL_MAXBUS=6
CONFIG_I2CTOOL_MINBUS=6
CONFIG_LIBC_FLOATINGPOINT=y
CONFIG_LIBM=y
CONFIG_MAX_TASKS=16
CONFIG_MAX_WDOGPARMS=2
CONFIG_NET=y
CONFIG_NETDB_DNSCLIENT=y
CONFIG_NETDB_DNSSERVER_NOADDR=y
CONFIG_NETUTILS_TELNETD=y
CONFIG_NETUTILS_TFTPC=y
CONFIG_NETUTILS_WEBCLIENT=y
CONFIG_NET_ARP_IPIN=y
CONFIG_NET_ARP_SEND=y
CONFIG_NET_BROADCAST=y
CONFIG_NET_ICMP=y
CONFIG_NET_ICMP_SOCKET=y
CONFIG_NET_SOCKOPTS=y
CONFIG_NET_SOLINGER=y
CONFIG_NET_STATISTICS=y
CONFIG_NET_TCP=y
CONFIG_NET_TCPBACKLOG=y
CONFIG_NET_TCP_WRITE_BUFFERS=y
CONFIG_NET_UDP=y
CONFIG_NFILE_DESCRIPTORS=8
CONFIG_NFILE_STREAMS=8
CONFIG_NSH_ARCHINIT=y
CONFIG_NSH_BUILTIN_APPS=y
CONFIG_NSH_FILEIOSIZE=512
CONFIG_NSH_LINELEN=64
CONFIG_NSH_NETINIT_MONITOR=y
CONFIG_NSH_NETINIT_THREAD=y
CONFIG_NSH_READLINE=y
CONFIG_PREALLOC_MQ_MSGS=4
CONFIG_PREALLOC_TIMERS=4
CONFIG_PREALLOC_WDOGS=4
CONFIG_RAM_SIZE=262144
CONFIG_RAM_START=0x20000000
CONFIG_RAW_BINARY=y
CONFIG_RR_INTERVAL=200
CONFIG_SCHED_HPWORK=y
CONFIG_SCHED_WAITPID=y
CONFIG_START_YEAR=2015
CONFIG_SYSTEM_I2CTOOL=y
CONFIG_SYSTEM_NSH=y
CONFIG_SYSTEM_PING=y
CONFIG_TIVA_BOARDMAC=y
CONFIG_TIVA_ETHERNET=y
CONFIG_TIVA_I2C0=y
CONFIG_TIVA_PHY_INTERRUPTS=y
CONFIG_TIVA_UART0=y
CONFIG_UART0_SERIAL_CONSOLE=y
CONFIG_USER_ENTRYPOINT="nsh_main"
CONFIG_WDOG_INTRESERVE=0
```

## configs/tms570ls31x-usb-kit/nsh/defconfig
```kconfig
# CONFIG_ARCH_RAMFUNCS is not set
CONFIG_ARCH_BOARD_TMS570LS31X_USB_KIT=y
CONFIG_ARCH_BOARD="tms570ls31x-usb-kit"
CONFIG_ARCH_BUTTONS=y
CONFIG_ARCH_CHIP_TMS570=y
CONFIG_ARCH_CHIP_TMS570LS3137ZWT=y
CONFIG_ARCH_INTERRUPTSTACK=2048
CONFIG_ARCH_IRQBUTTONS=y
CONFIG_ARCH_LOWVECTORS=y
CONFIG_ARCH_STACKDUMP=y
CONFIG_ARCH="arm"
CONFIG_BUILTIN=y
CONFIG_DISABLE_POLL=y
CONFIG_ELF=y
CONFIG_SYSTEM_NSH=y
CONFIG_FAT_LCNAMES=y
CONFIG_FAT_LFN=y
CONFIG_FS_FAT=y
CONFIG_FS_PROCFS=y
CONFIG_I2C=y
CONFIG_INTELHEX_BINARY=y
CONFIG_MAX_TASKS=16
CONFIG_MAX_WDOGPARMS=2
CONFIG_NFILE_DESCRIPTORS=8
CONFIG_NFILE_STREAMS=8
CONFIG_NSH_ARCHINIT=y
CONFIG_NSH_BUILTIN_APPS=y
CONFIG_NSH_FILEIOSIZE=512
CONFIG_NSH_LINELEN=64
CONFIG_NSH_READLINE=y
CONFIG_PREALLOC_MQ_MSGS=4
CONFIG_PREALLOC_TIMERS=4
CONFIG_RAM_SIZE=262143
CONFIG_RAM_START=0x08000000
CONFIG_RAW_BINARY=y
CONFIG_RR_INTERVAL=200
CONFIG_SCHED_HPWORK=y
CONFIG_SCHED_WAITPID=y
CONFIG_SCI1_2STOP=1
CONFIG_SCI1_BAUD=9600
CONFIG_SCI1_SERIAL_CONSOLE=y
CONFIG_SDCLONE_DISABLE=y
CONFIG_SPI=y
CONFIG_START_DAY=10
CONFIG_START_MONTH=3
CONFIG_START_YEAR=2014
CONFIG_SYSTEM_RAMTEST=y
CONFIG_TMS570_GIO_IRQ=y
CONFIG_TMS570_SCI1=y
CONFIG_USER_ENTRYPOINT="nsh_main"
```
