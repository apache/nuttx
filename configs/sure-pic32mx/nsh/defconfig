## configs/zkit-arm-1769/thttpd/defconfig
```kconfig
CONFIG_ARCH="arm"
CONFIG_ARCH_BOARD="zkit-arm-1769"
CONFIG_ARCH_BOARD_ZKITARM=y
CONFIG_ARCH_CHIP_LPC1768=y
CONFIG_ARCH_CHIP_LPC17XX=y
CONFIG_ARCH_STACKDUMP=y
CONFIG_ARMV7M_OABI_TOOLCHAIN=y
CONFIG_ARMV7M_TOOLCHAIN_BUILDROOT=y
CONFIG_BOARD_LOOPSPERMSEC=8079
CONFIG_DEV_LOWCONSOLE=y
CONFIG_DISABLE_MQUEUE=y
CONFIG_DISABLE_POSIX_TIMERS=y
CONFIG_DISABLE_PTHREAD=y
CONFIG_ETH0_PHY_DP83848C=y
CONFIG_EXAMPLES_THTTPD=y
CONFIG_EXAMPLES_THTTPD_DRIPADDR=0xac100002
CONFIG_EXAMPLES_THTTPD_NOMAC=y
CONFIG_FS_ROMFS=y
CONFIG_INTELHEX_BINARY=y
CONFIG_LPC17_ETHERNET=y
CONFIG_LPC17_ETH_NRXDESC=18
CONFIG_LPC17_ETH_NTXDESC=18
CONFIG_LPC17_PHY_AUTONEG=y
CONFIG_LPC17_UART0=y
CONFIG_MAX_TASKS=16
CONFIG_MAX_WDOGPARMS=2
CONFIG_MM_REGIONS=2
CONFIG_NET=y
CONFIG_NETUTILS_NETLIB=y
CONFIG_NETUTILS_THTTPD=y
CONFIG_NET_ICMP=y
CONFIG_NET_MAX_LISTENPORTS=8
CONFIG_NET_SOCKOPTS=y
CONFIG_NET_TCP=y
CONFIG_NET_TCPBACKLOG=y
CONFIG_NET_TCP_CONNS=16
CONFIG_NFILE_DESCRIPTORS=8
CONFIG_NFILE_STREAMS=8
CONFIG_NSOCKET_DESCRIPTORS=16
CONFIG_NUNGET_CHARS=0
CONFIG_NXFLAT=y
CONFIG_PIPES=y
CONFIG_PREALLOC_WDOGS=8
CONFIG_RAM_SIZE=32768
CONFIG_RAM_START=0x10000000
CONFIG_RR_INTERVAL=200
CONFIG_SCHED_HPWORK=y
CONFIG_START_DAY=26
CONFIG_START_MONTH=2
CONFIG_START_YEAR=2013
CONFIG_SYMTAB_ORDEREDBYNAME=y
CONFIG_TASK_NAME_SIZE=0
CONFIG_THTTPD_CGI_BYTECOUNT=20000
CONFIG_THTTPD_CGI_PRIORITY=50
CONFIG_THTTPD_CGI_STACKSIZE=1024
CONFIG_THTTPD_IOBUFFERSIZE=1024
CONFIG_THTTPD_IPADDR=0xac100064
CONFIG_UART0_SERIAL_CONSOLE=y
CONFIG_USERMAIN_STACKSIZE=8192
CONFIG_USER_ENTRYPOINT="thttp_main"
CONFIG_WDOG_INTRESERVE=1
```

## crypto/Kconfig
```kconfig
#
# For a description of the syntax of this configuration file,
# see the file kconfig-language.txt in the NuttX tools repository.
#

config CRYPTO
	bool "Crypto API support"
	default n
	---help---
		Enable or disable Crypto API features

if CRYPTO

config CRYPTO_AES
	bool "AES cypher support"
	default n

config CRYPTO_ALGTEST
	bool "Perform automatic crypto algorithms test on startup"
	default n

if CRYPTO_ALGTEST

config CRYPTO_AES128_DISABLE
	bool "Omit 128-bit AES tests"
	default n

config CRYPTO_AES192_DISABLE
	bool "Omit 192-bit AES tests"
	default n

config CRYPTO_AES256_DISABLE
	bool "Omit 256-bit AES tests"
	default n

endif # CRYPTO_ALGTEST

config CRYPTO_CRYPTODEV
	bool "cryptodev support"
	default n

config CRYPTO_SW_AES
	bool "Software AES library"
	default n
	---help---
		Enable the software AES library as described in
		include/nuttx/crypto/aes.h

		TODO: Adapt interfaces so that they are consistent with H/W AES
		implementations.  This needs to support up_aesinitialize() and
		aes_cypher() per include/nuttx/crypto/crypto.h.

config CRYPTO_BLAKE2S
	bool "BLAKE2s hash algorithm"
	default n
	---help---
		Enable the BLAKE2s hash algorithm

config CRYPTO_RANDOM_POOL
	bool "Entropy pool and strong randon number generator"
	default n
	select CRYPTO_BLAKE2S
	---help---
		Entropy pool gathers environmental noise from device drivers,
		user-space, etc., and returns good random numbers, suitable
		for cryptographic use. Based on entropy pool design from
		*BSDs and uses BLAKE2Xs algorithm for CSPRNG output.

		NOTE: May not actually be cyptographically secure, if
		not enough entropy is made available to the entropy pool.

if CRYPTO_RANDOM_POOL

config CRYPTO_RANDOM_POOL_COLLECT_IRQ_RANDOMNESS
	bool "Use interrupts to feed timing randomness to entropy pool"
	default y
	---help---
		Feed entropy pool with interrupt randomness from interrupt
		dispatch function 'irq_dispatch'. This adds some overhead
		for every interrupt handled.

endif # CRYPTO_RANDOM_POOL

endif # CRYPTO
```

## drivers/1wire/Kconfig
```kconfig
#
# For a description of the syntax of this configuration file,
# see the file kconfig-language.txt in the NuttX tools repository.
#

menuconfig 1WIRE
	bool "1wire Device Support"
	default n
	---help---
		Drivers for various 1wire devices.

if 1WIRE

config 1WIRE_DS28E17
	bool "DS28E17 1-wire to I2C converter"
	default n
	depends on I2C
	---help---
		Enable support for the Maxim DS28E17 1-wire to I2C converter

config 1WIRE_EE_DS2XXX
	bool "Support for Maxim/Analog Devices 1wire DS2XXX EEPROM devices"
	default n
	depends on 1WIRE
	---help---
		Enable support for 1WIRE DS2XXX EEPROMs.
		The list of supported devices:
		DS2430:   32 bytes, 1 page
		DS2431:   128 bytes, 4 pages
		DS2432:   128 bytes, 4 pages
		DS2433:   512 bytes, 16 pages
		DS28E04:  512 bytes, 16 pages
		DS28E07:  128 bytes, 4 pages
		DS28EC20: 2560 bytes, 32 pages

if 1WIRE_EE_DS2XXX

config 1WIRE_EE_DS2XXX_MEMSONBUS
	int "Maximum number of DS2XXX eeproms on the same bus"
	default 10

endif # 1WIRE_EE_DS2XXX

endif # 1WIRE
```
