## configs/photon/usbnsh/defconfig
```kconfig
# CONFIG_DEV_CONSOLE is not set
# CONFIG_NSH_ARGCAT is not set
# CONFIG_NSH_CMDOPT_HEXDUMP is not set
# CONFIG_NSH_CMDPARMS is not set
CONFIG_ARCH="arm"
CONFIG_ARCH_BOARD="photon"
CONFIG_ARCH_BOARD_PHOTON=y
CONFIG_ARCH_CHIP_STM32=y
CONFIG_ARCH_CHIP_STM32F205RG=y
CONFIG_ARCH_STACKDUMP=y
CONFIG_BOARDCTL_USBDEVCTRL=y
CONFIG_BOARD_LOOPSPERMSEC=16717
CONFIG_BUILTIN=y
CONFIG_CDCACM=y
CONFIG_CDCACM_CONSOLE=y
CONFIG_DISABLE_POLL=y
CONFIG_SYSTEM_NSH=y
CONFIG_FS_PROCFS=y
CONFIG_HAVE_CXX=y
CONFIG_HAVE_CXXINITIALIZE=y
CONFIG_INTELHEX_BINARY=y
CONFIG_MAX_TASKS=16
CONFIG_MAX_WDOGPARMS=2
CONFIG_MM_REGIONS=2
CONFIG_NFILE_DESCRIPTORS=8
CONFIG_NFILE_STREAMS=8
CONFIG_NSH_ARCHINIT=y
CONFIG_NSH_BUILTIN_APPS=y
CONFIG_NSH_FILEIOSIZE=512
CONFIG_NSH_LINELEN=64
CONFIG_NSH_READLINE=y
CONFIG_PHOTON_DFU_BOOTLOADER=y
CONFIG_PHOTON_IWDG=y
CONFIG_PHOTON_WDG_THREAD=y
CONFIG_PREALLOC_MQ_MSGS=4
CONFIG_PREALLOC_TIMERS=4
CONFIG_PREALLOC_WDOGS=16
CONFIG_RAM_SIZE=114688
CONFIG_RAM_START=0x20000000
CONFIG_RAW_BINARY=y
CONFIG_RR_INTERVAL=200
CONFIG_SCHED_WAITPID=y
CONFIG_SDCLONE_DISABLE=y
CONFIG_START_DAY=6
CONFIG_START_MONTH=12
CONFIG_START_YEAR=2011
CONFIG_STM32_IWDG=y
CONFIG_STM32_JTAG_SW_ENABLE=y
CONFIG_STM32_OTGHS=y
CONFIG_STM32_USART1=y
CONFIG_SYSLOG_CHAR=y
CONFIG_SYSLOG_DEVPATH="/dev/ttyS0"
CONFIG_USBDEV=y
CONFIG_USER_ENTRYPOINT="nsh_main"
```

## configs/photon/wlan/defconfig
```kconfig
# CONFIG_ARCH_LEDS is not set
# CONFIG_MMCSD_HAVE_CARDDETECT is not set
# CONFIG_MMCSD_MMCSUPPORT is not set
# CONFIG_NSH_ARGCAT is not set
# CONFIG_NSH_CMDOPT_HEXDUMP is not set
# CONFIG_NSH_CMDPARMS is not set
# CONFIG_NSH_CONSOLE is not set
CONFIG_ARCH="arm"
CONFIG_ARCH_BOARD="photon"
CONFIG_ARCH_BOARD_PHOTON=y
CONFIG_ARCH_CHIP_STM32=y
CONFIG_ARCH_CHIP_STM32F205RG=y
CONFIG_ARCH_STACKDUMP=y
CONFIG_BOARD_LOOPSPERMSEC=16717
CONFIG_BUILTIN=y
CONFIG_DFU_BASE=0x8020000
CONFIG_DFU_BINARY=y
CONFIG_DFU_PID=0xd006
CONFIG_DFU_VID=0x2b04
CONFIG_DISABLE_POLL=y
CONFIG_DRIVERS_IEEE80211=y
CONFIG_DRIVERS_WIRELESS=y
CONFIG_FS_PROCFS=y
CONFIG_HAVE_CXX=y
CONFIG_HAVE_CXXINITIALIZE=y
CONFIG_IEEE80211_BROADCOM_BCM43362=y
CONFIG_IEEE80211_BROADCOM_FULLMAC_SDIO=y
CONFIG_INTELHEX_BINARY=y
CONFIG_LIBM=y
CONFIG_MAX_TASKS=16
CONFIG_MAX_WDOGPARMS=2
CONFIG_MMCSD=y
CONFIG_MMCSD_SDIO=y
CONFIG_MM_REGIONS=2
CONFIG_NET=y
CONFIG_NETDB_DNSCLIENT=y
CONFIG_NETDEVICES=y
CONFIG_NETDEV_LATEINIT=y
CONFIG_NETDEV_WIRELESS_IOCTL=y
CONFIG_NETUTILS_DHCPC=y
CONFIG_NETUTILS_TELNETD=y
CONFIG_NET_BROADCAST=y
CONFIG_NET_ETH_PKTSIZE=800
CONFIG_NET_GUARDSIZE=32
CONFIG_NET_ICMP=y
CONFIG_NET_ICMP_SOCKET=y
CONFIG_NET_PKT=y
CONFIG_NET_SOCKOPTS=y
CONFIG_NET_TCP=y
CONFIG_NET_UDP=y
CONFIG_NFILE_DESCRIPTORS=8
CONFIG_NFILE_STREAMS=8
CONFIG_NSH_ARCHINIT=y
CONFIG_NSH_BUILTIN_APPS=y
CONFIG_NSH_DHCPC=y
CONFIG_NSH_DRIPADDR=0xc0a80001
CONFIG_NSH_FILEIOSIZE=512
CONFIG_NSH_LINELEN=64
CONFIG_NSH_READLINE=y
CONFIG_PHOTON_DFU_BOOTLOADER=y
CONFIG_PHOTON_IWDG=y
CONFIG_PHOTON_WDG_THREAD=y
CONFIG_PHOTON_WLAN=y
CONFIG_PREALLOC_MQ_MSGS=4
CONFIG_PREALLOC_TIMERS=4
CONFIG_PREALLOC_WDOGS=16
CONFIG_RAM_SIZE=114688
CONFIG_RAM_START=0x20000000
CONFIG_RR_INTERVAL=200
CONFIG_SCHED_HPWORK=y
CONFIG_SCHED_WAITPID=y
CONFIG_SDCLONE_DISABLE=y
CONFIG_SDIO_BLOCKSETUP=y
CONFIG_START_DAY=6
CONFIG_START_MONTH=12
CONFIG_START_YEAR=2011
CONFIG_STM32_DMA2=y
CONFIG_STM32_IWDG=y
CONFIG_STM32_JTAG_SW_ENABLE=y
CONFIG_STM32_SDIO=y
CONFIG_STM32_SDIO_CARD=y
CONFIG_STM32_USART1=y
CONFIG_SYSLOG_CHAR=y
CONFIG_SYSLOG_DEVPATH="/dev/ttyS0"
CONFIG_SYSTEM_NSH=y
CONFIG_SYSTEM_PING=y
CONFIG_USERLED=y
CONFIG_USER_ENTRYPOINT="nsh_main"
CONFIG_WIRELESS_WAPI=y
CONFIG_WIRELESS_WAPI_CMDTOOL=y
```

## configs/pic32mx-starterkit/nsh/defconfig
```kconfig
# CONFIG_ARCH_RAMFUNCS is not set
# CONFIG_NSH_DISABLE_IFCONFIG is not set
# CONFIG_NSH_DISABLE_PS is not set
CONFIG_ARCH="mips"
CONFIG_ARCH_BOARD="pic32mx-starterkit"
CONFIG_ARCH_BOARD_PIC32MX_STARTERKIT=y
CONFIG_ARCH_CHIP_PIC32MX795F512L=y
CONFIG_ARCH_CHIP_PIC32MX7=y
CONFIG_ARCH_CHIP_PIC32MX=y
CONFIG_ARCH_MIPS=y
CONFIG_ARCH_STACKDUMP=y
CONFIG_BOARD_LOOPSPERMSEC=7245
CONFIG_BUILTIN=y
CONFIG_DISABLE_POLL=y
CONFIG_FAT_LCNAMES=y
CONFIG_FAT_LFN=y
CONFIG_FS_FAT=y
CONFIG_HOST_WINDOWS=y
CONFIG_IDLETHREAD_STACKSIZE=2048
CONFIG_INTELHEX_BINARY=y
CONFIG_MAX_TASKS=16
CONFIG_MAX_WDOGPARMS=2
CONFIG_MMCSD=y
CONFIG_MTD=y
CONFIG_NFILE_DESCRIPTORS=8
CONFIG_NFILE_STREAMS=8
CONFIG_NSH_ARCHINIT=y
CONFIG_NSH_BUILTIN_APPS=y
CONFIG_NSH_FILEIOSIZE=512
CONFIG_NSH_LINELEN=64
CONFIG_NSH_READLINE=y
CONFIG_PIC32MX_DEBUGGER=2
CONFIG_PIC32MX_FETHIO=0
CONFIG_PIC32MX_FMIIEN=0
CONFIG_PIC32MX_UART1=y
CONFIG_PREALLOC_MQ_MSGS=4
CONFIG_PREALLOC_TIMERS=4
CONFIG_PREALLOC_WDOGS=8
CONFIG_RAM_SIZE=131072
CONFIG_RAM_START=0xa0000000
CONFIG_RR_INTERVAL=200
CONFIG_SCHED_WAITPID=y
CONFIG_SDCLONE_DISABLE=y
CONFIG_START_DAY=7
CONFIG_START_MONTH=3
CONFIG_START_YEAR=2012
CONFIG_SYSTEM_NSH=y
CONFIG_TASK_NAME_SIZE=0
CONFIG_UART1_SERIAL_CONSOLE=y
CONFIG_USER_ENTRYPOINT="nsh_main"
CONFIG_WDOG_INTRESERVE=1
```

## configs/pizero/nsh/defconfig
```kconfig
# CONFIG_NSH_ARGCAT is not set
# CONFIG_NSH_CMDOPT_HEXDUMP is not set
# CONFIG_NSH_CMDPARMS is not set
CONFIG_ARCH="arm"
CONFIG_ARCH_BOARD="pizero"
CONFIG_ARCH_BOARD_RASPBERRY_PIZERO=y
CONFIG_ARCH_CHIP_BCM2708=y
CONFIG_ARCH_CHIP_BCM2835=y
CONFIG_ARCH_LOWVECTORS=y
CONFIG_ARCH_STACKDUMP=y
CONFIG_BCM2708_MINI_UART=y
CONFIG_BCM2708_MINI_UART_SERIAL_CONSOLE=y
CONFIG_BOARD_LOOPSPERMSEC=16717
CONFIG_BOOT_RUNFROMSDRAM=y
CONFIG_BUILTIN=y
CONFIG_DISABLE_POLL=y
CONFIG_FS_PROCFS=y
CONFIG_HAVE_CXX=y
CONFIG_HAVE_CXXINITIALIZE=y
CONFIG_HOST_WINDOWS=y
CONFIG_INTELHEX_BINARY=y
CONFIG_MAX_TASKS=16
CONFIG_MAX_WDOGPARMS=2
CONFIG_NFILE_DESCRIPTORS=8
CONFIG_NFILE_STREAMS=8
CONFIG_NSH_BUILTIN_APPS=y
CONFIG_NSH_FILEIOSIZE=512
CONFIG_NSH_LINELEN=64
CONFIG_NSH_READLINE=y
CONFIG_PREALLOC_MQ_MSGS=4
CONFIG_PREALLOC_TIMERS=4
CONFIG_PREALLOC_WDOGS=16
CONFIG_RAM_SIZE=369098752
CONFIG_RAM_START=0x00000000
CONFIG_RAW_BINARY=y
CONFIG_RR_INTERVAL=200
CONFIG_SCHED_TICKLESS=y
CONFIG_SCHED_WAITPID=y
CONFIG_SDCLONE_DISABLE=y
CONFIG_START_DAY=6
CONFIG_START_MONTH=12
CONFIG_START_YEAR=2011
CONFIG_SYSTEM_NSH=y
CONFIG_USEC_PER_TICK=1
CONFIG_USER_ENTRYPOINT="nsh_main"
```

## configs/qemu-i486/nsh/defconfig
```kconfig
# CONFIG_NSH_DISABLE_IFCONFIG is not set
# CONFIG_NSH_DISABLE_PS is not set
CONFIG_16550_ADDRWIDTH=16
CONFIG_16550_SUPRESS_CONFIG=y
CONFIG_16550_UART=y
CONFIG_16550_UART0_BASE=0x3f8
CONFIG_16550_UART0_BAUD=57600
CONFIG_16550_UART0_CLOCK=16000000
CONFIG_16550_UART0_IRQ=4
CONFIG_16550_UART0_SERIAL_CONSOLE=y
CONFIG_16550_UART0=y
CONFIG_ARCH_BOARD_QEMU_I486=y
CONFIG_ARCH_BOARD="qemu-i486"
CONFIG_ARCH_CHIP_QEMU=y
CONFIG_ARCH_STACKDUMP=y
CONFIG_ARCH_X86=y
CONFIG_ARCH="x86"
CONFIG_BOARD_LOOPSPERMSEC=999
CONFIG_BOOT_RUNFROMEXTSRAM=y
CONFIG_DISABLE_POLL=y
CONFIG_SYSTEM_NSH=y
CONFIG_FS_FAT=y
CONFIG_FS_ROMFS=y
CONFIG_IDLETHREAD_STACKSIZE=2048
CONFIG_MAX_TASKS=64
CONFIG_NFILE_DESCRIPTORS=32
CONFIG_NSH_FILEIOSIZE=512
CONFIG_NSH_LINELEN=64
CONFIG_NSH_READLINE=y
CONFIG_PTHREAD_MUTEX_TYPES=y
CONFIG_RAM_SIZE=1048576
CONFIG_RAM_START=0x00100000
CONFIG_SDCLONE_DISABLE=y
CONFIG_START_DAY=3
CONFIG_START_MONTH=3
CONFIG_START_YEAR=2011
CONFIG_USER_ENTRYPOINT="nsh_main"
```

## configs/qemu-i486/ostest/defconfig
```kconfig
CONFIG_ARCH_BOARD_QEMU_I486=y
CONFIG_ARCH_BOARD="qemu-i486"
CONFIG_ARCH_CHIP_QEMU=y
CONFIG_ARCH_STACKDUMP=y
CONFIG_ARCH_X86=y
CONFIG_ARCH="x86"
CONFIG_BOARD_LOOPSPERMSEC=999
CONFIG_BOOT_RUNFROMEXTSRAM=y
CONFIG_DEV_LOWCONSOLE=y
CONFIG_DISABLE_POLL=y
CONFIG_EXAMPLES_OSTEST_LOOPS=100
CONFIG_EXAMPLES_OSTEST_STACKSIZE=4096
CONFIG_EXAMPLES_OSTEST=y
CONFIG_FS_FAT=y
CONFIG_IDLETHREAD_STACKSIZE=2048
CONFIG_MAX_TASKS=64
CONFIG_NFILE_DESCRIPTORS=32
CONFIG_PTHREAD_MUTEX_TYPES=y
CONFIG_RAM_SIZE=1048576
CONFIG_RAM_START=0x00100000
CONFIG_SDCLONE_DISABLE=y
CONFIG_START_DAY=3
CONFIG_START_MONTH=3
CONFIG_START_YEAR=2011
CONFIG_USER_ENTRYPOINT="ostest_main"
```

## configs/sam4e-ek/Kconfig
```kconfig
#
# For a description of the syntax of this configuration file,
# see the file kconfig-language.txt in the NuttX tools repository.
#

if ARCH_BOARD_SAM4EEK

choice
	prompt "CPU Frequency"
	default SAM4EEK_96MHZ

config SAM4EEK_96MHZ
	bool "96 MHz"

config SAM4EEK_120MHZ
	bool "120 MHz"

endchoice # CPU Frequency

config SAM4EEK_AT25_BLOCKMOUNT
	bool "AT25 serial FLASH auto-mount"
	default n
	depends on SAM34_SPI0 && MTD_AT25
	---help---
		Automatically initialize the AT25 SPI FLASH driver when NSH starts.

choice
	prompt "AT25 serial FLASH configuration"
	default SAM4EEK_AT25_FTL
	depends on SAM4EEK_AT25_BLOCKMOUNT

config SAM4EEK_AT25_FTL
	bool "Create AT25 Serial FLASH block driver"
	---help---
		Create the MTD driver for the AT25 and "wrap" the AT25 as a standard
		block driver that could then, for example, be mounted using FAT or
		any other file system.  Any file system may be used, but there will
		be no wear-leveling.

config SAM4EEK_AT25_NXFFS
	bool "Create AT25 serial FLASH NXFFS file system"
	depends on FS_NXFFS
	---help---
		Create the MTD driver for the AT25 and mount the AT25 device as
		a wear-leveling, NuttX FLASH file system (NXFFS).  The downside of
		NXFFS is that it can be very slow.

endchoice # AT25 serial FLASH configuration

choice
	prompt "USB MSC block device"
	default SAM4EEK_AT25_BLOCKDEVICE if SAM4EEK_AT25_FTL
	default SAM4EEK_HSMCI_BLOCKDEVICE if !SAM4EEK_AT25_FTL
	depends on SYSTEM_USBMSC && (SAM4EEK_AT25_FTL || SAM34_HSMCI)

config SAM4EEK_AT25_BLOCKDEVICE
	bool "AT25 Serial FLASH"

config SAM4EEK_HSMCI_BLOCKDEVICE
	bool "SD card"
	depends on SAM34_HSMCI

endchoice # AT25 serial FLASH configuration

if LCD

choice
	prompt "LCD Type"
	default SAM4EEK_LCD_ILI9341

config SAM4EEK_LCD_ILI9325
	bool "ILI9325 LCD controller"

config SAM4EEK_LCD_ILI9341
	bool "ILI9341 LCD controller"

endchoice # LCD Type

choice
	prompt "LCD Color Configuration"
	default SAM4EEK_LCD_RGB565

config SAM4EEK_LCD_RGB565
	bool "RGB565"

config SAM4EEK_LCD_RGB24
	bool "RGB24 / RGB888"

config SAM4EEK_LCD_RGB32
	bool "RGB32"

endchoice # LCD Color Configuration

config SAM4EEK_LCD_BGCOLOR
	hex "Initial background color"
	default 0x00

endif # LCD
endif # ARCH_BOARD_SAM4EEK
```
