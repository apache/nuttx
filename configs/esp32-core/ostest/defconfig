## configs/indium-f7/Kconfig
```kconfig
#
# For a description of the syntax of this configuration file,
# see the file kconfig-language.txt in the NuttX tools repository.
#

comment "Using Nucleo-144-F7 Board."
choice
	prompt "Select Clock Source."
	default INDIUM_CLOCK_MCO
	---help---
		Select the final clock source.

		MCO - Clock provided by the ST-LINK

		HSI - Internal High Speed Oscillator.

config INDIUM_CLOCK_MCO
	bool "MCO 8-MHz"

config INDIUM_CLOCK_HSI
	bool "HSI 16-MHz"

endchoice # "Select Clock Source."

choice
	prompt "Select Console wiring."
	default INDIUM_CONSOLE_MORPHO_UART4
	---help---
		Select where you will connect the console.

		Virtual COM Port:

		Advantage: Use the ST-Link as a console. No Extra wiring
		neded.

		Disdvantage: Not the best choice for initanl bring up.

		ARDUINO Connector:

		Advantage: You have a shield so it is
		easy.

		Disdvantage: You loose the use of the
		other functions on PC6, PC7

				STM32F7
			ARDUIONO FUNCTION  GPIO
			-- ----- --------- ----
			DO RX    USART6_RX PG9
			D1 TX    USART6_TX PG14
			-- ----- --------- ---

					OR

		Morpho Connector:

				STM32F7
			MORPHO   FUNCTION  GPIO
			-------- --------- -----
			CN12-64  UART8_RX  PE0
			CN11-61  UART8_TX  PE1
			-------- --------- -----

					OR

		Morpho Connector UART4:

				STM32F7
			MORPHO   FUNCTION  GPIO
			-------- --------- -----
			CN11-30  UART4_RX  PA0
			CN11-28  UART4_TX  PA1
			-------- --------- -----
			Note: SB13 must be removed to disable Ethernet.

config INDIUM_CONSOLE_ARDUINO
	bool "Arduino Connector"
	select STM32F7_USART6
	select USART6_SERIALDRIVER
	select USART6_SERIAL_CONSOLE

config INDIUM_CONSOLE_VIRTUAL
	bool "Virtual Comport"
	select STM32F7_USART3
	select USART3_SERIALDRIVER
	select USART3_SERIAL_CONSOLE

config INDIUM_CONSOLE_MORPHO
	bool "Morpho Connector"
	select STM32F7_UART8
	select UART8_SERIALDRIVER
	select UART8_SERIAL_CONSOLE

config INDIUM_CONSOLE_MORPHO_UART4
	bool "Morpho Connector UART4"
	select STM32F7_UART4
	select UART4_SERIALDRIVER
	select UART4_SERIAL_CONSOLE

config INDIUM_CONSOLE_NONE
	bool "No Console"

endchoice # "Select Console wiring"

config NUCLEO_SPI_TEST
	bool "Enable SPI test"
	default n
	---help---
		Enable Spi test - initalize and configure SPI to send
		NUCLEO_SPI_TEST_MESSAGE text. The text is sent on the
		selected SPI Buses with the configured parameters.
		Note the CS lines will not be asserted.

if NUCLEO_SPI_TEST

config NUCLEO_SPI_TEST_MESSAGE
	string "Text to Send on SPI Bus(es)"
	default "Hello World"
	depends on NUCLEO_SPI_TEST
	---help---
		Text to sent on SPI bus(es)

config NUCLEO_SPI1_TEST
	bool "Test SPI bus 1"
	default n
	depends on NUCLEO_SPI_TEST
	---help---
		Enable Spi test - on SPI BUS 1

if NUCLEO_SPI1_TEST

config NUCLEO_SPI1_TEST_FREQ
	int "SPI 1 Clock Freq in Hz"
	default 1000000
	depends on NUCLEO_SPI1_TEST
	---help---
		Sets SPI 1 Clock Freq

config NUCLEO_SPI1_TEST_BITS
	int "SPI 1 number of bits"
	default 8
	depends on NUCLEO_SPI1_TEST
	---help---
		Sets SPI 1 bit length

choice
	prompt "SPI BUS 1 Clock Mode"
	default INDIUM_SPI1_TEST_MODE3
	---help---
		Sets SPI 1 clock mode

config INDIUM_SPI1_TEST_MODE0
	bool "CPOL=0 CHPHA=0"

config INDIUM_SPI1_TEST_MODE1
	bool "CPOL=0 CHPHA=1"

config INDIUM_SPI1_TEST_MODE2
	bool "CPOL=1 CHPHA=0"

config INDIUM_SPI1_TEST_MODE3
	bool "CPOL=1 CHPHA=1"

endchoice # "SPI BUS 1 Clock Mode"

endif # INDIUM_SPI1_TEST

config NUCLEO_SPI2_TEST
	bool "Test SPI bus 2"
	default n
	depends on NUCLEO_SPI_TEST
	---help---
		Enable Spi test - on SPI BUS 2

if INDIUM_SPI2_TEST

config NUCLEO_SPI2_TEST_FREQ
	int "SPI 2 Clock Freq in Hz"
	default 12000000
	depends on NUCLEO_SPI2_TEST
	---help---
		Sets SPI 2 Clock Freq

config NUCLEO_SPI2_TEST_BITS
	int "SPI 2 number of bits"
	default 8
	depends on NUCLEO_SPI2_TEST
	---help---
		Sets SPI 2 bit length

choice
	prompt "SPI BUS 2 Clock Mode"
	default INDIUM_SPI2_TEST_MODE3
	---help---
		Sets SPI 2 clock mode

config INDIUM_SPI2_TEST_MODE0
	bool "CPOL=0 CHPHA=0"

config INDIUM_SPI2_TEST_MODE1
	bool "CPOL=0 CHPHA=1"

config INDIUM_SPI2_TEST_MODE2
	bool "CPOL=1 CHPHA=0"

config INDIUM_SPI2_TEST_MODE3
	bool "CPOL=1 CHPHA=1"

endchoice # "SPI BUS 2 Clock Mode"

endif # NUCLEO_SPI2_TEST
endif # NUCLEO_SPI_TEST
```

## configs/kwikstik-k40/ostest/defconfig
```kconfig
# CONFIG_ARCH_FPU is not set
CONFIG_ARCH="arm"
CONFIG_ARCH_BOARD="kwikstik-k40"
CONFIG_ARCH_BOARD_KWIKSTIK_K40=y
CONFIG_ARCH_CHIP_KINETIS=y
CONFIG_ARCH_CHIP_MK40X256VLQ100=y
CONFIG_ARCH_STACKDUMP=y
CONFIG_ARMV7M_OABI_TOOLCHAIN=y
CONFIG_ARMV7M_TOOLCHAIN_BUILDROOT=y
CONFIG_BOARD_LOOPSPERMSEC=9535
CONFIG_DEV_LOWCONSOLE=y
CONFIG_DISABLE_ENVIRON=y
CONFIG_DISABLE_MOUNTPOINT=y
CONFIG_DISABLE_POLL=y
CONFIG_EXAMPLES_OSTEST=y
CONFIG_EXAMPLES_OSTEST_NBARRIER_THREADS=3
CONFIG_EXAMPLES_OSTEST_STACKSIZE=2048
CONFIG_INTELHEX_BINARY=y
CONFIG_KINETIS_UART5=y
CONFIG_MAX_TASKS=16
CONFIG_MAX_WDOGPARMS=2
CONFIG_NFILE_DESCRIPTORS=8
CONFIG_NFILE_STREAMS=8
CONFIG_PREALLOC_MQ_MSGS=4
CONFIG_PREALLOC_TIMERS=4
CONFIG_PREALLOC_WDOGS=4
CONFIG_RAM_SIZE=65536
CONFIG_RAM_START=0x1fff8000
CONFIG_RR_INTERVAL=200
CONFIG_SDCLONE_DISABLE=y
CONFIG_START_DAY=25
CONFIG_START_MONTH=3
CONFIG_START_YEAR=2013
CONFIG_TASK_NAME_SIZE=0
CONFIG_UART5_SERIAL_CONSOLE=y
CONFIG_USER_ENTRYPOINT="ostest_main"
CONFIG_WDOG_INTRESERVE=0
```

## configs/lc823450-xgevk/Kconfig
```kconfig
#
# For a description of the syntax of this configuration file,
# see the file kconfig-language.txt in the NuttX tools repository.
#

if ARCH_BOARD_LC823450_XGEVK

config LC823450_XGEVK_BTPOWER
	bool "Enable bluetooth power control on lc823450-xgevk"
	default n

endif
```

## configs/lc823450-xgevk/elf/defconfig
```kconfig
# CONFIG_LC823450_SDIF is not set
CONFIG_ARCH="arm"
CONFIG_ARCH_BOARD="lc823450-xgevk"
CONFIG_ARCH_BOARD_LC823450_XGEVK=y
CONFIG_ARCH_CHIP_LC823450=y
CONFIG_ARCH_FLOAT_H=y
CONFIG_ARCH_INTERRUPTSTACK=2048
CONFIG_ARCH_STDARG_H=y
CONFIG_BINFMT_CONSTRUCTORS=y
CONFIG_BINFMT_EXEPATH=y
CONFIG_BOARD_INITIALIZE=y
CONFIG_BOARD_LOOPSPERMSEC=12061
CONFIG_C99_BOOL8=y
CONFIG_CODECS_HASH_MD5=y
CONFIG_DEBUG_FULLOPT=y
CONFIG_DEBUG_SYMBOLS=y
CONFIG_DEV_ZERO=y
CONFIG_DISABLE_POSIX_TIMERS=y
CONFIG_ELF=y
CONFIG_EXAMPLES_ELF=y
CONFIG_FS_PROCFS=y
CONFIG_FS_ROMFS=y
CONFIG_FS_WRITABLE=y
CONFIG_HAVE_CXX=y
CONFIG_INTELHEX_BINARY=y
CONFIG_LC823450_UART0=y
CONFIG_LIBM=y
CONFIG_LIB_BOARDCTL=y
CONFIG_LIB_KBDCODEC=y
CONFIG_MAX_TASKS=64
CONFIG_MAX_WDOGPARMS=2
CONFIG_MEMSET_OPTSPEED=y
CONFIG_NAME_MAX=765
CONFIG_NETUTILS_CODECS=y
CONFIG_NFILE_DESCRIPTORS=45
CONFIG_NFILE_STREAMS=8
CONFIG_PATH_INITIAL="/mnt/romfs"
CONFIG_PIPES=y
CONFIG_POSIX_SPAWN_PROXY_STACKSIZE=2048
CONFIG_PREALLOC_TIMERS=4
CONFIG_PREALLOC_WDOGS=16
CONFIG_PTHREAD_MUTEX_TYPES=y
CONFIG_PTHREAD_STACK_DEFAULT=3072
CONFIG_RAM_SIZE=1044480
CONFIG_RAM_START=0x02001000
CONFIG_RAW_BINARY=y
CONFIG_RTC=y
CONFIG_RTC_DATETIME=y
CONFIG_SCHED_ATEXIT=y
CONFIG_SCHED_CHILD_STATUS=y
CONFIG_SCHED_HAVE_PARENT=y
CONFIG_SCHED_INSTRUMENTATION=y
CONFIG_SCHED_INSTRUMENTATION_BUFFER=y
CONFIG_SCHED_ONEXIT=y
CONFIG_SCHED_ONEXIT_MAX=32
CONFIG_SCHED_STARTHOOK=y
CONFIG_SCHED_WAITPID=y
CONFIG_SDCLONE_DISABLE=y
CONFIG_SERIAL_TERMIOS=y
CONFIG_START_DAY=3
CONFIG_START_MONTH=10
CONFIG_START_YEAR=2013
CONFIG_SYMTAB_ORDEREDBYNAME=y
CONFIG_TASK_NAME_SIZE=24
CONFIG_UART0_RXBUFSIZE=512
CONFIG_UART0_SERIAL_CONSOLE=y
CONFIG_UART0_TXBUFSIZE=2048
CONFIG_USERMAIN_STACKSIZE=3072
CONFIG_USER_ENTRYPOINT="elf_main"
```

## configs/lc823450-xgevk/kostest/defconfig
```kconfig
CONFIG_ARCH="arm"
CONFIG_ARCH_BOARD="lc823450-xgevk"
CONFIG_ARCH_BOARD_LC823450_XGEVK=y
CONFIG_ARCH_CHIP_LC823450=y
CONFIG_ARCH_INTERRUPTSTACK=2048
CONFIG_ARCH_STDARG_H=y
CONFIG_ARM_MPU=y
CONFIG_BOARD_LOOPSPERMSEC=12061
CONFIG_BUILD_PROTECTED=y
CONFIG_DEBUG_FULLOPT=y
CONFIG_DEBUG_SYMBOLS=y
CONFIG_DISABLE_ENVIRON=y
CONFIG_DISABLE_MOUNTPOINT=y
CONFIG_DISABLE_POLL=y
CONFIG_EXAMPLES_OSTEST=y
CONFIG_EXAMPLES_OSTEST_NBARRIER_THREADS=3
CONFIG_EXAMPLES_OSTEST_STACKSIZE=2048
CONFIG_INTELHEX_BINARY=y
CONFIG_LC823450_MTM0_TICK=y
CONFIG_LC823450_SPIFI=y
CONFIG_LC823450_UART0=y
CONFIG_MAX_TASKS=16
CONFIG_MAX_WDOGPARMS=2
CONFIG_NFILE_DESCRIPTORS=8
CONFIG_NFILE_STREAMS=8
CONFIG_NUTTX_USERSPACE=0x05020000
CONFIG_PASS1_BUILDIR="configs/lc823450-xgevk/kernel"
CONFIG_PREALLOC_MQ_MSGS=4
CONFIG_PREALLOC_TIMERS=4
CONFIG_PREALLOC_WDOGS=8
CONFIG_RAM_SIZE=1044480
CONFIG_RAM_START=0x02001000
CONFIG_RAW_BINARY=y
CONFIG_RR_INTERVAL=200
CONFIG_RTC=y
CONFIG_RTC_DATETIME=y
CONFIG_SCHED_WAITPID=y
CONFIG_SDCLONE_DISABLE=y
CONFIG_START_DAY=3
CONFIG_START_MONTH=10
CONFIG_START_YEAR=2013
CONFIG_SYMTAB_ORDEREDBYNAME=y
CONFIG_SYSTEM_TIME64=y
CONFIG_SYS_RESERVED=8
CONFIG_UART0_RXBUFSIZE=512
CONFIG_UART0_SERIAL_CONSOLE=y
CONFIG_UART0_TXBUFSIZE=2048
CONFIG_USERMAIN_STACKSIZE=3072
CONFIG_USER_ENTRYPOINT="ostest_main"
CONFIG_WDOG_INTRESERVE=2
```

## configs/lc823450-xgevk/rndis/defconfig
```kconfig
# CONFIG_AUDIO_FORMAT_MP3 is not set
# CONFIG_NSH_ARGCAT is not set
# CONFIG_NX_DISABLE_1BPP is not set
# CONFIG_SPI_EXCHANGE is not set
CONFIG_AQM_1248A=y
CONFIG_ARCH="arm"
CONFIG_ARCH_BOARD="lc823450-xgevk"
CONFIG_ARCH_BOARD_LC823450_XGEVK=y
CONFIG_ARCH_CHIP_LC823450=y
CONFIG_ARCH_FLOAT_H=y
CONFIG_ARCH_INTERRUPTSTACK=2048
CONFIG_ARCH_STDARG_H=y
CONFIG_AUDIO=y
CONFIG_AUDIO_BUFFER_NUMBYTES=1024
CONFIG_AUDIO_EXCLUDE_BALANCE=y
CONFIG_AUDIO_EXCLUDE_FFORWARD=y
CONFIG_AUDIO_EXCLUDE_TONE=y
CONFIG_AUDIO_I2SCHAR=y
CONFIG_AUDIO_WM8776=y
CONFIG_BINFMT_EXEPATH=y
CONFIG_BOARDCTL_RESET=y
CONFIG_BOARDCTL_USBDEVCTRL=y
CONFIG_BOARD_LOOPSPERMSEC=12061
CONFIG_BUILD_LOADABLE=y
CONFIG_BUILTIN=y
CONFIG_C99_BOOL8=y
CONFIG_CODECS_HASH_MD5=y
CONFIG_DEBUG_FULLOPT=y
CONFIG_DEBUG_SYMBOLS=y
CONFIG_DEV_ZERO=y
CONFIG_DISABLE_POSIX_TIMERS=y
CONFIG_DRIVERS_AUDIO=y
CONFIG_DVFS=y
CONFIG_ELF=y
CONFIG_EXAMPLES_HELLO=m
CONFIG_EXAMPLES_HELLOXX=m
CONFIG_EXAMPLES_I2SLOOP=y
CONFIG_EXAMPLES_NXHELLO=y
CONFIG_EXAMPLES_NXHELLO_BPP=1
CONFIG_EXAMPLES_OSTEST=y
CONFIG_EXAMPLES_PIPE=y
CONFIG_EXAMPLES_SMP=y
CONFIG_FAT_LCNAMES=y
CONFIG_FAT_LFN=y
CONFIG_FAT_MAXFNAME=255
CONFIG_FS_FAT=y
CONFIG_FS_FATTIME=y
CONFIG_FS_PROCFS=y
CONFIG_FS_PROCFS_REGISTER=y
CONFIG_HAVE_CXX=y
CONFIG_HRT_TIMER=y
CONFIG_I2C=y
CONFIG_I2CTOOL_MAXBUS=1
CONFIG_I2C_RESET=y
CONFIG_I2S=y
CONFIG_INTELHEX_BINARY=y
CONFIG_IOB_BUFSIZE=128
CONFIG_IOB_NBUFFERS=64
CONFIG_IOB_NCHAINS=10
CONFIG_LC823450_I2C0=y
CONFIG_LC823450_I2C1=y
CONFIG_LC823450_I2S0=y
CONFIG_LC823450_MTD=y
CONFIG_LC823450_MTM0_TICK=y
CONFIG_LC823450_SDIF_SDC=y
CONFIG_LC823450_SPI_DMA=y
CONFIG_LC823450_UART0=y
CONFIG_LCD=y
CONFIG_LCD_ST7565=y
CONFIG_LIBC_EXECFUNCS=y
CONFIG_LIBM=y
CONFIG_LIB_KBDCODEC=y
CONFIG_MAX_TASKS=64
CONFIG_MAX_WDOGPARMS=2
CONFIG_MEMSET_OPTSPEED=y
CONFIG_MQ_MAXMSGSIZE=64
CONFIG_MTD=y
CONFIG_NAME_MAX=765
CONFIG_NET=y
CONFIG_NETDB_DNSCLIENT=y
CONFIG_NETDEVICES=y
CONFIG_NETUTILS_CODECS=y
CONFIG_NETUTILS_DHCPC=y
CONFIG_NETUTILS_TELNETD=y
CONFIG_NETUTILS_WEBCLIENT=y
CONFIG_NET_ARP_SEND=y
CONFIG_NET_BROADCAST=y
CONFIG_NET_ETH_PKTSIZE=1500
CONFIG_NET_ICMP=y
CONFIG_NET_ICMP_SOCKET=y
CONFIG_NET_LOOPBACK=y
CONFIG_NET_PKT=y
CONFIG_NET_ROUTE=y
CONFIG_NET_SOCKOPTS=y
CONFIG_NET_STATISTICS=y
CONFIG_NET_TCP=y
CONFIG_NET_UDP=y
CONFIG_NET_UDP_BINDTODEVICE=y
CONFIG_NFILE_DESCRIPTORS=45
CONFIG_NFILE_STREAMS=8
CONFIG_NSH_ARCHINIT=y
CONFIG_NSH_BUILTIN_APPS=y
CONFIG_NSH_CMDOPT_DD_STATS=y
CONFIG_NSH_DHCPC=y
CONFIG_NSH_DISABLE_BASENAME=y
CONFIG_NSH_DISABLE_DIRNAME=y
CONFIG_NSH_DISABLE_EXEC=y
CONFIG_NSH_DISABLE_GET=y
CONFIG_NSH_DISABLE_LOSETUP=y
CONFIG_NSH_DISABLE_MB=y
CONFIG_NSH_DISABLE_MH=y
CONFIG_NSH_DISABLE_MKFIFO=y
CONFIG_NSH_DISABLE_MKRD=y
CONFIG_NSH_DISABLE_PUT=y
CONFIG_NSH_DISABLE_SH=y
CONFIG_NSH_DISABLE_XD=y
CONFIG_NSH_DRIPADDR=0xa9feab5a
CONFIG_NSH_FILEIOSIZE=512
CONFIG_NSH_FILE_APPS=y
CONFIG_NSH_LINELEN=128
CONFIG_NSH_MACADDR=0x00e0deadbeff
CONFIG_NSH_MAXARGUMENTS=10
CONFIG_NSH_NETINIT_THREAD=y
CONFIG_NSH_NETMASK=0xffff0000
CONFIG_NSH_NOMAC=y
CONFIG_NSH_READLINE=y
CONFIG_NSH_WGET_USERAGENT="NuttX/7.2x.x (; http://www.nuttx.org/)"
CONFIG_NX=y
CONFIG_NXFONT_MONO5X8=y
CONFIG_NXPLAYER_DEFAULT_MEDIADIR="/mnt/sd1"
CONFIG_NXPLAYER_HTTP_STREAMING_SUPPORT=y
CONFIG_NX_BLOCKING=y
CONFIG_PATH_INITIAL="/mnt/sd0/bin"
CONFIG_PIPES=y
CONFIG_POSIX_SPAWN_PROXY_STACKSIZE=2048
CONFIG_PREALLOC_MQ_MSGS=4
CONFIG_PREALLOC_TIMERS=4
CONFIG_PREALLOC_WDOGS=16
CONFIG_PTHREAD_MUTEX_TYPES=y
CONFIG_PTHREAD_STACK_DEFAULT=3072
CONFIG_RAM_SIZE=1044480
CONFIG_RAM_START=0x02001000
CONFIG_RAW_BINARY=y
CONFIG_READLINE_CMD_HISTORY=y
CONFIG_RNDIS=y
CONFIG_RTC=y
CONFIG_RTC_HIRES=y
CONFIG_SCHED_ATEXIT=y
CONFIG_SCHED_CHILD_STATUS=y
CONFIG_SCHED_HAVE_PARENT=y
CONFIG_SCHED_HPWORK=y
CONFIG_SCHED_HPWORKPRIORITY=192
CONFIG_SCHED_INSTRUMENTATION=y
CONFIG_SCHED_INSTRUMENTATION_BUFFER=y
CONFIG_SCHED_INSTRUMENTATION_PREEMPTION=y
CONFIG_SCHED_LPWORK=y
CONFIG_SCHED_LPWORKPRIORITY=60
CONFIG_SCHED_ONEXIT=y
CONFIG_SCHED_ONEXIT_MAX=32
CONFIG_SCHED_STARTHOOK=y
CONFIG_SCHED_WAITPID=y
CONFIG_SDCLONE_DISABLE=y
CONFIG_SENSORS=y
CONFIG_SERIAL_TERMIOS=y
CONFIG_SMP=y
CONFIG_SMP_NCPUS=2
CONFIG_SPI=y
CONFIG_SPINLOCK_IRQ=y
CONFIG_START_DAY=3
CONFIG_START_MONTH=10
CONFIG_START_YEAR=2013
CONFIG_SYMTAB_ORDEREDBYNAME=y
CONFIG_SYSTEM_I2CTOOL=y
CONFIG_SYSTEM_NSH=y
CONFIG_SYSTEM_NSH_SYMTAB=y
CONFIG_SYSTEM_NSH_SYMTAB_ARRAYNAME="g_symtab"
CONFIG_SYSTEM_NSH_SYMTAB_COUNTNAME="g_nsymbols"
CONFIG_SYSTEM_NXPLAYER=y
CONFIG_SYSTEM_PING=y
CONFIG_SYSTEM_TASKSET=y
CONFIG_SYSTEM_TIME64=y
CONFIG_TASK_NAME_SIZE=24
CONFIG_TELNET_CHARACTER_MODE=y
CONFIG_UART0_RXBUFSIZE=512
CONFIG_UART0_SERIAL_CONSOLE=y
CONFIG_UART0_TXBUFSIZE=2048
CONFIG_USBDEV=y
CONFIG_USBDEV_BUSPOWERED=y
CONFIG_USBDEV_DUALSPEED=y
CONFIG_USBDEV_MAXPOWER=500
CONFIG_USERMAIN_STACKSIZE=3072
CONFIG_USER_ENTRYPOINT="nsh_main"
CONFIG_WM8776_SWAP_HPOUT=y
```
