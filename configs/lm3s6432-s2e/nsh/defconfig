## configs/mcu123-lpc214x/composite/defconfig
```kconfig
# CONFIG_MMCSD_MMCSUPPORT is not set
# CONFIG_SPI_EXCHANGE is not set
CONFIG_ARCH="arm"
CONFIG_ARCH_BOARD="mcu123-lpc214x"
CONFIG_ARCH_BOARD_MCU123_LPC214X=y
CONFIG_ARCH_CHIP_LPC2148=y
CONFIG_ARCH_CHIP_LPC214X=y
CONFIG_ARCH_INTERRUPTSTACK=1024
CONFIG_ARCH_STACKDUMP=y
CONFIG_ARM_TOOLCHAIN_BUILDROOT=y
CONFIG_BOARD_LOOPSPERMSEC=3270
CONFIG_CDCACM=y
CONFIG_CDCACM_COMPOSITE=y
CONFIG_CDCACM_RXBUFSIZE=256
CONFIG_CDCACM_TXBUFSIZE=256
CONFIG_COMPOSITE_CONFIGSTR="system/composite"
CONFIG_COMPOSITE_IAD=y
CONFIG_COMPOSITE_PRODUCTID=0x2022
CONFIG_COMPOSITE_PRODUCTSTR="Composite Device"
CONFIG_COMPOSITE_SERIALSTR="12345"
CONFIG_COMPOSITE_VENDORID=0x03eb
CONFIG_COMPOSITE_VERSIONNO=0x0101
CONFIG_DISABLE_POLL=y
CONFIG_IDLETHREAD_STACKSIZE=2048
CONFIG_INTELHEX_BINARY=y
CONFIG_LIB_BOARDCTL=y
CONFIG_MAX_TASKS=16
CONFIG_MAX_WDOGPARMS=2
CONFIG_MMCSD=y
CONFIG_MMCSD_MULTIBLOCK_DISABLE=y
CONFIG_NFILE_DESCRIPTORS=8
CONFIG_NFILE_STREAMS=8
CONFIG_PREALLOC_MQ_MSGS=4
CONFIG_PREALLOC_TIMERS=4
CONFIG_PREALLOC_WDOGS=8
CONFIG_RAM_SIZE=32768
CONFIG_RAM_START=0x40000000
CONFIG_SDCLONE_DISABLE=y
CONFIG_SPI=y
CONFIG_START_MONTH=10
CONFIG_START_YEAR=2008
CONFIG_SYSTEM_COMPOSITE=y
CONFIG_SYSTEM_COMPOSITE_SERDEV="/dev/ttyUSB0"
CONFIG_TASK_NAME_SIZE=0
CONFIG_UART0_BAUD=38400
CONFIG_UART0_SERIAL_CONSOLE=y
CONFIG_UART1_BAUD=38400
CONFIG_USBDEV=y
CONFIG_USBDEV_COMPOSITE=y
CONFIG_USBDEV_TRACE=y
CONFIG_USBMSC=y
CONFIG_USBMSC_BULKINREQLEN=256
CONFIG_USBMSC_BULKOUTREQLEN=256
CONFIG_USBMSC_COMPOSITE=y
CONFIG_USBMSC_NRDREQS=2
CONFIG_USBMSC_NWRREQS=2
CONFIG_USBMSC_REMOVABLE=y
CONFIG_USBMSC_VERSIONNO=0x0399
CONFIG_USER_ENTRYPOINT="conn_main"
CONFIG_WDOG_INTRESERVE=1
```

## configs/metro-m4/Kconfig
```kconfig
#
# For a description of the syntax of this configuration file,
# see the file kconfig-language.txt in the NuttX tools repository.
#

if ARCH_BOARD_METRO_M4

choice
	prompt "Execution memory"
	default METRO_M4_RUNFROMFLASH

config METRO_M4_RUNFROMFLASH
	bool "Run from FLASH"
	select BOOT_RUNFROMFLASH
	---help---
		This is the normal configuration for building METRO M4 code.

config METRO_M4_RUNFROMSRAM
	bool "Run from SRAM"
	select BOOT_RUNFROMISRAM
	---help---
		During early bring-up, it is safer to execute entirely from
		SRAM until you are confident in the initialization logic.
		Then you can safely switch to FLASH.

		REVISIT:  This auto-selects CONFIG_BOOT_RUNFROMISRAM but I have
		found, with some difficulty, that that choice still defaults to
		CONFIG_BOOT_RUNFROMFLASH, causing link-time failures when running
		from SRAM.

endchoice # Execution memory
endif # ARCH_BOARD_METRO_M4
```

## configs/mikroe-stm32f4/Kconfig
```kconfig
#
# For a description of the syntax of this configuration file,
# see misc/tools/kconfig-language.txt.
#

if ARCH_BOARD_MIKROE_STM32F4

config MIKROE_FLASH
	bool "MTD driver for onboard 1M FLASH"
	default n
    select MTD
    select MTD_M25P
    select MTD_SMART
    select FS_SMARTFS
    select STM32_SPI3
    select MTD_BYTE_WRITE
	---help---
		Configures an MTD device for use with the onboard flash

config MIKROE_FLASH_MINOR
	int "Minor number for the FLASH /dev/smart entry"
	default 0
    depends on MIKROE_FLASH
	---help---
		Sets the minor number for the FLASH MTD /dev entry

config MIKROE_FLASH_PART
	bool "Enable partition support on FLASH"
	default n
    depends on MIKROE_FLASH
	---help---
		Enables creation of partitions on the FLASH

config MIKROE_FLASH_PART_LIST
	string "Flash partition size list"
    default "256,768"
    depends on MIKROE_FLASH_PART
	---help---
		Comma separated list of partition sizes in KB

config MIKROE_RAMMTD
	bool "MTD driver for SMARTFS RAM disk"
	default n
    select MTD
    select RAMMTD
	---help---
		Configures an MTD based RAM device for use with SMARTFS.

config MIKROE_RAMMTD_MINOR
	int "Minor number for RAM /dev/smart entry"
	default 1
    depends on MIKROE_RAMMTD
	---help---
		Sets the minor number for the RAM MTD /dev entry

config MIKROE_RAMMTD_SIZE
	int "Size in KB of the RAM device to create"
	default 32
    depends on MIKROE_RAMMTD
	---help---
		Sets the size of static RAM allocation for the SMART RAM device

config PM_ALARM_SEC
	int "PM_STANDBY delay (seconds)"
	default 15
	depends on PM && RTC_ALARM
	---help---
		Number of seconds to wait in PM_STANDBY before going to PM_STANDBY mode.

config PM_ALARM_NSEC
	int "PM_STANDBY delay (nanoseconds)"
	default 0
	depends on PM && RTC_ALARM
	---help---
		Number of additional nanoseconds to wait in PM_STANDBY before going to PM_STANDBY mode.

config PM_SLEEP_WAKEUP
	bool "PM_SLEEP wake-up alarm"
	default n
	depends on PM && RTC_ALARM
	---help---
		Wake-up of PM_SLEEP mode after a delay and resume normal operation.

config PM_SLEEP_WAKEUP_SEC
	int "PM_SLEEP delay (seconds)"
	default 10
	depends on PM && RTC_ALARM
	---help---
		Number of seconds to wait in PM_SLEEP before going to PM_STANDBY mode.

config PM_SLEEP_WAKEUP_NSEC
	int "PM_SLEEP delay (nanoseconds)"
	default 0
	depends on PM && RTC_ALARM
	---help---
		Number of additional nanoseconds to wait in PM_SLEEP before going to PM_STANDBY mode.

endif
```

## configs/mikroe-stm32f4/usbnsh/defconfig
```kconfig
# CONFIG_ARCH_FPU is not set
# CONFIG_DEV_CONSOLE is not set
# CONFIG_NSH_DISABLE_IFCONFIG is not set
# CONFIG_NSH_DISABLE_PS is not set
# CONFIG_SPI_CALLBACK is not set
CONFIG_ARCH="arm"
CONFIG_ARCH_BOARD="mikroe-stm32f4"
CONFIG_ARCH_BOARD_MIKROE_STM32F4=y
CONFIG_ARCH_BOARD_STM32_CUSTOM_CLOCKCONFIG=y
CONFIG_ARCH_CHIP_STM32=y
CONFIG_ARCH_CHIP_STM32F407VG=y
CONFIG_ARCH_STACKDUMP=y
CONFIG_BOARDCTL_USBDEVCTRL=y
CONFIG_BOARD_LOOPSPERMSEC=16717
CONFIG_BUILTIN=y
CONFIG_CDCACM=y
CONFIG_CDCACM_CONSOLE=y
CONFIG_CDCACM_RXBUFSIZE=256
CONFIG_CDCACM_TXBUFSIZE=256
CONFIG_DEV_LOOP=y
CONFIG_DEV_ZERO=y
CONFIG_DISABLE_POLL=y
CONFIG_FS_FAT=y
CONFIG_FS_ROMFS=y
CONFIG_HAVE_CXX=y
CONFIG_HAVE_CXXINITIALIZE=y
CONFIG_IDLETHREAD_STACKSIZE=2048
CONFIG_INTELHEX_BINARY=y
CONFIG_LIBC_PERROR_STDOUT=y
CONFIG_LIBC_STRERROR=y
CONFIG_M25P_MANUFACTURER=0x1C
CONFIG_M25P_MEMORY_TYPE=0x31
CONFIG_M25P_SUBSECTOR_ERASE=y
CONFIG_MAX_TASKS=16
CONFIG_MAX_WDOGPARMS=2
CONFIG_MIKROE_FLASH=y
CONFIG_MIKROE_FLASH_PART=y
CONFIG_MIKROE_FLASH_PART_LIST="256,768"
CONFIG_MIKROE_RAMMTD=y
CONFIG_MMCSD=y
CONFIG_MM_REGIONS=2
CONFIG_MTD_PARTITION=y
CONFIG_MTD_SMART_SECTOR_SIZE=512
CONFIG_NFILE_DESCRIPTORS=8
CONFIG_NFILE_STREAMS=8
CONFIG_NSH_ARCHINIT=y
CONFIG_NSH_BUILTIN_APPS=y
CONFIG_NSH_FILEIOSIZE=512
CONFIG_NSH_LINELEN=64
CONFIG_NSH_READLINE=y
CONFIG_NSH_STRERROR=y
CONFIG_PREALLOC_MQ_MSGS=4
CONFIG_PREALLOC_TIMERS=4
CONFIG_PREALLOC_WDOGS=8
CONFIG_RAMDISK=y
CONFIG_RAM_SIZE=114688
CONFIG_RAM_START=0x20000000
CONFIG_RAW_BINARY=y
CONFIG_RR_INTERVAL=200
CONFIG_SCHED_WAITPID=y
CONFIG_SDCLONE_DISABLE=y
CONFIG_START_DAY=27
CONFIG_START_YEAR=2013
CONFIG_STM32_DISABLE_IDLE_SLEEP_DURING_DEBUG=y
CONFIG_STM32_JTAG_SW_ENABLE=y
CONFIG_STM32_OTGFS=y
CONFIG_STM32_PWR=y
CONFIG_STM32_RNG=y
CONFIG_STM32_SPI2=y
CONFIG_STM32_USART2=y
CONFIG_SYSLOG_CHAR=y
CONFIG_SYSLOG_DEVPATH="/dev/ttyS0"
CONFIG_SYSTEM_FLASH_ERASEALL=y
CONFIG_SYSTEM_NSH=y
CONFIG_SYSTEM_NSH_CXXINITIALIZE=y
CONFIG_TASK_NAME_SIZE=0
CONFIG_USBDEV=y
CONFIG_USER_ENTRYPOINT="nsh_main"
CONFIG_WDOG_INTRESERVE=1
```

## configs/mirtoo/Kconfig
```kconfig
#
# For a description of the syntax of this configuration file,
# see misc/tools/kconfig-language.txt.
#

if ARCH_BOARD_MIRTOO

config MIRTOO_RELEASE
	int "Mirtoo release number"
	default 2
	---help---
		Select the Mirtoo release number.  For example, 1 for release R1.

endif
```

## configs/misoc/nsh/defconfig
```kconfig
# CONFIG_LIBC_LONG_LONG is not set
# CONFIG_STANDARD_SERIAL is not set
CONFIG_ARCH="misoc"
CONFIG_ARCH_BOARD="misoc"
CONFIG_ARCH_BOARD_MISOC=y
CONFIG_ARCH_CHIP_LM32=y
CONFIG_ARCH_MISOC=y
CONFIG_ARCH_STACKDUMP=y
CONFIG_BOARD_LOOPSPERMSEC=800
CONFIG_DEBUG_SYMBOLS=y
CONFIG_DISABLE_ENVIRON=y
CONFIG_DISABLE_MOUNTPOINT=y
CONFIG_DISABLE_MQUEUE=y
CONFIG_DISABLE_POLL=y
CONFIG_DISABLE_POSIX_TIMERS=y
CONFIG_DISABLE_PSEUDOFS_OPERATIONS=y
CONFIG_DISABLE_PTHREAD=y
CONFIG_EXAMPLES_HELLO=y
CONFIG_SYSTEM_NSH=y
CONFIG_EXAMPLES_OSTEST=y
CONFIG_MAX_TASKS=4
CONFIG_MAX_WDOGPARMS=2
CONFIG_MISOC_UART1=y
CONFIG_NFILE_DESCRIPTORS=4
CONFIG_NFILE_STREAMS=4
CONFIG_NUNGET_CHARS=0
CONFIG_PREALLOC_TIMERS=0
CONFIG_PREALLOC_WDOGS=4
CONFIG_PTHREAD_STACK_DEFAULT=1024
CONFIG_PTHREAD_STACK_MIN=512
CONFIG_RAM_SIZE=524288
CONFIG_RAM_START=0x40000000
CONFIG_RAW_BINARY=y
CONFIG_SDCLONE_DISABLE=y
CONFIG_START_DAY=16
CONFIG_START_MONTH=6
CONFIG_START_YEAR=2011
CONFIG_STDIO_DISABLE_BUFFERING=y
CONFIG_TASK_NAME_SIZE=0
CONFIG_UART1_SERIAL_CONSOLE=y
CONFIG_USERMAIN_STACKSIZE=1024
CONFIG_USER_ENTRYPOINT="nsh_main"
CONFIG_WDOG_INTRESERVE=0
```
