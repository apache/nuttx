## configs/16z/Kconfig
```kconfig
#
# For a description of the syntax of this configuration file,
# see misc/tools/kconfig-language.txt.
#

if CONFIG_ARCH_BOARD_16Z

config 16Z_RFTRANSCEIVER
	bool "RF Transceiver installed"
	default n
	---help---
		Select this option if the on-board RF transceiver is installed

config 16Z_SERIAL_MEMORY
	bool "Serial memory"
	default n
	---help---
		Select this option if the on-board serial memory is installed

endif # CONFIG_ARCH_BOARD_16Z
```

## configs/arduino-due/Kconfig
```kconfig
#
# For a description of the syntax of this configuration file,
# see the file kconfig-language.txt in the NuttX tools repository.
#

if ARCH_BOARD_ARDUINO_DUE

config ADRUINO_DUE_REV3
	bool "Rev 3"
	default n
	---help---
		This port was performed on the Aduino Due Rev 2 board.  Differences
		with the Arduino Due Rev 3 board have been reported.  This selection
		will enable work arounds specifically for the Rev 3 board.

config ARDUINO_ITHEAD_TFT
	bool "ITEAD 2.4 inch TFT w/Touch"
	default n
	---help---
		Select this option if you have the ITEAD 2.4" TFT module installed.
		This will enable support for the peripherals on that module
		including the SD card, TFT LCD, and touchscreen controller.

endif
```

## configs/avr32dev1/ostest/defconfig
```kconfig
CONFIG_ARCH="avr"
CONFIG_ARCH_AVR=y
CONFIG_ARCH_BOARD="avr32dev1"
CONFIG_ARCH_BOARD_AVR32DEV1=y
CONFIG_ARCH_CHIP_AT32UC3=y
CONFIG_ARCH_CHIP_AT32UC3B0256=y
CONFIG_ARCH_CHIP_AT32UC3B0=y
CONFIG_ARCH_CHIP_AT32UC3B=y
CONFIG_ARCH_STACKDUMP=y
CONFIG_AVR32_GPIOIRQ=y
CONFIG_AVR32_GPIOIRQSETA=0
CONFIG_AVR32_GPIOIRQSETB=0x0000000c
CONFIG_AVR32_USART1=y
CONFIG_BOARD_LOOPSPERMSEC=1140
CONFIG_DEV_LOWCONSOLE=y
CONFIG_DISABLE_ENVIRON=y
CONFIG_DISABLE_MOUNTPOINT=y
CONFIG_DISABLE_POLL=y
CONFIG_ENDIAN_BIG=y
CONFIG_EXAMPLES_OSTEST=y
CONFIG_EXAMPLES_OSTEST_NBARRIER_THREADS=3
CONFIG_EXAMPLES_OSTEST_STACKSIZE=1024
CONFIG_HOST_WINDOWS=y
CONFIG_INTELHEX_BINARY=y
CONFIG_MAX_TASKS=16
CONFIG_MAX_WDOGPARMS=2
CONFIG_NFILE_DESCRIPTORS=8
CONFIG_NFILE_STREAMS=8
CONFIG_PREALLOC_MQ_MSGS=4
CONFIG_PREALLOC_TIMERS=4
CONFIG_PREALLOC_WDOGS=4
CONFIG_RAM_SIZE=32768
CONFIG_RAM_START=0x00000000
CONFIG_SDCLONE_DISABLE=y
CONFIG_START_DAY=2
CONFIG_START_MONTH=11
CONFIG_START_YEAR=2010
CONFIG_TASK_NAME_SIZE=0
CONFIG_USART1_BAUD=57600
CONFIG_USART1_SERIAL_CONSOLE=y
CONFIG_USER_ENTRYPOINT="ostest_main"
CONFIG_WDOG_INTRESERVE=0
```

## configs/b-l475e-iot01a/Kconfig
```kconfig
#
# For a description of the syntax of this configuration file,
# see the file kconfig-language.txt in the NuttX tools repository.
#

if ARCH_BOARD_B_L475E_IOT01A

config B_L475E_IOT01A_MTD_FLASH
	bool "MTD driver for external 64Mbytes flash memory"
	default n
	select STM32L4_DMA1
	select STM32L4_QSPI
	select MTD
	select MTD_MX25RXX
	select MTD_SMART
	select MTD_SMART_MINIMIZE_RAM
	select FS_SMARTFS
	---help---
		Configures an MTD device for use with the onboard external flash
		using QuadSPI interface.

if B_L475E_IOT01A_MTD_FLASH

config B_L475E_IOT01A_MTD_FLASH_MINOR
	int "Minor number for the flash memory /dev/smart entry"
	default 0
	---help---
		Sets the minor number for the flash memory /dev/smart entry

config B_L475E_IOT01A_MTD_PART
	bool "Enable partition support"
	default n
	select MTD_PARTITION
	---help---
		Enables creation of partitions on the external flash memory.

config B_L475E_IOT01A_MTD_PART_LIST
	string "Flash partition size list"
	default "512,8192,8192,16384"
	depends on B_L475E_IOT01A_MTD_PART
	---help---
		Comma separated list of partition sizes in KB.

endif # B_L475E_IOT01A_MTD_FLASH
endif # ARCH_BOARD_B_L475E_IOT01A
```

## configs/b-l475e-iot01a/nsh/defconfig
```kconfig
# CONFIG_NSH_ARGCAT is not set
# CONFIG_NSH_CMDOPT_HEXDUMP is not set
# CONFIG_NSH_CMDPARMS is not set
CONFIG_ARCH="arm"
CONFIG_ARCH_BOARD="b-l475e-iot01a"
CONFIG_ARCH_BOARD_B_L475E_IOT01A=y
CONFIG_ARCH_CHIP_STM32L475VG=y
CONFIG_ARCH_CHIP_STM32L4=y
CONFIG_ARCH_STACKDUMP=y
CONFIG_BOARD_LOOPSPERMSEC=8025
CONFIG_BUILTIN=y
CONFIG_DISABLE_POLL=y
CONFIG_FS_PROCFS=y
CONFIG_HAVE_CXX=y
CONFIG_HAVE_CXXINITIALIZE=y
CONFIG_INTELHEX_BINARY=y
CONFIG_MAX_TASKS=16
CONFIG_MAX_WDOGPARMS=2
CONFIG_MM_REGIONS=2
CONFIG_NFILE_DESCRIPTORS=8
CONFIG_NFILE_STREAMS=8
CONFIG_NSH_ARCHINIT=y
CONFIG_NSH_BUILTIN_APPS=y
CONFIG_NSH_FILEIOSIZE=512
CONFIG_NSH_LINELEN=64
CONFIG_NSH_READLINE=y
CONFIG_PREALLOC_MQ_MSGS=4
CONFIG_PREALLOC_TIMERS=4
CONFIG_PREALLOC_WDOGS=16
CONFIG_RAM_SIZE=114688
CONFIG_RAM_START=0x20000000
CONFIG_RAW_BINARY=y
CONFIG_RR_INTERVAL=200
CONFIG_SCHED_WAITPID=y
CONFIG_SDCLONE_DISABLE=y
CONFIG_START_DAY=6
CONFIG_START_MONTH=12
CONFIG_START_YEAR=2011
CONFIG_STM32L4_USART1=y
CONFIG_SYSTEM_NSH=y
CONFIG_USART1_SERIAL_CONSOLE=y
CONFIG_USER_ENTRYPOINT="nsh_main"
CONFIG_WATCHDOG=y
```

## configs/bambino-200e/Kconfig
```kconfig
#
# For a description of the syntax of this configuration file,
# see the file kconfig-language.txt in the NuttX tools repository.
#

if ARCH_BOARD_BAMBINO_200E

config CXX_LINK_GNUTOOL_LIB
	bool "Link to GNU Toolchain Libraries"
	default n
	depends on ARM_TOOLCHAIN_GNU
	---help---
		This option enable NuttX build system to link with GNU Toolchain
		libraries. Mainly stdlib++ and newlib nano.

endif
```

## configs/bambino-200e/max31855/defconfig
```kconfig
# CONFIG_ARCH_FPU is not set
# CONFIG_NSH_DISABLE_IFCONFIG is not set
# CONFIG_NSH_DISABLE_PS is not set
CONFIG_ARCH="arm"
CONFIG_ARCH_BOARD="bambino-200e"
CONFIG_ARCH_BOARD_BAMBINO_200E=y
CONFIG_ARCH_CHIP_LPC4330FBD144=y
CONFIG_ARCH_CHIP_LPC43XX=y
CONFIG_ARCH_STACKDUMP=y
CONFIG_ARCH_STDARG_H=y
CONFIG_BOARD_INITIALIZE=y
CONFIG_BOARD_LOOPSPERMSEC=18535
CONFIG_BUILTIN=y
CONFIG_CDCACM=y
CONFIG_DEBUG_SYMBOLS=y
CONFIG_EXAMPLES_MAX31855=y
CONFIG_EXAMPLES_TIMER=y
CONFIG_FAT_LCNAMES=y
CONFIG_FAT_LFN=y
CONFIG_FS_FAT=y
CONFIG_LPC43_BOOT_SPIFI=y
CONFIG_LPC43_SSP0=y
CONFIG_LPC43_SSP1=y
CONFIG_LPC43_TMR0=y
CONFIG_LPC43_UART1=y
CONFIG_LPC43_USB0=y
CONFIG_MAX_TASKS=16
CONFIG_MAX_WDOGPARMS=2
CONFIG_MM_REGIONS=2
CONFIG_NFILE_DESCRIPTORS=8
CONFIG_NFILE_STREAMS=8
CONFIG_NSH_ARCHINIT=y
CONFIG_NSH_BUILTIN_APPS=y
CONFIG_NSH_FILEIOSIZE=512
CONFIG_NSH_LINELEN=64
CONFIG_NSH_READLINE=y
CONFIG_PREALLOC_MQ_MSGS=4
CONFIG_PREALLOC_TIMERS=4
CONFIG_PREALLOC_WDOGS=4
CONFIG_RAM_SIZE=131072
CONFIG_RAM_START=0x10000000
CONFIG_RAW_BINARY=y
CONFIG_RR_INTERVAL=200
CONFIG_SCHED_WAITPID=y
CONFIG_SDCLONE_DISABLE=y
CONFIG_SENSORS=y
CONFIG_SENSORS_MAX31855=y
CONFIG_START_DAY=11
CONFIG_START_MONTH=7
CONFIG_START_YEAR=2012
CONFIG_SYMTAB_ORDEREDBYNAME=y
CONFIG_SYSTEM_CDCACM=y
CONFIG_SYSTEM_CDCACM_DEVMINOR=1
CONFIG_SYSTEM_NSH=y
CONFIG_TASK_NAME_SIZE=0
CONFIG_TIMER=y
CONFIG_UART1_SERIAL_CONSOLE=y
CONFIG_USBDEV=y
CONFIG_USER_ENTRYPOINT="nsh_main"
CONFIG_WDOG_INTRESERVE=0
```

## configs/c5471evm/httpd/defconfig
```kconfig
# CONFIG_STANDARD_SERIAL is not set
CONFIG_ARCH="arm"
CONFIG_ARCH_BOARD="c5471evm"
CONFIG_ARCH_BOARD_C5471EVM=y
CONFIG_ARCH_CHIP_C5471=y
CONFIG_ARCH_STACKDUMP=y
CONFIG_ARM_TOOLCHAIN_BUILDROOT=y
CONFIG_BOARD_LOOPSPERMSEC=1250
CONFIG_DISABLE_ENVIRON=y
CONFIG_DISABLE_MOUNTPOINT=y
CONFIG_DISABLE_MQUEUE=y
CONFIG_DISABLE_POLL=y
CONFIG_EXAMPLES_WEBSERVER=y
CONFIG_IDLETHREAD_STACKSIZE=4096
CONFIG_MAX_TASKS=64
CONFIG_NET=y
CONFIG_NETUTILS_NETLIB=y
CONFIG_NETUTILS_WEBSERVER=y
CONFIG_NET_ICMP=y
CONFIG_NET_MAX_LISTENPORTS=8
CONFIG_NET_SOCKOPTS=y
CONFIG_NET_TCP=y
CONFIG_NET_TCPBACKLOG=y
CONFIG_NET_TCP_CONNS=16
CONFIG_NFILE_DESCRIPTORS=8
CONFIG_NFILE_STREAMS=8
CONFIG_PREALLOC_WDOGS=8
CONFIG_PTHREAD_STACK_DEFAULT=4096
CONFIG_RAM_SIZE=285212672
CONFIG_RAM_START=0
CONFIG_RRLOAD_BINARY=y
CONFIG_RR_INTERVAL=200
CONFIG_SCHED_HPWORK=y
CONFIG_SDCLONE_DISABLE=y
CONFIG_START_DAY=13
CONFIG_START_MONTH=2
CONFIG_START_YEAR=2007
CONFIG_TASK_NAME_SIZE=0
CONFIG_USERMAIN_STACKSIZE=4096
CONFIG_USER_ENTRYPOINT="webserver_main"
CONFIG_WATCHDOG=y
CONFIG_WDOG_INTRESERVE=1
```

## configs/c5471evm/nsh/defconfig
```kconfig
# CONFIG_NSH_CONSOLE is not set
# CONFIG_NSH_DISABLE_IFCONFIG is not set
# CONFIG_NSH_DISABLE_PS is not set
# CONFIG_STANDARD_SERIAL is not set
CONFIG_ARCH="arm"
CONFIG_ARCH_BOARD="c5471evm"
CONFIG_ARCH_BOARD_C5471EVM=y
CONFIG_ARCH_CHIP_C5471=y
CONFIG_ARCH_STACKDUMP=y
CONFIG_ARM_TOOLCHAIN_BUILDROOT=y
CONFIG_BOARD_LOOPSPERMSEC=1250
CONFIG_DISABLE_ENVIRON=y
CONFIG_DISABLE_MOUNTPOINT=y
CONFIG_DISABLE_MQUEUE=y
CONFIG_DISABLE_POLL=y
CONFIG_IDLETHREAD_STACKSIZE=4096
CONFIG_MAX_TASKS=16
CONFIG_NET=y
CONFIG_NETDB_DNSCLIENT=y
CONFIG_NETDB_DNSCLIENT_ENTRIES=4
CONFIG_NETDB_DNSSERVER_NOADDR=y
CONFIG_NETUTILS_TELNETD=y
CONFIG_NETUTILS_TFTPC=y
CONFIG_NETUTILS_WEBCLIENT=y
CONFIG_NET_BROADCAST=y
CONFIG_NET_ICMP=y
CONFIG_NET_MAX_LISTENPORTS=8
CONFIG_NET_SOCKOPTS=y
CONFIG_NET_STATISTICS=y
CONFIG_NET_TCP=y
CONFIG_NET_UDP=y
CONFIG_NET_UDP_CHECKSUMS=y
CONFIG_NFILE_DESCRIPTORS=8
CONFIG_NFILE_STREAMS=8
CONFIG_NSH_NOMAC=y
CONFIG_NSH_READLINE=y
CONFIG_PREALLOC_WDOGS=8
CONFIG_PTHREAD_STACK_DEFAULT=4096
CONFIG_RAM_SIZE=285212672
CONFIG_RAM_START=0
CONFIG_RRLOAD_BINARY=y
CONFIG_RR_INTERVAL=200
CONFIG_SCHED_HPWORK=y
CONFIG_SDCLONE_DISABLE=y
CONFIG_START_DAY=13
CONFIG_START_MONTH=2
CONFIG_START_YEAR=2007
CONFIG_SYSTEM_NSH=y
CONFIG_TASK_NAME_SIZE=0
CONFIG_USERMAIN_STACKSIZE=4096
CONFIG_USER_ENTRYPOINT="nsh_main"
CONFIG_WATCHDOG=y
CONFIG_WDOG_INTRESERVE=1
```

## configs/cc3200-launchpad/nsh/defconfig
```kconfig
# CONFIG_ARCH_FPU is not set
CONFIG_ARCH_BOARD_CC3200_LAUNCHPAD=y
CONFIG_ARCH_BOARD="cc3200-launchpad"
CONFIG_ARCH_CHIP_CC3200=y
CONFIG_ARCH_CHIP_TIVA=y
CONFIG_ARCH_IRQPRIO=y
CONFIG_ARCH="arm"
CONFIG_ARMV7M_USEBASEPRI=y
CONFIG_BOARD_LOOPSPERMSEC=4000
CONFIG_BOOT_RUNFROMISRAM=y
CONFIG_BUILTIN_PROXY_STACKSIZE=512
CONFIG_BUILTIN=y
CONFIG_DISABLE_POLL=y
CONFIG_EXAMPLES_NSH=y
CONFIG_EXPERIMENTAL=y
CONFIG_FS_BINFS=y
CONFIG_FS_PROCFS=y
CONFIG_MAX_TASKS=8
CONFIG_MAX_WDOGPARMS=2
CONFIG_MM_REGIONS=2
CONFIG_NFILE_DESCRIPTORS=8
CONFIG_NFILE_STREAMS=8
CONFIG_NSH_BUILTIN_APPS=y
CONFIG_NSH_FILEIOSIZE=512
CONFIG_NSH_LINELEN=64
CONFIG_NSH_READLINE=y
CONFIG_NXFLAT=y
CONFIG_PREALLOC_TIMERS=2
CONFIG_PREALLOC_WDOGS=8
CONFIG_RAM_SIZE=192000
CONFIG_RAM_START=0x20004000
CONFIG_RAW_BINARY=y
CONFIG_RR_INTERVAL=100
CONFIG_SCHED_WAITPID=y
CONFIG_START_DAY=24
CONFIG_START_MONTH=8
CONFIG_START_YEAR=2014
CONFIG_STDIO_BUFFER_SIZE=128
CONFIG_TASK_NAME_SIZE=0
CONFIG_TIVA_UART0=y
CONFIG_UART0_RXBUFSIZE=128
CONFIG_UART0_SERIAL_CONSOLE=y
CONFIG_UART0_TXBUFSIZE=128
CONFIG_USER_ENTRYPOINT="nsh_main"
CONFIG_USERMAIN_STACKSIZE=4096
CONFIG_WDOG_INTRESERVE=2
```

## configs/clicker2-stm32/Kconfig
```kconfig
#
# For a description of the syntax of this configuration file,
# see the file kconfig-language.txt in the NuttX tools repository.
#

if ARCH_BOARD_CLICKER2_STM32

config CLICKER2_STM32_MB1_SPI
	bool "mikroBUS1 SPI"
	default n
	select STM32_SPI3
	---help---
		Enable SPI support on mikroBUS1 (STM32 SPI3)

config CLICKER2_STM32_MB2_SPI
	bool "mikroBUS2 SPI"
	default n
	select STM32_SPI2
	---help---
		Enable SPI support on mikroBUS1 (STM32 SPI2)

config CLICKER2_STM32_MB1_BEE
	bool "mikroBUS1 MRF24J40 BEE"
	default y
	depends on IEEE802154_MRF24J40
	select CLICKER2_STM32_MB1_SPI
	---help---
		Enable support for MRF24J40 BEE on mikroBUS1

config CLICKER2_STM32_MB2_BEE
	bool "mikroBUS2 MRF24J40 BEE"
	default n
	depends on IEEE802154_MRF24J40
	select CLICKER2_STM32_MB2_SPI
	---help---
		Enable support for MRF24J40 BEE on mikroBUS2

config CLICKER2_STM32_MRF24J40LH_VERBOSE
	bool "Verbose MRF24J40 lowerhalf"
	default n
	depends on IEEE802154_MRF24J40 && DEBUG_WIRELESS_INFO
	---help---
		Enable verbose syslog for MRF24J40 lowerhalf

config CLICKER2_STM32_MB1_XBEE
	bool "mikroBUS1 XBee radio"
	default n
	depends on IEEE802154_XBEE
	select CLICKER2_STM32_MB1_SPI
	---help---
		Enable support for XBee radio on mikroBUS1

config CLICKER2_STM32_MB2_XBEE
	bool "mikroBUS2 XBee radio"
	default n
	depends on IEEE802154_XBEE
	select CLICKER2_STM32_MB2_SPI
	---help---
		Enable support for XBee on mikroBUS2

config CLICKER2_STM32_XBEELH_VERBOSE
	bool "Verbose XBee lowerhalf"
	default n
	depends on IEEE802154_XBEE && DEBUG_WIRELESS_INFO
	---help---
		Enable verbose syslog for XBee lowerhalf

endif # ARCH_BOARD_CLICKER2_STM32
```

## configs/compal_e99/Kconfig
```kconfig
#
# For a description of the syntax of this configuration file,
# see the file kconfig-language.txt in the NuttX tools repository.
#

if ARCH_BOARD_COMPALE99

config COMPALE99_LCD_SSD1783
	bool "SSD1783 LCD support"
	default y
	select LCD

endif
```

## configs/dk-tm4c129x/ipv6/defconfig
```kconfig
# CONFIG_ARCH_FPU is not set
# CONFIG_NET_IPv4 is not set
# CONFIG_NET_UDP_READAHEAD is not set
# CONFIG_NSH_DISABLE_IFCONFIG is not set
# CONFIG_NSH_DISABLE_PS is not set
CONFIG_ARCH="arm"
CONFIG_ARCH_BOARD="dk-tm4c129x"
CONFIG_ARCH_BOARD_DK_TM4C129X=y
CONFIG_ARCH_BUTTONS=y
CONFIG_ARCH_CHIP_TIVA=y
CONFIG_ARCH_CHIP_TM4C129=y
CONFIG_ARCH_CHIP_TM4C129XNC=y
CONFIG_ARCH_CHIP_TM4C=y
CONFIG_ARCH_IRQBUTTONS=y
CONFIG_ARCH_STACKDUMP=y
CONFIG_ARMV7M_TOOLCHAIN_CODESOURCERYW=y
CONFIG_BOARD_LOOPSPERMSEC=11401
CONFIG_BUILTIN=y
CONFIG_HOST_WINDOWS=y
CONFIG_I2CTOOL_MAXBUS=6
CONFIG_I2CTOOL_MINBUS=6
CONFIG_LIBC_FLOATINGPOINT=y
CONFIG_LIBM=y
CONFIG_MAX_TASKS=16
CONFIG_MAX_WDOGPARMS=2
CONFIG_NET=y
CONFIG_NET_BROADCAST=y
CONFIG_NET_ETH_PKTSIZE=590
CONFIG_NET_ICMPv6=y
CONFIG_NET_ICMPv6_NEIGHBOR=y
CONFIG_NET_ICMPv6_SOCKET=y
CONFIG_NET_IPv6=y
CONFIG_NET_SOCKOPTS=y
CONFIG_NET_SOLINGER=y
CONFIG_NET_STATISTICS=y
CONFIG_NET_TCP=y
CONFIG_NET_TCPBACKLOG=y
CONFIG_NET_TCP_WRITE_BUFFERS=y
CONFIG_NET_UDP=y
CONFIG_NFILE_DESCRIPTORS=8
CONFIG_NFILE_STREAMS=8
CONFIG_NSH_ARCHINIT=y
CONFIG_NSH_BUILTIN_APPS=y
CONFIG_NSH_FILEIOSIZE=512
CONFIG_NSH_IPv6NETMASK_8=0xff80
CONFIG_NSH_LINELEN=64
CONFIG_NSH_NETINIT_MONITOR=y
CONFIG_NSH_NETINIT_THREAD=y
CONFIG_NSH_READLINE=y
CONFIG_PREALLOC_MQ_MSGS=4
CONFIG_PREALLOC_TIMERS=4
CONFIG_PREALLOC_WDOGS=4
CONFIG_RAM_SIZE=262144
CONFIG_RAM_START=0x20000000
CONFIG_RAW_BINARY=y
CONFIG_RR_INTERVAL=200
CONFIG_SCHED_HPWORK=y
CONFIG_SCHED_WAITPID=y
CONFIG_SENSORS=y
CONFIG_SENSORS_LM75=y
CONFIG_START_DAY=24
CONFIG_START_MONTH=3
CONFIG_START_YEAR=2013
CONFIG_SYSTEM_I2CTOOL=y
CONFIG_SYSTEM_LM75=y
CONFIG_SYSTEM_NSH=y
CONFIG_SYSTEM_PING6=y
CONFIG_TIVA_BOARDMAC=y
CONFIG_TIVA_ETHERNET=y
CONFIG_TIVA_GPIOP_IRQS=y
CONFIG_TIVA_I2C6=y
CONFIG_TIVA_PHY_INTERRUPTS=y
CONFIG_TIVA_UART0=y
CONFIG_UART0_SERIAL_CONSOLE=y
CONFIG_USER_ENTRYPOINT="nsh_main"
CONFIG_WDOG_INTRESERVE=0
```

## configs/ea3131/pgnsh/defconfig
```kconfig
# CONFIG_NSH_DISABLE_IFCONFIG is not set
# CONFIG_NSH_DISABLE_PS is not set
CONFIG_ARCH="arm"
CONFIG_ARCH_BOARD="ea3131"
CONFIG_ARCH_BOARD_EA3131=y
CONFIG_ARCH_CHIP_LPC3131=y
CONFIG_ARCH_CHIP_LPC31XX=y
CONFIG_ARCH_LOWVECTORS=y
CONFIG_ARCH_STACKDUMP=y
CONFIG_ARM_TOOLCHAIN_CODESOURCERYW=y
CONFIG_BOARD_LOOPSPERMSEC=16945
CONFIG_BOOT_RUNFROMISRAM=y
CONFIG_BUILD_2PASS=y
CONFIG_DISABLE_POLL=y
CONFIG_FS_FAT=y
CONFIG_HOST_WINDOWS=y
CONFIG_LPC31_SPI=y
CONFIG_LPC31_UART=y
CONFIG_M25P_SPIMODE=3
CONFIG_MAX_TASKS=16
CONFIG_MAX_WDOGPARMS=2
CONFIG_MMCSD=y
CONFIG_MTD=y
CONFIG_MTD_M25P=y
CONFIG_NFILE_DESCRIPTORS=8
CONFIG_NFILE_STREAMS=8
CONFIG_NSH_ARCHINIT=y
CONFIG_NSH_FILEIOSIZE=512
CONFIG_NSH_LINELEN=64
CONFIG_NSH_READLINE=y
CONFIG_PAGING=y
CONFIG_PAGING_BLOCKINGFILL=y
CONFIG_PAGING_NDATA=32
CONFIG_PAGING_NPPAGED=96
CONFIG_PAGING_NVPAGED=384
CONFIG_PAGING_PAGESIZE=1024
CONFIG_PAGING_STACKSIZE=2048
CONFIG_PASS1_BUILDIR="configs/ea3131/locked"
CONFIG_PASS1_OBJECT="locked.r"
CONFIG_PREALLOC_MQ_MSGS=4
CONFIG_PREALLOC_TIMERS=4
CONFIG_PREALLOC_WDOGS=4
CONFIG_RAM_SIZE=196608
CONFIG_RAM_START=0x11028000
CONFIG_RAM_VSTART=0x11028000
CONFIG_RAW_BINARY=y
CONFIG_RR_INTERVAL=200
CONFIG_SDCLONE_DISABLE=y
CONFIG_START_DAY=15
CONFIG_START_MONTH=3
CONFIG_START_YEAR=2010
CONFIG_SYSTEM_NSH=y
CONFIG_TASK_NAME_SIZE=0
CONFIG_UART_SERIAL_CONSOLE=y
CONFIG_USER_ENTRYPOINT="nsh_main"
CONFIG_WDOG_INTRESERVE=0
```
