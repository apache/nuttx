## configs/ea3131/usbserial/defconfig
```kconfig
CONFIG_ARCH="arm"
CONFIG_ARCH_BOARD="ea3131"
CONFIG_ARCH_BOARD_EA3131=y
CONFIG_ARCH_CHIP_LPC3131=y
CONFIG_ARCH_CHIP_LPC31XX=y
CONFIG_ARCH_LOWVECTORS=y
CONFIG_ARCH_ROMPGTABLE=y
CONFIG_ARCH_STACKDUMP=y
CONFIG_ARM_TOOLCHAIN_CODESOURCERYW=y
CONFIG_BOARD_LOOPSPERMSEC=16945
CONFIG_BOOT_RUNFROMISRAM=y
CONFIG_DEV_LOWCONSOLE=y
CONFIG_DISABLE_ENVIRON=y
CONFIG_DISABLE_POLL=y
CONFIG_EXAMPLES_USBSERIAL=y
CONFIG_HOST_WINDOWS=y
CONFIG_LIB_BOARDCTL=y
CONFIG_LPC31_UART=y
CONFIG_LPC31_USBOTG=y
CONFIG_MAX_TASKS=16
CONFIG_MAX_WDOGPARMS=2
CONFIG_NFILE_DESCRIPTORS=8
CONFIG_NFILE_STREAMS=8
CONFIG_PL2303=y
CONFIG_PL2303_EPBULKIN=1
CONFIG_PL2303_EPINTIN=3
CONFIG_PL2303_PRODUCTSTR="USBdev Serial"
CONFIG_PL2303_RXBUFSIZE=512
CONFIG_PL2303_TXBUFSIZE=512
CONFIG_PL2303_VENDORSTR="Nuttx"
CONFIG_PREALLOC_MQ_MSGS=4
CONFIG_PREALLOC_TIMERS=4
CONFIG_PREALLOC_WDOGS=8
CONFIG_RAM_SIZE=196608
CONFIG_RAM_START=0x11028000
CONFIG_RAM_VSTART=0x11028000
CONFIG_RAW_BINARY=y
CONFIG_RR_INTERVAL=200
CONFIG_SCHED_HPWORK=y
CONFIG_SCHED_HPWORKPRIORITY=192
CONFIG_SCHED_HPWORKSTACKSIZE=1024
CONFIG_SDCLONE_DISABLE=y
CONFIG_START_DAY=28
CONFIG_START_MONTH=3
CONFIG_START_YEAR=2010
CONFIG_TASK_NAME_SIZE=0
CONFIG_UART_SERIAL_CONSOLE=y
CONFIG_USBDEV=y
CONFIG_USBDEV_DUALSPEED=y
CONFIG_USBDEV_TRACE=y
CONFIG_USER_ENTRYPOINT="usbserial_main"
CONFIG_WDOG_INTRESERVE=0
```

## configs/ea3152/ostest/defconfig
```kconfig
CONFIG_ARCH="arm"
CONFIG_ARCH_BOARD="ea3152"
CONFIG_ARCH_BOARD_EA3152=y
CONFIG_ARCH_CHIP_LPC3152=y
CONFIG_ARCH_CHIP_LPC31XX=y
CONFIG_ARCH_LOWVECTORS=y
CONFIG_ARCH_ROMPGTABLE=y
CONFIG_ARCH_STACKDUMP=y
CONFIG_ARM_TOOLCHAIN_BUILDROOT=y
CONFIG_BOARD_LOOPSPERMSEC=16945
CONFIG_BOOT_RUNFROMISRAM=y
CONFIG_DEV_LOWCONSOLE=y
CONFIG_DISABLE_ENVIRON=y
CONFIG_DISABLE_MOUNTPOINT=y
CONFIG_DISABLE_POLL=y
CONFIG_EXAMPLES_OSTEST=y
CONFIG_EXAMPLES_OSTEST_NBARRIER_THREADS=3
CONFIG_EXAMPLES_OSTEST_STACKSIZE=2048
CONFIG_HOST_WINDOWS=y
CONFIG_LPC31_UART=y
CONFIG_MAX_TASKS=16
CONFIG_MAX_WDOGPARMS=2
CONFIG_NFILE_DESCRIPTORS=8
CONFIG_NFILE_STREAMS=8
CONFIG_PREALLOC_MQ_MSGS=4
CONFIG_PREALLOC_TIMERS=4
CONFIG_PREALLOC_WDOGS=4
CONFIG_RAM_SIZE=196608
CONFIG_RAM_START=0x11028000
CONFIG_RAM_VSTART=0x11028000
CONFIG_RAW_BINARY=y
CONFIG_RR_INTERVAL=200
CONFIG_SDCLONE_DISABLE=y
CONFIG_START_DAY=26
CONFIG_START_MONTH=12
CONFIG_START_YEAR=2009
CONFIG_TASK_NAME_SIZE=0
CONFIG_UART_SERIAL_CONSOLE=y
CONFIG_USER_ENTRYPOINT="ostest_main"
CONFIG_WDOG_INTRESERVE=0
```

## configs/esp32-core/Kconfig
```kconfig
#
# For a description of the syntax of this configuration file,
# see the file kconfig-language.txt in the NuttX tools repository.
#

if ARCH_BOARD_ESP32CORE

choice
	prompt "On-board Crystal Frequency"
	default ESP32CORE_XTAL_40MZ

config ESP32CORE_XTAL_40MZ
	bool "40MHz"

config ESP32CORE_XTAL_26MHz
	bool "26MHz"

endchoice # On-board Crystal Frequency

config ESP32CORE_RUN_IRAM
	bool "Run from IRAM"
	default n
	---help---
		The default configuration is set up run from IRAM.  However, the
		current (2016-11-14) OpenOCD for ESP32 does not support writing to
		FLASH.  This option sets up the liner scripts to support execution
		from IRAM.  In this case, OpenOCD can be used to load directly into
		IRAM.

endif # ARCH_BOARD_ESP32CORE
```
