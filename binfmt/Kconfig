## binfmt/Kconfig
```kconfig
#
# For a description of the syntax of this configuration file,
# see the file kconfig-language.txt in the NuttX tools repository.
#

config BINFMT_DISABLE
	bool "Disable BINFMT support"
	default DEFAULT_SMALL
	---help---
		By default, support for loadable binary formats is built.  This logic
		may be suppressed by defining this setting.

if !BINFMT_DISABLE

config PATH_INITIAL
	string "Initial PATH Value"
	default ""
	depends on LIBC_ENVPATH
	---help---
		The initial value of the PATH variable.  This is the colon-separated
		list of absolute paths.  E.g., "/bin:/usr/bin:/sbin"

config BINFMT_LOADABLE
	bool
	select MODULES
	default n
	---help---
		Automatically selected if a loadable binary format is selected.

config PIC
	bool "Executable elf position-independent support"
	default n
	---help---
		Automatically selected if the binary format requires position
		independent operation.

config NXFLAT
	bool "Enable the NXFLAT Binary Format"
	default n
	select BINFMT_LOADABLE
	select PIC
	---help---
		Enable support for the NXFLAT binary format.  Default: n

if NXFLAT
source "binfmt/libnxflat/Kconfig"
endif

config ELF
	bool "Enable the ELF Binary Format"
	default n
	select BINFMT_LOADABLE
	select LIBC_ELF
	---help---
		Enable support for the ELF binary format.  Default: n

if ELF
config ELF_STACKSIZE
	int "ELF Stack Size"
	default DEFAULT_TASK_STACKSIZE
	---help---
		This is the default stack size that will be used when starting ELF binaries.

config FDPIC
	bool "FDPIC modules"
	default n
	select PIC
	depends on ARCH_HAVE_ELF_FDPIC
	depends on BUILD_FLAT
	---help---
		Load ELF modules built for the FDPIC ABI.

		An FDPIC module places its read-only and writable segments
		independently, so its text can be executed directly out of flash
		while only the writable segment is copied to RAM, once per running
		instance.  A filesystem that can show its media, such as XIPFS or
		ROMFS, gives that result.  On any other filesystem the loader copies
		the text to RAM, and the module runs but shares nothing.

		Building a module needs an arm-uclinuxfdpiceabi linker.  The stock
		arm-none-eabi compiler emits correct FDPIC objects for both C and
		C++, so only the link needs it.

		What this adds over the position independent ELF support already
		present is a function pointer that carries its own data base, as a
		two word descriptor rather than a bare code address.  That is what
		lets a module be called back on a thread it did not create, such as
		the work queue worker that runs a SIGEV_THREAD notification.

		Selecting this makes ten libc and sched entry points that can
		accept a callback from a module resolve such a descriptor before
		storing or branching to it.  Each costs a register read and a
		branch on a path that is not hot.

		FDPIC is specified only for ARM Thumb-2.
endif
endif

config BINFMT_CONSTRUCTORS
	bool "C++ Static Constructor Support"
	default n
	depends on HAVE_CXX && ELF
	---help---
		Built-in support for C++ constructors in loaded modules.  Currently
		only support for ELF binary formats.

choice
	prompt "File output format"
	default BINFMT_ELF_RELOCATABLE
	---help---
		Defines the type of ELF file produced by the NuttX build system.

config BINFMT_ELF_RELOCATABLE
	bool "Relocatable ELF"
	---help---
		Produce a relocatable object as output. This is also known as partial linking.

config BINFMT_ELF_EXECUTABLE
	bool "Executable ELF"
	depends on ARCH_HAVE_ELF_EXECUTABLE
	---help---
		Produce a full linked executable object as output.

endchoice

config BINFMT_STORE_FILENAME
	bool "Store the binary filename"
	default n
	---help---
		Store the filename of the loaded binary
```

## boards/arm/common/stm32/Kconfig
```kconfig
#
# For a description of the syntax of this configuration file,
# see the file kconfig-language.txt in the NuttX tools repository.
#

if STM32_FOC

menuconfig BOARD_STM32_IHM07M1
	bool "X-NUCLEO-IHM07M1 board support"
	default n
	---help---
		Board based on the L6230 DMOS driver.

if BOARD_STM32_IHM07M1

config BOARD_STM32_IHM07M1_VBUS
	bool "X-NUCLEO-IHM07M1 board VBUS sense"
	default n

config BOARD_STM32_IHM07M1_POT
	bool "X-NUCLEO-IHM07M1 board POT support"
	default n

endif # BOARD_STM32_IHM07M1

menuconfig BOARD_STM32_IHM08M1
	bool "X-NUCLEO-IHM08M1 board support"
	default n
	select STM32_FOC_HAS_PWM_COMPLEMENTARY
	---help---
		Board based on the discrete L6398 gate drivers and STL220N6F7 POWER MOSFETs.

if BOARD_STM32_IHM08M1

config BOARD_STM32_IHM08M1_VBUS
	bool "X-NUCLEO-IHM08M1 board VBUS sense"
	default n

config BOARD_STM32_IHM08M1_POT
	bool "X-NUCLEO-IHM08M1 board POT support"
	default n

endif # BOARD_STM32_IHM08M1

menuconfig BOARD_STM32_IHM16M1
	bool "X-NUCLEO-IHM16M1 board support"
	default n
	---help---
		Board based on the STSPIN830 three-phase brushless motor driver.

if BOARD_STM32_IHM16M1

config BOARD_STM32_IHM16M1_VBUS
	bool "X-NUCLEO-IHM16M1 board VBUS sense"
	default n

config BOARD_STM32_IHM16M1_POT
	bool "X-NUCLEO-IHM16M1 board POT support"
	default n

endif # BOARD_STM32_IHM16M1

endif # STM32_FOC

if SENSORS_HALL3PHASE

config BOARD_STM32_HALL3PHASE_SAMPLES
	int "3-phase Hall effect sensor number of samples"
	default 10

endif # SENSORS_HALL3PHASE

config STM32_ROMFS
	bool "Automount baked-in ROMFS image"
	default n
	depends on FS_ROMFS
	---help---
		Select STM32_ROMFS_IMAGEFILE, STM32_ROMFS_DEV_MINOR, STM32_ROMFS_MOUNTPOINT

config STM32_ROMFS_DEV_MINOR
	int "Minor for the block device backing the data"
	depends on STM32_ROMFS
	default 64

config STM32_ROMFS_MOUNTPOINT
	string "Mountpoint of the custom romfs image"
	depends on STM32_ROMFS
	default "/rom"

config STM32_ROMFS_IMAGEFILE
	string "ROMFS image file to include into build"
	depends on STM32_ROMFS
	default "../../../rom.img"

config STM32_SPI_TEST
	bool "Enable SPI test"
	default n
	---help---
		Enable Spi test - initialize and configure SPI to send
		STM32_SPI_TEST_MESSAGE text. The text is sent on the
		selected SPI Buses with the configured parameters.
		Note the CS lines will not be asserted.

if STM32_SPI_TEST

config STM32_SPI_TEST_MESSAGE
	string "Text to Send on SPI Bus(es)"
	default "Hello World"
	depends on STM32_SPI_TEST
	---help---
		Text to sent on SPI bus(es)

config STM32_SPI1_TEST
	bool "Test SPI bus 1"
	default n
	depends on STM32_SPI_TEST
	---help---
		Enable Spi test - on SPI BUS 1

if STM32_SPI1_TEST

config STM32_SPI1_TEST_FREQ
	int "SPI 1 Clock Freq in Hz"
	default 1000000
	depends on STM32_SPI1_TEST
	---help---
		Sets SPI 1 Clock Freq

config STM32_SPI1_TEST_BITS
	int "SPI 1 number of bits"
	default 8
	depends on STM32_SPI1_TEST
	---help---
		Sets SPI 1 bit length

choice
	prompt "SPI BUS 1 Clock Mode"
	default STM32_SPI1_TEST_MODE3
	---help---
		Sets SPI 1 clock mode

config STM32_SPI1_TEST_MODE0
	bool "CPOL=0 CPHA=0"

config STM32_SPI1_TEST_MODE1
	bool "CPOL=0 CPHA=1"

config STM32_SPI1_TEST_MODE2
	bool "CPOL=1 CPHA=0"

config STM32_SPI1_TEST_MODE3
	bool "CPOL=1 CPHA=1"

endchoice # "SPI BUS 1 Clock Mode"

endif # STM32_SPI1_TEST

config STM32_SPI2_TEST
	bool "Test SPI bus 2"
	default n
	depends on STM32_SPI_TEST
	---help---
		Enable Spi test - on SPI BUS 2

if STM32_SPI2_TEST

config STM32_SPI2_TEST_FREQ
	int "SPI 2 Clock Freq in Hz"
	default 12000000
	depends on STM32_SPI2_TEST
	---help---
		Sets SPI 2 Clock Freq

config STM32_SPI2_TEST_BITS
	int "SPI 2 number of bits"
	default 8
	depends on STM32_SPI2_TEST
	---help---
		Sets SPI 2 bit length

choice
	prompt "SPI BUS 2 Clock Mode"
	default STM32_SPI2_TEST_MODE3
	---help---
		Sets SPI 2 clock mode

config STM32_SPI2_TEST_MODE0
	bool "CPOL=0 CPHA=0"

config STM32_SPI2_TEST_MODE1
	bool "CPOL=0 CPHA=1"

config STM32_SPI2_TEST_MODE2
	bool "CPOL=1 CPHA=0"

config STM32_SPI2_TEST_MODE3
	bool "CPOL=1 CPHA=1"

endchoice # "SPI BUS 2 Clock Mode"

endif # STM32_SPI2_TEST

config STM32_SPI3_TEST
	bool "Test SPI bus 3"
	default n
	depends on STM32_SPI_TEST
	---help---
		Enable Spi test - on SPI BUS 3

if STM32_SPI3_TEST

config STM32_SPI3_TEST_FREQ
	int "SPI 3 Clock Freq in Hz"
	default 40000000
	depends on STM32_SPI3_TEST
	---help---
		Sets SPI 3 Clock Freq

config STM32_SPI3_TEST_BITS
	int "SPI 3 number of bits"
	default 8
	depends on STM32_SPI3_TEST
	---help---
		Sets SPI 3 bit length

choice
	prompt "SPI BUS 3 Clock Mode"
	default STM32_SPI3_TEST_MODE3
	---help---
		Sets SPI 3 clock mode

config STM32_SPI3_TEST_MODE0
	bool "CPOL=0 CPHA=0"

config STM32_SPI3_TEST_MODE1
	bool "CPOL=0 CPHA=1"

config STM32_SPI3_TEST_MODE2
	bool "CPOL=1 CPHA=0"

config STM32_SPI3_TEST_MODE3
	bool "CPOL=1 CPHA=1"

endchoice # "SPI BUS 3 Clock Mode"

endif # STM32_SPI3_TEST
endif # STM32_SPI_TEST

menu "STM32 common timer devices"

config BOARD_STM32_COMMON_TIM1_TIMER
	bool "TIM1 /dev/timer1"
	depends on TIMER && STM32_TIM1

config BOARD_STM32_COMMON_TIM1_ONESHOT
	bool "TIM1 /dev/oneshot1"
	depends on ONESHOT && STM32_ONESHOT && STM32_TIM1 && !BOARD_STM32_COMMON_TIM1_TIMER

config BOARD_STM32_COMMON_TIM2_TIMER
	bool "TIM2 /dev/timer2"
	depends on TIMER && STM32_TIM2

config BOARD_STM32_COMMON_TIM2_ONESHOT
	bool "TIM2 /dev/oneshot2"
	depends on ONESHOT && STM32_ONESHOT && STM32_TIM2 && !BOARD_STM32_COMMON_TIM2_TIMER

config BOARD_STM32_COMMON_TIM3_TIMER
	bool "TIM3 /dev/timer3"
	depends on TIMER && STM32_TIM3

config BOARD_STM32_COMMON_TIM3_ONESHOT
	bool "TIM3 /dev/oneshot3"
	depends on ONESHOT && STM32_ONESHOT && STM32_TIM3 && !BOARD_STM32_COMMON_TIM3_TIMER

config BOARD_STM32_COMMON_TIM4_TIMER
	bool "TIM4 /dev/timer4"
	depends on TIMER && STM32_TIM4

config BOARD_STM32_COMMON_TIM4_ONESHOT
	bool "TIM4 /dev/oneshot4"
	depends on ONESHOT && STM32_ONESHOT && STM32_TIM4 && !BOARD_STM32_COMMON_TIM4_TIMER

config BOARD_STM32_COMMON_TIM5_TIMER
	bool "TIM5 /dev/timer5"
	depends on TIMER && STM32_TIM5

config BOARD_STM32_COMMON_TIM5_ONESHOT
	bool "TIM5 /dev/oneshot5"
	depends on ONESHOT && STM32_ONESHOT && STM32_TIM5 && !BOARD_STM32_COMMON_TIM5_TIMER

config BOARD_STM32_COMMON_TIM6_TIMER
	bool "TIM6 /dev/timer6"
	depends on TIMER && STM32_TIM6

config BOARD_STM32_COMMON_TIM6_ONESHOT
	bool "TIM6 /dev/oneshot6"
	depends on ONESHOT && STM32_ONESHOT && STM32_TIM6 && !BOARD_STM32_COMMON_TIM6_TIMER

config BOARD_STM32_COMMON_TIM7_TIMER
	bool "TIM7 /dev/timer7"
	depends on TIMER && STM32_TIM7

config BOARD_STM32_COMMON_TIM7_ONESHOT
	bool "TIM7 /dev/oneshot7"
	depends on ONESHOT && STM32_ONESHOT && STM32_TIM7 && !BOARD_STM32_COMMON_TIM7_TIMER

config BOARD_STM32_COMMON_TIM8_TIMER
	bool "TIM8 /dev/timer8"
	depends on TIMER && STM32_TIM8

config BOARD_STM32_COMMON_TIM8_ONESHOT
	bool "TIM8 /dev/oneshot8"
	depends on ONESHOT && STM32_ONESHOT && STM32_TIM8 && !BOARD_STM32_COMMON_TIM8_TIMER

config BOARD_STM32_COMMON_TIM9_TIMER
	bool "TIM9 /dev/timer9"
	depends on TIMER && STM32_TIM9

config BOARD_STM32_COMMON_TIM9_ONESHOT
	bool "TIM9 /dev/oneshot9"
	depends on ONESHOT && STM32_ONESHOT && STM32_TIM9 && !BOARD_STM32_COMMON_TIM9_TIMER

config BOARD_STM32_COMMON_TIM10_TIMER
	bool "TIM10 /dev/timer10"
	depends on TIMER && STM32_TIM10

config BOARD_STM32_COMMON_TIM10_ONESHOT
	bool "TIM10 /dev/oneshot10"
	depends on ONESHOT && STM32_ONESHOT && STM32_TIM10 && !BOARD_STM32_COMMON_TIM10_TIMER

config BOARD_STM32_COMMON_TIM11_TIMER
	bool "TIM11 /dev/timer11"
	depends on TIMER && STM32_TIM11

config BOARD_STM32_COMMON_TIM11_ONESHOT
	bool "TIM11 /dev/oneshot11"
	depends on ONESHOT && STM32_ONESHOT && STM32_TIM11 && !BOARD_STM32_COMMON_TIM11_TIMER

config BOARD_STM32_COMMON_TIM12_TIMER
	bool "TIM12 /dev/timer12"
	depends on TIMER && STM32_TIM12

config BOARD_STM32_COMMON_TIM12_ONESHOT
	bool "TIM12 /dev/oneshot12"
	depends on ONESHOT && STM32_ONESHOT && STM32_TIM12 && !BOARD_STM32_COMMON_TIM12_TIMER

config BOARD_STM32_COMMON_TIM13_TIMER
	bool "TIM13 /dev/timer13"
	depends on TIMER && STM32_TIM13

config BOARD_STM32_COMMON_TIM13_ONESHOT
	bool "TIM13 /dev/oneshot13"
	depends on ONESHOT && STM32_ONESHOT && STM32_TIM13 && !BOARD_STM32_COMMON_TIM13_TIMER

config BOARD_STM32_COMMON_TIM14_TIMER
	bool "TIM14 /dev/timer14"
	depends on TIMER && STM32_TIM14

config BOARD_STM32_COMMON_TIM14_ONESHOT
	bool "TIM14 /dev/oneshot14"
	depends on ONESHOT && STM32_ONESHOT && STM32_TIM14 && !BOARD_STM32_COMMON_TIM14_TIMER

config BOARD_STM32_COMMON_TIM15_TIMER
	bool "TIM15 /dev/timer15"
	depends on TIMER && STM32_TIM15

config BOARD_STM32_COMMON_TIM15_ONESHOT
	bool "TIM15 /dev/oneshot15"
	depends on ONESHOT && STM32_ONESHOT && STM32_TIM15 && !BOARD_STM32_COMMON_TIM15_TIMER

config BOARD_STM32_COMMON_TIM16_TIMER
	bool "TIM16 /dev/timer16"
	depends on TIMER && STM32_TIM16

config BOARD_STM32_COMMON_TIM16_ONESHOT
	bool "TIM16 /dev/oneshot16"
	depends on ONESHOT && STM32_ONESHOT && STM32_TIM16 && !BOARD_STM32_COMMON_TIM16_TIMER

config BOARD_STM32_COMMON_TIM17_TIMER
	bool "TIM17 /dev/timer17"
	depends on TIMER && STM32_TIM17

config BOARD_STM32_COMMON_TIM17_ONESHOT
	bool "TIM17 /dev/oneshot17"
	depends on ONESHOT && STM32_ONESHOT && STM32_TIM17 && !BOARD_STM32_COMMON_TIM17_TIMER

config BOARD_STM32_COMMON_LPTIM1_TIMER
	bool "LPTIM1 /dev/lptimer1"
	depends on TIMER && STM32_LPTIM1

config BOARD_STM32_COMMON_LPTIM1_ONESHOT
	bool "LPTIM1 /dev/lponeshot1"
	depends on ONESHOT && STM32_LPTIM1 && !BOARD_STM32_COMMON_LPTIM1_TIMER

config BOARD_STM32_COMMON_LPTIM2_TIMER
	bool "LPTIM2 /dev/lptimer2"
	depends on TIMER && STM32_LPTIM2

config BOARD_STM32_COMMON_LPTIM2_ONESHOT
	bool "LPTIM2 /dev/lponeshot2"
	depends on ONESHOT && STM32_LPTIM2 && !BOARD_STM32_COMMON_LPTIM2_TIMER

config BOARD_STM32_COMMON_LPTIM3_TIMER
	bool "LPTIM3 /dev/lptimer3"
	depends on TIMER && STM32_LPTIM3

config BOARD_STM32_COMMON_LPTIM3_ONESHOT
	bool "LPTIM3 /dev/lponeshot3"
	depends on ONESHOT && STM32_LPTIM3 && !BOARD_STM32_COMMON_LPTIM3_TIMER

config BOARD_STM32_COMMON_LPTIM4_TIMER
	bool "LPTIM4 /dev/lptimer4"
	depends on TIMER && STM32_LPTIM4

config BOARD_STM32_COMMON_LPTIM4_ONESHOT
	bool "LPTIM4 /dev/lponeshot4"
	depends on ONESHOT && STM32_LPTIM4 && !BOARD_STM32_COMMON_LPTIM4_TIMER

config BOARD_STM32_COMMON_LPTIM5_TIMER
	bool "LPTIM5 /dev/lptimer5"
	depends on TIMER && STM32_LPTIM5

config BOARD_STM32_COMMON_LPTIM5_ONESHOT
	bool "LPTIM5 /dev/lponeshot5"
	depends on ONESHOT && STM32_LPTIM5 && !BOARD_STM32_COMMON_LPTIM5_TIMER

config BOARD_STM32_COMMON_LPTIM6_TIMER
	bool "LPTIM6 /dev/lptimer6"
	depends on TIMER && STM32_LPTIM6

config BOARD_STM32_COMMON_LPTIM6_ONESHOT
	bool "LPTIM6 /dev/lponeshot6"
	depends on ONESHOT && STM32_LPTIM6 && !BOARD_STM32_COMMON_LPTIM6_TIMER

endmenu # STM32 common timer devices
```
