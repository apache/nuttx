## boards/arm/imxrt/fmu-v6xrt/Kconfig
```kconfig
#
# For a description of the syntax of this configuration file,
# see the file kconfig-language.txt in the NuttX tools repository.
#

if ARCH_BOARD_FMU_V6XRT

choice
	prompt "Boot Flash"
	default FMU_V6XRT_QSPI_FLASH

config FMU_V6XRT_HYPER_FLASH
	bool "HYPER Flash"

config FMU_V6XRT_QSPI_FLASH
	bool "QSPI Flash"

endchoice # Boot Flash

config FMU_V6XRT_SDRAM
	bool "Enable SDRAM"
	default n
	select IMXRT_SEMC_INIT_DONE
	---help---
		Activate DCD configuration of SDRAM

config IMXRT1170_FLEXSPI_NOR
	bool "Enable FlexSPI NOR Storage"
	default n
	depends on IMXRT_FLEXSPI

config IMXRT1170_FLEXSPI_FRAM
	bool "Enable FlexSPI FRAM Storage"
	default n
	depends on IMXRT_FLEXSPI
	select MTD

config FMU_V6XRT_CM4_ROMFS
	bool "Embed the CM4 firmware in the etc ROMFS"
	default n
	depends on IMXRT_RPTUN
	select FS_ROMFS
	select ETC_ROMFS
	---help---
		Build boards/arm/imxrt/fmu-v6xrt/src/etc/cm4.elf into the etc
		ROMFS that is mounted at boot, so no SD card is needed.  The file
		is not part of the tree; copy the CM4 image there before building.

config FMU_V6XRT_CM4_FIRMWARE
	string "CM4 firmware path"
	default "/mnt/sd/cm4.elf"
	depends on IMXRT_RPTUN && !FMU_V6XRT_CM4_ROMFS
	---help---
		ELF image the RPTUN loader writes into the CM4 TCM on
		"rptun start /dev/rptun/cm4".  It must carry a .resource_table
		section and link against the CM4 code TCM at 0x1ffe0000, with
		its shared memory in the upper 64 KB of that TCM.  With
		FMU_V6XRT_CM4_ROMFS the path is /etc/cm4.elf.

endif
```

## boards/arm/imxrt/frdm-imxrt1186/Kconfig
```kconfig
#
# SPDX-License-Identifier: Apache-2.0
#

if ARCH_BOARD_FRDM_IMXRT1186

config FRDM_IMXRT1186_DTCM
	bool
	default y

config FRDM_IMXRT1186_XIP
	bool "Create a FlexSPI2 NOR execute-in-place image"
	depends on BOOT_RUNFROMFLASH
	---help---
		Build an RT1180 Boot ROM container that executes the Cortex-M33
		image directly from the on-board 16 MiB W25Q128 QSPI NOR connected
		to FlexSPI2.  Writable data remains in internal OCRAM.

		The raw binary starts at flash offset zero and includes the FlexSPI
		configuration block and RT1180 container required for POR boot.

endif
```

## boards/arm/imxrt/frdm-imxrt1186/configs/netnsh/defconfig
```kconfig
#
# SPDX-License-Identifier: Apache-2.0
#

# CONFIG_ARCH_RAMFUNCS is not set
# CONFIG_NSH_DISABLE_DATE is not set
# CONFIG_NSH_DISABLE_IFCONFIG is not set
# CONFIG_NSH_DISABLE_IFUPDOWN is not set
# CONFIG_NSH_DISABLE_MB is not set
# CONFIG_NSH_DISABLE_MH is not set
# CONFIG_NSH_DISABLE_MW is not set
# CONFIG_RAW_BINARY is not set
# CONFIG_SYSTEM_DD is not set
CONFIG_ARCH="arm"
CONFIG_ARCH_BOARD="frdm-imxrt1186"
CONFIG_ARCH_BOARD_FRDM_IMXRT1186=y
CONFIG_ARCH_CHIP="imxrt"
CONFIG_ARCH_CHIP_IMXRT=y
CONFIG_ARCH_CHIP_MIMXRT1186=y
CONFIG_ARCH_STACKDUMP=y
CONFIG_BINFMT_DISABLE=y
CONFIG_BOARD_LATE_INITIALIZE=y
CONFIG_BOARD_LOOPSPERMSEC=240000
CONFIG_BOOT_RUNFROMISRAM=y
CONFIG_BUILTIN=y
CONFIG_DEBUG_FEATURES=y
CONFIG_DEBUG_NET=y
CONFIG_DEBUG_NET_ERROR=y
CONFIG_DEBUG_NET_INFO=y
CONFIG_FS_PROCFS=y
CONFIG_IDLETHREAD_STACKSIZE=2048
CONFIG_IMXRT_LPUART1=y
CONFIG_IMXRT_NETC=y
CONFIG_INIT_ENTRYPOINT="nsh_main"
CONFIG_INTELHEX_BINARY=y
CONFIG_LIBC_LOCALTIME=y
CONFIG_LINE_MAX=64
CONFIG_LPUART1_BAUD=115200
CONFIG_LPUART1_SERIAL_CONSOLE=y
CONFIG_NET=y
CONFIG_NET_BINDTODEVICE=y
CONFIG_NET_BROADCAST=y
CONFIG_NETDEV_LATEINIT=y
CONFIG_NETINIT_DHCPC=y
CONFIG_NETUTILS_DHCPC=y
CONFIG_NET_ICMP_SOCKET=y
CONFIG_NET_SOCKOPTS=y
CONFIG_NET_UDP=y
CONFIG_NSH_BUILTIN_APPS=y
CONFIG_NSH_FILEIOSIZE=512
CONFIG_NSH_READLINE=y
CONFIG_RAM_SIZE=524288
CONFIG_RAM_START=0x20480000
CONFIG_SCHED_LPWORK=y
CONFIG_START_DAY=16
CONFIG_START_MONTH=8
CONFIG_SYSTEM_NSH=y
CONFIG_SYSTEM_PING=y
```

## boards/arm/imxrt/frdm-imxrt1186/configs/nsh-xip/defconfig
```kconfig
#
# SPDX-License-Identifier: Apache-2.0
#

# CONFIG_ARCH_RAMFUNCS is not set
# CONFIG_NSH_DISABLE_DATE is not set
# CONFIG_NSH_DISABLE_MB is not set
# CONFIG_NSH_DISABLE_MH is not set
# CONFIG_NSH_DISABLE_MW is not set
CONFIG_ARCH="arm"
CONFIG_ARCH_BOARD="frdm-imxrt1186"
CONFIG_ARCH_BOARD_FRDM_IMXRT1186=y
CONFIG_ARCH_CHIP="imxrt"
CONFIG_ARCH_CHIP_IMXRT=y
CONFIG_ARCH_CHIP_MIMXRT1186=y
CONFIG_ARCH_STACKDUMP=y
CONFIG_BINFMT_DISABLE=y
CONFIG_BOARD_LOOPSPERMSEC=240000
CONFIG_BOOT_RUNFROMFLASH=y
CONFIG_BUILTIN=y
CONFIG_FLASH_SIZE=16777216
CONFIG_FLASH_START=0x14000000
CONFIG_FRDM_IMXRT1186_XIP=y
CONFIG_IDLETHREAD_STACKSIZE=2048
CONFIG_IMXRT_BOOT_FLEXSPI=y
CONFIG_IMXRT_LPUART1=y
CONFIG_INIT_ENTRYPOINT="nsh_main"
CONFIG_INTELHEX_BINARY=y
CONFIG_LIBC_LOCALTIME=y
CONFIG_LINE_MAX=64
CONFIG_LPUART1_BAUD=115200
CONFIG_LPUART1_SERIAL_CONSOLE=y
CONFIG_NSH_BUILTIN_APPS=y
CONFIG_NSH_DISABLE_IFUPDOWN=y
CONFIG_NSH_FILEIOSIZE=512
CONFIG_NSH_READLINE=y
CONFIG_RAM_SIZE=524288
CONFIG_RAM_START=0x20480000
CONFIG_RAW_BINARY=y
CONFIG_SCHED_BACKTRACE=y
CONFIG_START_DAY=16
CONFIG_START_MONTH=8
CONFIG_SYSTEM_NSH=y
```

## boards/arm/imxrt/imxrt1180-evk/Kconfig
```kconfig
#
# For a description of the syntax of this configuration file,
# see the file kconfig-language.txt in the NuttX tools repository.
#

if ARCH_BOARD_IMXRT1180_EVK

config IMXRT_DMA_POOL_SIZE
	int "RT1180 USB DMA pool size"
	depends on ARCH_FAMILY_IMXRT118x && IMXRT_USBDEV && USBDEV_DMAMEMORY
	default 6144
	range 1024 65536
	---help---
		Size in bytes of the RT1180 USB DMA-capable memory pool.
		The default is 6 KiB.  Increase this when a composite USB
		configuration requires additional request buffers.

config IMXRT1180_EVK_BOOTLOADER
	bool "Cortex-M33 bootloader application"
	default n
	depends on ARCH_CORTEXM33
	select IMXRT_CM7_BOOT
	---help---
		Build the minimal Cortex-M33 bootloader application
		(src/imxrt_bootloader.c) instead of a normal NuttX application.
		Its bootloader_main() entry point only releases the Cortex-M7,
		which then runs the M7 NuttX image XIP'd at 0x28080000.

		Set CONFIG_INIT_ENTRYPOINT="bootloader_main" when this is
		enabled (see the imxrt1180-evk:bl configuration).

endif
```
