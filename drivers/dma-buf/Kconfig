## drivers/tee/Kconfig
```kconfig
#
# For a description of the syntax of this configuration file,
# see the file kconfig-language.txt in the NuttX tools repository.
#

choice
	prompt "Select OP-TEE dev implementation"
	default DEV_OPTEE_NONE
	---help---
		There are three implementations of optee server,
		one is soft tee server which does not distinguish
		between secure and non-secure states and uses socket communication,
		and the other two is teeos which runs in the secure state of
		the cpu and uses either RPMsg cross-core communication or arm SMCs.
		Warning: SMC implementation has only been tested on arm64.

		DEV_OPTEE_DUMMY is not one of them: select it on the side that
		runs the server itself, which needs no client of its own.

config DEV_OPTEE_LOCAL
	bool "OPTEE Local Socket Support"
	depends on NET_LOCAL
	depends on FS_ANONMAP
	depends on ALLOW_BSD_COMPONENTS

config DEV_OPTEE_RPMSG
	bool "OP-TEE RPMSG Socket Support"
	depends on NET_RPMSG
	depends on FS_ANONMAP
	depends on ALLOW_BSD_COMPONENTS

config DEV_OPTEE_SMC
	bool "OP-TEE SMC CC Support"
	depends on ARCH_ARM || ARCH_ARM64
	depends on FS_ANONMAP
	depends on ALLOW_BSD_COMPONENTS

config DEV_OPTEE_DUMMY
	bool "OP-TEE RPMSG channel announcement"
	depends on RPMSG
	---help---
		Select this on the side that runs the OP-TEE server, rather than
		on a client of /dev/tee0.

		A TEE that shares memory with a REE over rpmsg has to make itself
		visible to that REE first: the REE binds its TEE backend to a named
		rpmsg channel, and binding is what hands that backend the rpmsg
		device it allocates the shared memory from.

		The channel carries no traffic of its own, as the requests
		themselves travel over the OP-TEE service socket, so the endpoint
		this creates is a sink.

config DEV_OPTEE_NONE
	bool "Disable OP-TEE driver"

endchoice

config DEV_OPTEE_SUPPLICANT
	bool "Enables kernel driver for TEE supplicant"
	default n
	depends on DEV_OPTEE_SMC

config OPTEE_REMOTE_CPU_NAME
	string "The cpuname on which the OP-TEE server runs"
	default "tee"
	depends on DEV_OPTEE_RPMSG

if DEV_OPTEE_SMC

choice
	prompt "Select OP-TEE conduit method"
	default DEV_OPTEE_SMC_CONDUIT_SMC
	---help---
		Select between the 2 supported conduit methods for invoking the secure
		world: SMC (when running at EL1) and HVC (when running at EL2, which is
		not supported by NuttX yet).

config DEV_OPTEE_SMC_CONDUIT_SMC
	bool "Use SMC calls to invoke OP-TEE"

config DEV_OPTEE_SMC_CONDUIT_HVC
	bool "Use HVC calls to invoke OP-TEE"

endchoice

endif # DEV_OPTEE_SMC
```
