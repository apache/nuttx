## drivers/power/battery/Kconfig
```kconfig
############################################################################
# drivers/power/battery/Kconfig
#
# SPDX-License-Identifier: Apache-2.0
#
# Licensed to the Apache Software Foundation (ASF) under one or more
# contributor license agreements.  See the NOTICE file distributed with
# this work for additional information regarding copyright ownership.  The
# ASF licenses this file to you under the Apache License, Version 2.0 (the
# "License"); you may not use this file except in compliance with the
# License.  You may obtain a copy of the License at
#
#   http://www.apache.org/licenses/LICENSE-2.0
#
# Unless required by applicable law or agreed to in writing, software
# distributed under the License is distributed on an "AS IS" BASIS, WITHOUT
# WARRANTIES OR CONDITIONS OF ANY KIND, either express or implied.  See the
# License for the specific language governing permissions and limitations
# under the License.
#
############################################################################
#
# For a description of the syntax of this configuration file,
# see the file kconfig-language.txt in the NuttX tools repository.
#

menu "Battery Management Support"

config BATTERY_CHARGER
	bool "Battery Charger support"
	default n

config BQ2425X
	bool "BQ2425X Battery charger support"
	default n
	select I2C
	select I2C_BQ2425X
	depends on BATTERY_CHARGER
	depends on ALLOW_BSD_COMPONENTS
	---help---
		The BQ24250/BQ24251 are battery charger for lithium-ion batteries.

config I2C_BQ2425X
	bool

config BQ2429X
	bool "BQ2429X Battery charger support"
	default n
	select I2C
	select I2C_BQ2429X
	depends on BATTERY_CHARGER
	---help---
		The BQ24296/BQ24297/BQ24296M are battery charger for lithium-ion batteries.

config I2C_BQ2429X
	bool

if BQ2429X

config DEBUG_BQ2429X
	bool "BQ2429X Debug Features"
	default n
	---help---
		Enable BQ2429X battery management debug features.

endif # BQ2429X

config AXP202
	bool "AXP202 Battery charger support"
	default n
	select I2C
	select I2C_AXP202
	depends on BATTERY_CHARGER
	---help---
		axp202 are battery charger for lithium-ion batteries.

config I2C_AXP202
	bool

config AXP202_DC2_VOLTAGE
	int "AXP202 DC2 output voltage"
	default 0
	depends on AXP202
	---help---
		AXP202 DC2 output voltage. 0 is disable, enable range: [700, 2275] mV.

config AXP202_DC3_VOLTAGE
	int "AXP202 DC3 output voltage"
	default 3300
	depends on AXP202
	---help---
		AXP202 DC3 output voltage. 0 is disable, enable range: [700, 3500] mV.

config AXP202_LDO2_VOLTAGE
	int "AXP202 LDO2 output voltage"
	default 0
	depends on AXP202
	---help---
		AXP202 LDO2 output voltage. 0 is disable, enable range: [1800, 3300] mV.

config AXP202_LDO3_VOLTAGE
	int "AXP202 LDO3 output voltage"
	default 0
	depends on AXP202
	---help---
		Enable LDO3 output voltage. 0 is disable, enable range: [700, 2275] mV.

config AXP202_LDO4_VOLTAGE
	int "AXP202 LDO4 output voltage"
	default 0
	depends on AXP202
	---help---
		Enable LDO4 output voltage. 0 is disable, other value:
			1250 1300 1400 1500 1600 1700 1800 1900
			2000 2500 2700 2800 3000 3100 3200 3300 mV.

config AXP2101
	bool "AXP2101 PMIC battery charger support"
	default n
	select I2C
	depends on BATTERY_CHARGER
	---help---
		Battery charger driver for the X-Powers AXP2101 PMIC (I2C).
		It reports the charge state and sets the charge voltage, the
		charge current and the input current limit.  The power rails
		are left as programmed by the OTP of the chip.

config AXP2101_GAUGE
	bool "AXP2101 fuel gauge support"
	default y
	depends on AXP2101 && BATTERY_GAUGE
	---help---
		Also provide a battery gauge lower half for the AXP2101: battery
		voltage, state of charge and die temperature.

config AXP2101_VOFF_VOLTAGE
	int "AXP2101 power-off voltage (mV)"
	default 0
	range 0 3300
	depends on AXP2101
	---help---
		The AXP2101 turns the system off when the battery voltage falls
		below this level, which protects the battery from deep
		discharge.  2600 to 3300 mV in steps of 100 mV.  0 keeps the
		value programmed in the OTP of the chip, which may be as low as
		2600 mV.  For a Li-ion or LiPo battery, 3000 mV or more is
		recommended.

config GD30BC2416
	bool "GD30BC2416 Battery charger support"
	default n
	select I2C
	select I2C_GD30BC2416
	select SCHED_HPWORK
	depends on BATTERY_CHARGER
	---help---
		The GigaDevice GD30BC2416 is a single-cell switching battery
		charger with a 5 V boost converter, an I2C interface and an ADC
		for the battery voltage.

config I2C_GD30BC2416
	bool

config GD30BC2416_CHARGE
	bool "Enable the charge at initialization"
	default n
	depends on GD30BC2416
	---help---
		The charge is disabled when the GD30BC2416 powers up.  Enable it
		when the driver is initialized.  Otherwise it can be enabled
		later with the BATIO_OPRTN_CHARGE operation.

config MCP73871
	bool "Microchip MCP73871 Battery charger support"
	default n
	depends on BATTERY_CHARGER
	---help---
		A simple driver to report MCP73871 status.

config LTC4013
	bool "Analog Devices LTC4013 Battery charger support"
	default n
	depends on BATTERY_CHARGER
	---help---
		Lower half driver for the LTC4013 multi-chemistry battery charger
		controller.  The chip has no digital interface: the driver enables
		it, sets its charge algorithm and reads its status through board
		callbacks.  The charge voltage is set by a board callback that
		programs the feedback network, or it is fixed by the hardware.

config NPM1100
	bool "Nordic nPM1100 PMIC battery charger support"
	default n
	depends on BATTERY_CHARGER
	---help---
		A simple driver to report Nordic nPM1100 PMIC charge status from
		its CHG/ERR GPIOs (the nPM1100 has no register interface).

config BATTERY_GAUGE
	bool "Battery Fuel Gauge support"
	default n

config MAX1704X
	bool "MAX1704X Battery fuel gauge support"
	default n
	select I2C
	select I2C_MAX1704X
	depends on BATTERY_GAUGE
	---help---
		The MAX17040/MAX17041 are ultra-compact, low-cost, host-side fuel-gauge
		systems for lithium-ion (Li+) batteries in handheld and portable equipment.
		The MAX17040 is configured to operate with a single lithium cell and the
		MAX17041 is configured for a dual-cell 2S pack.

config I2C_MAX1704X
	bool

config BQ27426
	bool "BQ27426 Battery fuel gauge support"
	default n
	select I2C
	depends on BATTERY_GAUGE
	---help---
		The bq27426 battery fuel gauge accurately predicts the battery capacity and other
		operational characteristics of a single, Li-based, rechargeable cell.
		It can be interrogated by a system processor to provide cell information,
		such as state-of-charge (SOC).

config BATTERY_MONITOR
	bool "Battery Monitor/Management support"
	default n

config BQ769X0
	bool "BQ769X0 Battery monitor support"
	default n
	select I2C
	select I2C_BQ769X0
	depends on BATTERY_MONITOR
	---help---
		The BQ76920/BQ76930/BQ76940 provide monitoring, balancing, and
		protection features for up to 15 cells in series.

config I2C_BQ769X0
	bool

if BQ769X0
config BQ769X0_USE_INTERNAL_TS
	bool "Use internal temperature sensor on BQ769X0"
	default n
endif

config GOLDFISH_BATTERY
	bool "Goldfish Battery charger support"
	default n
	depends on BATTERY_GAUGE
	---help---
		The GOLDFISH_BATTERY are battery charger for emulate batteries.

config BATTERY_FAKE_GAUGE
	bool "Battery fake gauge support"
	default n
	depends on BATTERY_GAUGE
	---help---
		The BATTERY FAKE are battery charger for emulate gauge.

endmenu
```
