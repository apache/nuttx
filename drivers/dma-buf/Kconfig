## drivers/rpmsg/Kconfig
```kconfig
############################################################################
# drivers/rpmsg/Kconfig
#
# SPDX-License-Identifier: Apache-2.0
#
# Licensed to the Apache Software Foundation (ASF) under one or more
# contributor license agreements.  See the NOTICE file distributed with
# this work for additional information regarding copyright ownership.  The
# ASF licenses this file to you under the Apache License, Version 2.0 (the
# "License"); you may not use this file except in compliance with the
# License.  You may obtain a copy of the License at
#
#   http://www.apache.org/licenses/LICENSE-2.0
#
# Unless required by applicable law or agreed to in writing, software
# distributed under the License is distributed on an "AS IS" BASIS, WITHOUT
# WARRANTIES OR CONDITIONS OF ANY KIND, either express or implied.  See the
# License for the specific language governing permissions and limitations
# under the License.
#
############################################################################
#
# For a description of the syntax of this configuration file,
# see the file kconfig-language.txt in the NuttX tools repository.
#

config RPMSG
	bool
	default n
	select OPENAMP
	select SCHED_WORKQUEUE

if RPMSG

config RPMSG_CHAR
	bool "rpmsg char support"
	default n
	---help---
		User can use the /dev/rpmsg/<cpuname> to create the
		endpoint and then use /dev/rpmsg-<name> to communicate with
		remote processor.

config RPMSG_CHAR_NPOLLWAITERS
	int "rpmsg char number of the poll waiters"
	default 2
	depends on RPMSG_CHAR

config RPMSG_WQUEUE_GLOBAL
	bool "rpmsg global work queue"
	default n
	---help---
		This is for rpmsg global work queue.

config RPMSG_WQUEUE_PRIORITY
	int "rpmsg work queue priority"
	default 224

config RPMSG_WQUEUE_STACKSIZE
	int "rpmsg work queue stack size"
	default 8192 if ARCH_64BIT && DEFAULT_TASK_STACKSIZE < 8192
	default DEFAULT_TASK_STACKSIZE

config RPMSG_WQUEUE_NUMBER
	int "rpmsg work queue number"
	default 1
	range 1 256
	---help---
		This macro sets the number of rpmsg work queue. It can be
		customized and the minimum value is 1.

config RPMSG_RECURSIVE_LIMIT
	int "rpmsg recursive limit"
	default 8 if ARCH_SIM
	default 2 if RPMSG_WQUEUE_STACKSIZE <= 4096
	default 3 if RPMSG_WQUEUE_STACKSIZE <= 5120
	default 4 if RPMSG_WQUEUE_STACKSIZE <= 6144
	default 5 if RPMSG_WQUEUE_STACKSIZE <= 7168
	default 6 if RPMSG_WQUEUE_STACKSIZE <= 8192
	default 7 if RPMSG_WQUEUE_STACKSIZE <= 9216
	default 8
	---help---
		This macro sets the maximum recursion depth allowed in the
		rpmsg dispatch function.

config RPMSG_TRACE
	bool "rpmsg trace"
	default n
	depends on SCHED_INSTRUMENTATION_DUMP
	---help---
		Record the messages passed through the rpmsg transports in the
		note stream under NOTE_TAG_RPMSG, so they can be read back with
		the note drivers (e.g. /dev/note/ram).

config RPMSG_TRACE_BACKTRACE
	int "rpmsg trace backtrace depth"
	default 0
	range 0 16
	depends on RPMSG_TRACE
	---help---
		Number of frames recorded with a trace that asks for a
		backtrace. 0 disables backtraces.

config RPMSG_PROCFS
	bool "Include rpmsg info in procfs"
	depends on FS_PROCFS_REGISTER
	default !DEFAULT_SMALL
	---help---
		Add /proc/rpmsg, which lists the local and the remote CPU of every
		registered rpmsg device.

config RPMSG_LOCAL_CPUNAME
	string "Rpmsg Local Cpuname"
	default LIBC_HOSTNAME

config RPMSG_PING
	bool "rpmsg ping support"
	default n
	---help---
		This is for debugging & profiling, create ping rpmsg
		channel, user can use it to get send/recv speed & latency.

config RPMSG_TEST
	bool "rpmsg test support"
	default n

config RPMSG_WAKELOCK
	bool "rpmsg wakelock support"
	default n
	depends on PM
	---help---
		Let a CPU hold a PM wakelock on the remote CPU through the
		RPMSGIOC_ACQUIRE_WAKELOCK and RPMSGIOC_RELEASE_WAKELOCK ioctls.
		Both sides of the link must enable it.

config RPMSG_HEAP
	bool "rpmsg heap manage support"
	default n
	---help---
		This is for rpmsg heap manage, it can be used to allocate/free
		shm for slave.

config RPMSG_DUMP_LEVEL
	int "rpmsg dump level"
	default 2 if DEFAULT_SMALL
	default 3
	range 0 3
	---help---
		Control what rpmsg can dump:
		  0 - Disable: no dump support, RPMSGIOC_DUMP returns -ENOTTY
		  1 - Manual: dump on request only (RPMSGIOC_DUMP)
		  2 - Panic info: also a brief dump on panic, at the
		      PANIC_KERNEL_FINAL stage
		  3 - Panic verbose: also a full dump on panic

config RPMSG_POOL_COUNT
	int "rpmsg pool buffer count"
	default 0
	---help---
		This macro sets the count of rpmsg pool buffers, each pool
		can be used to allocate rpmsg buffers. 0 means disable
		rpmsg pool.

config RPMSG_POOL_SIZE
	int "rpmsg pool size"
	depends on RPMSG_POOL_COUNT != 0
	default 64
	---help---
		This macro sets the size of each rpmsg pool, which is used
		to allocate rpmsg buffers. The default value is 64 bytes.

endif # RPMSG

config RPMSG_ROUTER
	bool "rpmsg router support"
	default n
	---help---
		Rpmsg router driver for enabling communication
		without physical channels.

config RPMSG_PORT
	bool
	default n
	select RPMSG
	---help---
		Rpmsg port transport layer used for cross chip communication.

config RPMSG_PORT_SPI
	bool "Rpmsg SPI Port Driver Support"
	default n
	depends on SPI
	select RPMSG_PORT
	---help---
		Rpmsg SPI Port driver used for cross chip communication.

config RPMSG_PORT_SPI_SLAVE
	bool "Rpmsg SPI Slave Port Driver Support"
	default n
	select RPMSG_PORT
	---help---
		Rpmsg SPI Slave Port driver used for cross chip communication.

if RPMSG_PORT_SPI || RPMSG_PORT_SPI_SLAVE

config RPMSG_PORT_SPI_THREAD_PRIORITY
	int "Rpmsg SPI Port Thread Priority"
	default 224

config RPMSG_PORT_SPI_THREAD_STACKSIZE
	int "Rpmsg SPI Port Stack Size"
	default 4096

config RPMSG_PORT_SPI_CRC
	bool "Rpmsg SPI Port Use Checksum"
	default n
	---help---
		Check every frame with a 16-bit XOR checksum (xorsum16()). It
		catches corrupted framing at little cost, but it is not a CRC: it
		misses errors that flip the same bit in two 16-bit words.

config RPMSG_PORT_SPI_RX_THRESHOLD
	int "Rpmsg SPI Port Rx Buffer Threshold"
	default 50
	range 0 100

config RPMSG_PORT_SPI_PM_TIMEOUT
	int "Rpmsg SPI Port PM Stay Timeout in Milliseconds"
	default 1
	depends on PM

endif # RPMSG_PORT_SPI

config RPMSG_PORT_UART
	bool "Rpmsg Uart Port Driver Support"
	default n
	depends on SCHED_EVENTS
	select RPMSG_PORT
	---help---
		Rpmsg Uart Port driver used for cross chip communication.

if RPMSG_PORT_UART

config RPMSG_PORT_UART_RX_THREAD_PRIORITY
	int "Rpmsg UART Port RX Thread Priority"
	default 224

config RPMSG_PORT_UART_RX_THREAD_STACKSIZE
	int "Rpmsg UART Port RX Stack Size"
	default DEFAULT_TASK_STACKSIZE

config RPMSG_PORT_UART_TX_THREAD_PRIORITY
	int "Rpmsg UART Port TX Thread Priority"
	default 224

config RPMSG_PORT_UART_TX_THREAD_STACKSIZE
	int "Rpmsg UART Port TX Stack Size"
	default DEFAULT_TASK_STACKSIZE

config RPMSG_PORT_UART_CRC
	bool "Rpmsg UART Port Checksum Enable"
	default n
	---help---
		Check every frame with a 16-bit XOR checksum (xorsum16()). It
		catches corrupted framing at little cost, but it is not a CRC: it
		misses errors that flip the same bit in two 16-bit words.

config RPMSG_PORT_UART_COMPRESSION
	bool "Rpmsg UART Port LZF Compression"
	default n
	depends on LIBC_LZF
	---help---
		Enable LZF compression for rpmsg port uart data frames.
		Compresses payload before byte-escaping to reduce UART
		bandwidth usage. Both TX and RX sides must enable this.

config RPMSG_PORT_UART_DEBUG
	bool "Rpmsg UART DEBUG Enable"
	default n

endif # RPMSG_PORT_UART

config RPMSG_VIRTIO
	bool
	default n
	select RPMSG
	---help---
		The Rpmsg VirtIO Lite, VirtIO-Rpmsg and VHost-Rpmsg common
		part.

if RPMSG_VIRTIO

config RPMSG_VIRTIO_PM
	bool "RPMsg VirtIO power management"
	depends on PM
	default n
	---help---
		If TX/RX buffer is supplied and powered by each CPU.
		And when one CPU in DEEP sleep, then it's buffer will
		goto RAM-retention mode, can't access from another CPU.
		So, we provide this method to resolve this.

config RPMSG_VIRTIO_PM_AUTORELAX
	bool "RPMsg VirtIO pm autorelax"
	depends on RPMSG_VIRTIO_PM
	default y
	---help---
		Enable automatic power management wakelock relaxation using watchdog timer.

		When enabled, this option uses a watchdog timer to periodically check if
		there are any tx buffers is not returned by remote core. If the tx buffers
		are returned by remote core, the power management wakelock is automatically
		released, allowing the system to enter low-power states. If the tx buffers
		are still not returned by remote core, the wakelock is maintained and the
		timer is restarted.

		Autorelax feature can improve power efficiency in multi-core systems because
		it prevents unnecessary power consumption by reducing the times that system
		enter and leave low-power states.

config RPMSG_VIRTIO_START_SYNC
	bool "rpmsg virtio start devices synchronously"
	default n
	---help---
		By default probe defers the rpmsg device bring-up to the rpmsg work
		queue.  Enable this to run it inline instead, so the device is ready
		when probe returns, at the cost of blocking the probe caller.

		The bring-up then announces the local services from outside the
		rpmsg work queue, while the work queues of both cores answer each
		other's announcements and wait for tx buffers recursively.  If
		RPMSG_RECURSIVE_LIMIT is too small on either core, both cores wait
		for tx buffers forever: sim, with 17 services and 8 buffers, needs
		at least 4 on both cores.

endif # RPMSG_VIRTIO
```

## drivers/rptun/Kconfig
```kconfig
############################################################################
# drivers/rptun/Kconfig
#
# SPDX-License-Identifier: Apache-2.0
#
# Licensed to the Apache Software Foundation (ASF) under one or more
# contributor license agreements.  See the NOTICE file distributed with
# this work for additional information regarding copyright ownership.  The
# ASF licenses this file to you under the Apache License, Version 2.0 (the
# "License"); you may not use this file except in compliance with the
# License.  You may obtain a copy of the License at
#
#   http://www.apache.org/licenses/LICENSE-2.0
#
# Unless required by applicable law or agreed to in writing, software
# distributed under the License is distributed on an "AS IS" BASIS, WITHOUT
# WARRANTIES OR CONDITIONS OF ANY KIND, either express or implied.  See the
# License for the specific language governing permissions and limitations
# under the License.
#
############################################################################
#
# For a description of the syntax of this configuration file,
# see the file kconfig-language.txt in the NuttX tools repository.
#

menuconfig RPTUN
	bool "Remote Proc Tunnel Driver Support"
	default n
	select RPMSG_VIRTIO
	---help---
		RPTUN driver is used for multi-cores' communication.

if RPTUN

choice RPTUN_AUTO_RESET
	prompt "rptun auto reset peer"
	default RPTUN_AUTO_RESET_IN_PANIC_NOTIFIER

config RPTUN_AUTO_RESET_DISABLE
	bool "rptun auto reset feature disabled"

config RPTUN_AUTO_RESET_IN_PANIC_NOTIFIER
	bool "rptun panic other core in panic notifier"
	---help---
		Panic peer in the panic notifier and Reboot/Poweroff peer in
		the reboot notifier. This mode is used for the case that the
		main core do the coredump after panic all the peer cores.

config RPTUN_AUTO_RESET_IN_REBOOT_NOTIFIER
	bool "rptun panic other core in reboot notifier"
	---help---
		Panic/Reboot/Poweroff peer all in the reboot notifier.
		This mode is used for the case that all the core do its
		coredump by itself.

endchoice # RPTUN_AUTO_RESET

config RPTUN_BMP
	bool "rptun bmp support"
	default n
	---help---
		This is a rptun driver for communications in bmp
		environments. With this driver, Each ends communicate with each
		other by using the native rpmsg
		or various Rpmsg services have been implemented in NuttX.

config RPTUN_IVSHMEM
	bool "rptun ivshmem support"
	default n
	depends on PCI_IVSHMEM && DEV_SIMPLE_ADDRENV
	---help---
		This is rptun driver based on pci ivshmem.

if RPTUN_IVSHMEM

config RPTUN_IVSHMEM_NAME
	string "rptun ivshmem name"
	---help---
		Using this config to custom the rptun ivshmem cpuname and role,
		using ";" to split the names.
		For example, if RPTUN_IVSHMEM_CPUNAME = "0:cpu1:m;1:cpu2:s" and pass
		two ivshmem devices to the qemu, we will get two rptun ivshmem
		drivers with ivshmem device match id: [0, 1],
		remote cpu names: ["cpu1", "cpu2"] and roles: ["master", "slave"']

config RPTUN_IVSHMEM_BUFFSIZE
	int "rptun ivshmem rpmsg buffer size"
	default 2048
	---help---
		The rpmsg buffer size in resource table, the RX and TX buffer size
		are same for now.

config RPTUN_IVSHMEM_BUFFNUM
	int "rptun ivshmem rpmsg buffer number"
	default 8
	---help---
		The rpmsg buffer number in resource table, the RX and TX buffer number
		are same for now.

config RPTUN_IVSHMEM_RPMB_PATH
	string "rptun ivshmem backend eMMC RPMB device path"
	depends on DRIVERS_VHOST_RPMB
	default "/dev/mmcsd0rpmb"
	---help---
		Path of the backend eMMC RPMB partition opened by the vhost-rpmb
		driver on the device side. It is published into the RPMB vdev
		config space (struct vhost_rpmb_config_s) of the ivshmem resource
		table so the vhost-rpmb probe can open the real RPMB block device.

endif

config RPTUN_START_SYNC
	bool "rptun start devices synchronously"
	default n
	---help---
		By default rptun spawns a short lived "rptun" kernel thread on every
		start to bring the remote proc up and to wait for the peer to publish
		VIRTIO_CONFIG_STATUS_DRIVER_OK.  Each start/stop cycle therefore
		allocates and releases a TCB and a stack, and the stop path has to
		SIGKILL the thread out of its peer wait.

		Enable this option to run the whole sequence inline in the caller's
		context instead.  No thread is created and a start/stop cycle performs
		no dynamic allocation at all.

		Be aware of the trade-off: the caller blocks until the peer has
		driven every virtio device in the resource table, forever if the
		peer has no driver for one of them.
		With RPTUN_IS_AUTOSTART this stalls board bring-up, and when entered
		through RPTUNIOC_START (rptun_boot()) the global rptun lock is held for
		the whole wait, which blocks rptun_reset()/rptun_poweroff() on every
		rptun instance, including from the panic notifier.

		Only select this when the peer is known to be up before this side
		starts, or when stalling the caller is acceptable.

config RPTUN_PRIORITY
	int "rptun thread priority"
	default 224

config RPTUN_STACKSIZE
	int "rptun stack size"
	default 4096

config RPTUN_STATUS_TIMEOUT_MS
	int "rptun status timeout ms"
	default 5000

config RPTUN_LOADER
	bool "rptun loader support"
	default n

endif # RPTUN
```
