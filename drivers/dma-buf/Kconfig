## drivers/ivshmem/Kconfig
```kconfig
#
# For a description of the syntax of this configuration file,
# see the file kconfig-language.txt in the NuttX tools repository.
#

config IVSHMEM
	bool
	default n
	---help---
		Inter-VM shared memory bus. Matches ivshmem devices registered by
		a backend (e.g. PCI) with the drivers that use them. Selected by
		the backends, not chosen directly.

config RAMDISK_IVSHMEM
	bool "Ramdisk ivshmem driver"
	default n
	depends on IVSHMEM && !DISABLE_MOUNTPOINT
	---help---
		Enable ramdisk device driver.

config RAMDISK_IVSHMEM_IDTABLE
	string "The id table of ramdisk ivshmem device"
	depends on RAMDISK_IVSHMEM
	---help---
		"id0;id1;id2", e.g.: "0;1;2"


config UIO_IVSHMEM
	bool "Enable uio ivshmem driver support"
	default n
	depends on IVSHMEM
	---help---
		When this option is enabled, char ivshmem driver will register
		char device with name: "/dev/uioX" to the VFS, then
		application can open this device and use `mmap()` to get the
		share memory provided by ivshmem device.

config UIO_IVSHMEM_IDTABLE
	string "The id table of uio ivshmem device"
	depends on UIO_IVSHMEM
	---help---
		"id0;id1;id2", e.g.: "0;1;2"

config UIO_IVSHMEM_NPOLLWAITERS
	int "Uio ivshmem poll waiter number"
	default 2
	depends on UIO_IVSHMEM

config IVSHMEM_FLAT
	bool "QEMU ivshmem-flat driver"
	default n
	select IVSHMEM
	---help---
		Driver for the QEMU ivshmem-flat device: the ivshmem register
		block and shared memory as plain MMIO regions plus one irq, for
		machines without a PCI bus. The board registers each device with
		ivshmem_flat_register(), or from the device tree with
		fdt_ivshmem_flat_devices_register().
```

## drivers/misc/Kconfig
```kconfig
############################################################################
# drivers/misc/Kconfig
#
# SPDX-License-Identifier: Apache-2.0
#
# Licensed to the Apache Software Foundation (ASF) under one or more
# contributor license agreements.  See the NOTICE file distributed with
# this work for additional information regarding copyright ownership.  The
# ASF licenses this file to you under the Apache License, Version 2.0 (the
# "License"); you may not use this file except in compliance with the
# License.  You may obtain a copy of the License at
#
#   http://www.apache.org/licenses/LICENSE-2.0
#
# Unless required by applicable law or agreed to in writing, software
# distributed under the License is distributed on an "AS IS" BASIS, WITHOUT
# WARRANTIES OR CONDITIONS OF ANY KIND, either express or implied.  See the
# License for the specific language governing permissions and limitations
# under the License.
#
############################################################################
#
# For a description of the syntax of this configuration file,
# see the file kconfig-language.txt in the NuttX tools repository.
#

config DEV_SIMPLE_ADDRENV
	bool "Simple AddrEnv"
	default n

config DEV_NULL
	bool "Enable /dev/null"
	default !DEFAULT_SMALL

config DEV_ZERO
	bool "Enable /dev/zero"
	default !DEFAULT_SMALL

config DEV_MEM
	bool "Enable /dev/mem"
	default n
	---help---
		It is a full image of physical memory and can be used to
		access physical memory.

config DEV_ASCII
	bool "Enable /dev/ascii"
	default n
	---help---
		Enable the /dev/ascii device driver.  This is a character driver
		that will return all characters from 0x21-0x7f.

config DEV_RPMSG
	bool "RPMSG Device Client Support"
	default n
	depends on RPMSG

config DEV_RPMSG_SERVER
	bool "RPMSG Device Server Support"
	default n
	depends on RPMSG

if DEV_RPMSG_SERVER

config DEV_RPMSG_SERVER_WORK_PRIORITY
	int "Rpmsg Device Server Work Priority"
	default 224

config DEV_RPMSG_SERVER_WORK_STACKSIZE
	int "Rpmsg Device Server Work Stack Size"
	default DEFAULT_TASK_STACKSIZE

endif # DEV_RPMSG_SERVER

config DRVR_MKRD
	bool "RAM disk wrapper (mkrd)"
	default n
	---help---
		Build the mkrd() function which serves as a wrapper to simplify
		creation of RAM disks.  If the boardctrl() interface is enabled,
		the selecting this option will also enable the BOARDIOC_MKRD
		command that will support creation of RAM disks from applications.

config BLK_RPMSG
	bool "RPMSG Block Client Support"
	default n
	depends on RPMSG

config BLK_RPMSG_SERVER
	bool "RPMSG Block Server Support"
	default n
	depends on RPMSG

config GOLDFISH_PIPE
	bool "Goldfish Pipe Support"
	default n

config QEMU_FWCFG
	bool "QEMU fw_cfg Support"
	default n
	depends on MTD_CONFIG_NAMED
	---help---
		Enable a read-only driver for the QEMU fw_cfg device.  The MMIO
		region is discovered from the "qemu,fw-cfg-mmio" node of the
		flattened device tree and exposed as a character device
		(/dev/qemufwcfg).  Named "file" items published by QEMU (e.g.
		-fw_cfg name=opt/xxx,string=...) can be read from user space using
		the configdata ioctl interface (CFGDIOC_GETCONFIG,
		CFGDIOC_FINDCONFIG, CFGDIOC_FIRSTCONFIG, CFGDIOC_NEXTCONFIG).

# ARCH needs to support memory access while CPU is running to be able to use
# the LWL CONSOLE

config ARCH_HAVE_RDWR_MEM_CPU_RUN
	bool
	default n

config LWL_CONSOLE
	bool "Lightweight Link Console Support"
	default n
	depends on DEV_CONSOLE && ARCH_HAVE_RDWR_MEM_CPU_RUN && SERIAL
	---help---
		Use the lightweight link console which provides console over a
		debug channel by means of shared memory.  A terminal application
		for openocd as the debugger is available in tools/lwl/ocdconsole.py.
		See Documentation/guides/drivers/lwl.rst.

if LWL_CONSOLE

config LWL_CONSOLE_RXBUFSIZE
	int "Receive buffer size"
	default 64
	---help---
		Size of the buffer that holds the characters received from the
		host until they are read.  While it is full the host is held off,
		so no input is lost.

config LWL_CONSOLE_TXBUFSIZE
	int "Transmit buffer size"
	default 256
	---help---
		Size of the buffer that holds the characters waiting to be
		collected by the host.  While no host is connected the most recent
		output is kept here and shown when the host connects.

config LWL_CONSOLE_RINGSIZE
	int "Output ring buffer size"
	default 256
	---help---
		Size of the ring buffer in the control block from which the host
		collects the output, many bytes per debugger access instead of
		three per word.  This is what makes the output fast.  It must be
		a multiple of 4.  0 disables it: the output then only uses the
		word protocol, as with old host tools.

config LWL_CONSOLE_DOORBELL
	bool "Doorbell interrupt"
	default n
	---help---
		Let the host raise an interrupt every time it updates the link, by
		writing a register of the interrupt controller that makes an
		unused interrupt pending.  The console is then entirely interrupt
		driven: the CPU does no work at all while the console is idle.
		It requires a host that rings the doorbell, such as
		tools/lwl/ocdconsole.py.  Without the doorbell the link is polled,
		see LWL_CONSOLE_POLL_INTERVAL.

if LWL_CONSOLE_DOORBELL

config LWL_CONSOLE_DOORBELL_IRQ
	int "Doorbell IRQ number"
	---help---
		The NuttX IRQ number used as the doorbell.  It must be implemented
		by the chip but not used by any other driver.

config LWL_CONSOLE_DOORBELL_ADDR
	hex "Doorbell register address"
	default 0x0
	---help---
		Address of the register the host writes to make the doorbell IRQ
		pending.  The debugger must be able to write it while the CPU is
		running.  On ARMv6-M/ARMv7-M/ARMv8-M this is the NVIC Interrupt
		Set-Pending Register 0xe000e200 + 4 * ((IRQ - 16) / 32).  The
		interrupt handler writes 0 to it, which must either clear the
		request or have no effect.

config LWL_CONSOLE_DOORBELL_VALUE
	hex "Doorbell register value"
	default 0x0
	---help---
		Value the host writes to LWL_CONSOLE_DOORBELL_ADDR.  On
		ARMv6-M/ARMv7-M/ARMv8-M this is 1 << ((IRQ - 16) % 32).

endif # LWL_CONSOLE_DOORBELL

config LWL_CONSOLE_POLL_INTERVAL
	int "Polling interval (usec)"
	default 10000
	range 1 1000000
	depends on !LWL_CONSOLE_DOORBELL
	---help---
		Interval at which the link is polled while the console is open,
		when the doorbell is not used.  It works with any host, but the
		CPU wakes up at this rate and the output throughput is limited
		by it.

endif # LWL_CONSOLE

menu "Buffering"

config DRVR_WRITEBUFFER
	bool "Enable write buffer support"
	default n
	---help---
		Enable generic write buffering support that can be used by a variety
		of drivers.

if DRVR_WRITEBUFFER

config DRVR_WRDELAY
	int "Write flush delay"
	default 350
	---help---
		If there is no write activity for this configured amount of time,
		then the contents will be automatically flushed to the media.  This
		reduces the likelihood that data will be stuck in the write buffer
		at the time of power down.

endif # DRVR_WRITEBUFFER

config DRVR_READAHEAD
	bool "Enable read-ahead buffer support"
	default n
	---help---
		Enable generic read-ahead buffering support that can be used by a
		variety of drivers.

if DRVR_WRITEBUFFER || DRVR_READAHEAD

config DRVR_READBYTES
	bool "Support byte read method"
	default MTD_BYTE_WRITE

config DRVR_REMOVABLE
	bool "Support removable media"
	default n

config DRVR_INVALIDATE
	bool "Support cache invalidation"
	default n

endif # DRVR_WRITEBUFFER || DRVR_READAHEAD

endmenu # Buffering
```
