## drivers/can/Kconfig
```kconfig
#
# For a description of the syntax of this configuration file,
# see the file kconfig-language.txt in the NuttX tools repository.
#

config ARCH_HAVE_CAN_ERRORS
	bool
	default n

menuconfig CAN
	bool "CAN Driver Support"
	default n
	---help---
		This selection enables building of the "upper-half" CAN driver.
		See include/nuttx/can/can.h for further CAN driver information.

if CAN

config CAN_EXTID
	bool "CAN extended IDs"
	default n
	---help---
		Enables support for the 29-bit extended ID.  Default Standard 11-bit
		IDs.

config CAN_ERRORS
	bool "CAN error reporting"
	default n
	depends on ARCH_HAVE_CAN_ERRORS
	---help---
		Support CAN error reporting.  If this option is selected then CAN
		error reporting is enabled.  In the event of an error, the ch_error
		bit will be set in the CAN message and the following message payload
		will include a more detailed description of certain errors.

config CAN_FD
	bool "CAN FD"
	default n
	---help---
		Enables support for the CAN_FD mode.

config CAN_FIFOSIZE
	int "CAN driver I/O buffer size"
	default 8
	---help---
		The size of the circular buffer of CAN messages. Default: 8

config CAN_NPENDINGRTR
	int "Number of pending RTRs"
	default 4
	---help---
		The size of the list of pending RTR requests. Default: 4

config CAN_TXREADY
	bool "can_txready interface"
	default n
	---help---
		This selection enables the can_txready() interface.  This interface
		is needed only for CAN hardware that supports queueing of outgoing
		messages in a H/W FIFO.

		The CAN upper half driver also supports a queue of output messages
		in a S/W FIFO.  Messages are added to that queue when when
		can_write() is called and removed from the queue in can_txdone()
		when each TX message is complete.

		After each message is added to the S/W FIFO, the CAN upper half
		driver will attempt to send the message by calling into the lower
		half driver.  That send will not be performed if the lower half
		driver is busy, i.e., if dev_txready() returns false.  In that
		case, the number of messages in the S/W FIFO can grow.  If the
		S/W FIFO becomes full, then can_write() will wait for space in
		the S/W FIFO.

		If the CAN hardware does not support a H/W FIFO then busy means
		that the hardware is actively sending the message and is
		guaranteed to become non busy (i.e, dev_txready()) when the
		send transfer completes and can_txdone() is called.  So the call
		to can_txdone() means that the transfer has completed and also
		that the hardware is ready to accept another transfer.

		If the CAN hardware supports a H/W FIFO, can_txdone() is not
		called when the transfer is complete, but rather when the
		transfer is queued in the H/W FIFO.  When the H/W FIFO becomes
		full, then dev_txready() will report false and the number of
		queued messages in the S/W FIFO will grow.

		There is no mechanism in this case to inform the upper half
		driver when the hardware is again available, when there is
		again space in the H/W FIFO.  can_txdone() will not be called
		again.  If the S/W FIFO becomes full, then the upper half
		driver will wait for space to become available, but there is
		no event to awaken it and the driver will hang.

		Enabling this feature adds support for the can_txready()
		interface.  This function is called from the lower half
		driver's CAN interrupt handler each time a TX transfer
		completes.  This is a sure indication that the H/W FIFO is
		no longer full.  can_txready() will then awaken the
		can_write() logic and the hang condition is avoided.

choice
	prompt "TX Ready Work Queue"
	default CAN_TXREADY_HIPRI
	depends on CAN_TXREADY

config CAN_TXREADY_LOPRI
	bool "Low-priority work queue"
	select SCHED_LPWORK

config CAN_TXREADY_HIPRI
	bool "High-priority work queue"
	select SCHED_HPWORK

endchoice # TX Ready Work Queue

config CAN_LOOPBACK
	bool "CAN loopback mode"
	default n
	---help---
		A CAN driver may or may not support a loopback mode for testing. If the
		driver does support loopback mode, the setting will enable it. (If the
		driver does not, this setting will have no effect).

config CAN_NPOLLWAITERS
	int "Number of poll waiters"
	default 2
	---help---
		The maximum number of threads that may be waiting on the
		poll method.
		
config CAN_USE_RTR
	bool "Include RTR in CAN header"
	default n
	---help---
		This selection includes RTR bitfield in the CAN header.

comment "CAN Bus Controllers:"

config CAN_MCP2515
	bool "Microchip MCP2515 CAN Bus Controller over SPI"
	default n
	depends on SPI
	select ARCH_HAVE_CAN_ERRORS
	---help---
		Enable driver support for Microchip MCP2515.

if CAN_MCP2515

config MCP2515_BITRATE
	int "MCP2515 bitrate"
	default 500000
	---help---
		MCP2515 bitrate in bits per second.

config MCP2515_PROPSEG
	int "MCP2515 Propagation Segment TQ"
	default 2
	range 1 8
	---help---
		The length of the bit time is Tquanta * (SyncSeg + PropSeg + PhaseSeg1 + PhaseSeg2).

config MCP2515_PHASESEG1
	int "MCP2515 Phase Segment 1"
	default 2
	range 1 8
	---help---
		The length of the bit time is Tquanta * (SyncSeg + PropSeg + PhaseSeg1 + PhaseSeg2).

config MCP2515_PHASESEG2
	int "MCP2515 Phase Segment 2"
	default 3
	range 2 8
	---help---
		The length of the bit time is Tquanta * (SyncSeg + PropSeg + PhaseSeg1 + PhaseSeg2).

config MCP2515_SJW
	int "MCP2515 Synchronization Jump Width"
	default 1
	range 1 4
	---help---
		The duration of a synchronization jump is SJW.

config MCP2515_CLK_FREQUENCY
	int "MCP2515 on-board clock frequency"
	default 8000000
	range 1 25000000

config MCP2515_SPI_SCK_FREQUENCY
	int "MCP2515 SPI SCK Frequency"
	default 1000000
	range 100000 10000000

endif # CAN_MCP2515

endif
```

## drivers/clk/Kconfig
```kconfig
menuconfig CLK
	bool "Clock management (CLK) driver interfaces"
	default n
	---help---
		The base clock drivers and clock management sets. These interfaces are used
		to enable/disable clocks and set clock rate for drivers

if CLK

config CLK_RPMSG
	bool "RPMSG clk driver"
	default n
	depends on RPMSG
	---help---
		RPMSG clk are proxy/master pairs clock that operate clks between client and
		server processor.

endif
```

## drivers/contactless/Kconfig
```kconfig
#
# For a description of the syntax of this configuration file,
# see the file kconfig-language.txt in the NuttX tools repository.
#

menuconfig DRIVERS_CONTACTLESS
	bool "Contactless Device Support"
	default n
	---help---
		Drivers for various contactless devices.

if DRIVERS_CONTACTLESS

config CL_MFRC522
	bool "NXP MFRC522 ISO14443/Mifare Transceiver"
	default n
	select SPI
	---help---
		This options adds driver support for the MFRC522 ISO14443/Mifare chip.

if CL_MFRC522

config MFRC522_SPI_FREQ
	int "SPI frequency for MFRC522"
	default 1000000
	depends on CL_MFRC522

config CL_MFRC522_DEBUG_TX
	bool "trace TX frames"
	default n
	depends on DEBUG_CONTACTLESS

config CL_MFRC522_DEBUG_RX
	bool "trace RX frames"
	default n
	depends on DEBUG_CONTACTLESS

endif # CL_MFRC522

config CL_PN532
	bool "pn532 NFC-chip support"
	default n
	select SPI
	---help---
		This options adds driver support for the PN532 NFC chip.

if CL_PN532

config PN532_SPI_FREQ
	int "SPI frequency for PN532"
	default 1000000
	depends on CL_PN532

config CL_PN532_DEBUG_TX
	bool "trace TX frames"
	default n
	depends on DEBUG_CONTACTLESS

config CL_PN532_DEBUG_RX
	bool "trace RX frames"
	default n
	depends on DEBUG_CONTACTLESS

endif # CL_PN532

endif # DRIVERS_CONTACTLESS
```

## drivers/coresight/Kconfig
```kconfig
#
# For a description of the syntax of this configuration file,
# see the file kconfig-language.txt in the NuttX tools repository.
#

menuconfig CORESIGHT
	bool "Coresight Driver Support"
	default n
	---help---
		Coresight drivers support.

if CORESIGHT

config CORESIGHT_MAX_OUTPORT_NUM
	int "Max outport number of coresight device"
	default 2

config CORESIGHT_TIMEOUT
	int "Timeout us for waiting register state change"
	default 100

endif # CORESIGHT
```

## drivers/crypto/Kconfig
```kconfig
#
# For a description of the syntax of this configuration file,
# see the file kconfig-language.txt in the NuttX tools repository.
#

config ARCH_HAVE_RNG
	bool

config DEV_RANDOM
	bool "Enable /dev/random"
	default y
	depends on ARCH_HAVE_RNG
	---help---
		Enable support for /dev/random provided by a hardware TRNG.

config DEV_URANDOM
	bool "Enable /dev/urandom"
	default n
	---help---
		Enable support for /dev/urandom provided by either a hardware TRNG or
		by a software PRNG implementation.

		NOTE:  This option may not be cryptographially secure and should not
		be enabled if you are concerned about cyptographically secure
		pseudo-random numbers (CPRNG) and do not know the characteristics
		of the software PRNG implementation!

if DEV_URANDOM

choice
	prompt "/dev/urandom algorithm"
	default DEV_URANDOM_ARCH if ARCH_HAVE_RNG
	default DEV_URANDOM_XORSHIFT128 if !ARCH_HAVE_RNG

config DEV_URANDOM_XORSHIFT128
	bool "xorshift128"
	---help---
		xorshift128 is a pseudorandom number generator that is simple,
		portable, and can also be used on 8-bit and 16-bit MCUs.

		NOTE: Not cyptographically secure

config DEV_URANDOM_CONGRUENTIAL
	bool "Congruential"
	---help---
		Use the same congruential general used with srand().  This algorithm
		is computationally more intense and uses double precision floating
		point.  NOTE: Good randomness from the congruential generator also
		requires that you also select CONFIG_LIBC_RAND_ORDER > 2

		NOTE: Not cyptographically secure

config DEV_URANDOM_RANDOM_POOL
	bool "Entropy pool"
	depends on CRYPTO_RANDOM_POOL
	---help---
		Use the entropy pool CPRNG output for urandom algorithm.

		NOTE: May or may not be cyptographically secure, depending upon the
		quality entropy available to entropy pool.

config DEV_URANDOM_ARCH
	bool "Architecture-specific"
	depends on ARCH_HAVE_RNG
	---help---
		The implementation of /dev/urandom is provided in archtecture-
		specific logic using hardware TRNG logic.  architecture-specific
		logic must provide the whole implementation in this case, including
		the function devurandom_register().  In this case, /dev/urandom may
		refer to the same driver as /dev/random.

		NOTE: May or may not be cyptographically secure, depending upon the
		implementation.

endchoice # /dev/urandom algorithm

endif # DEV_URANDOM

menuconfig DEV_SE05X
	bool "Enable secure element (SE05X)"
	depends on I2C
	depends on CRYPTO
	default n
	---help---
		Enable support for /dev/se05x secure element provided by NXP SE050
		or SE051

if DEV_SE05X

choice
	prompt "Channel communication interface"
	default DEV_SE05X_PLAIN
	---help---
		Select authentication method

config DEV_SE05X_SCP03
	bool "SCP03 secure channel (TBI)"
	select CRYPTO_RANDOM_POOL
	select CRYPTO_AES

config DEV_SE05X_PLAIN
	bool "plain communication"

endchoice # Channel communication interface

config DEV_SE05X_SCP03_KEY_FILE
	string "SCP03 keys"
	depends on DEV_SE05X_SCP03
	default "/host/path/to/key_file"
	---help---
		Specify file containing the keys needed with SCP03 channel authentication.
		Location may be relative to the NuttX root folder. File should contain
		the definitions for SCP03_ENC_KEY, SCP03_MAC_KEY and SCP03_DEK_KEY as
		byte array initializers.

choice SE05X_LOG_LEVEL
	prompt "SE05x debug log level"
	default SE05X_LOG_NONE
	---help---
		The SE05x log is divided into the following levels: ERROR,WARNING,INFO,DEBUG.

config SE05X_LOG_NONE
	bool "No output"

config SE05X_LOG_ERROR
	bool "Error"

config SE05X_LOG_WARNING
	bool "Warning"

config SE05X_LOG_INFO
	bool "Info"

config SE05X_LOG_DEBUG
	bool "Debug"

endchoice # SE05x debug log level

endif #DEV_SE05X
```

## drivers/devicetree/Kconfig
```kconfig
#
# For a description of the syntax of this configuration file,
# see the file kconfig-language.txt in the NuttX tools repository.
#

menuconfig DEVICE_TREE
	bool "Device Tree Support"
	default n
	select LIBC_FDT
	---help---
		Interface for interacting with devicetree.
```

## drivers/discrete/Kconfig
```kconfig
#
# For a description of the syntax of this configuration file,
# see the file kconfig-language.txt in the NuttX tools repository.
#

menuconfig IOEXPANDER
	bool "IO Expander Support"
	default n
	---help---
		This directory holds implementations of IO expander drivers.
		See include/nuttx/discrete/ioexpander.h for registration information.

if IOEXPANDER

config IOEXPANDER_MULTIPIN
	bool "Support multi-pin access routines"
	default n
	---help---
		This settings enable the definition of routines for
		optimized simultaneous access to multiple pins.

config IOEXPANDER_PCA9555
	bool "PCA9555 I2C IO expander"
	default n
	select I2C
	---help---
		Enable support for the NXP PCA9555 IO Expander

if IOEXPANDER_PCA9555

config PCA9555_MULTIPLE
	bool "Multiple PCA9555 Devices"
	default n
	---help---
		Can be defined to support multiple PCA9555 devices on board.

config PCA9555_INT_DISABLE
	bool "Disable PCA9555 Interrupt Support"
	default y
	---help---
		Disable driver interrupt functionality

endif # IOEXPANDER_PCA9555
endif # IOEXPANDER

config USERLED
	bool "LED driver"
	default n
	depends on ARCH_HAVE_LEDS
	---help---
		Enable standard user LED upper half driver.

if USERLED

config USERLED_LOWER
	bool "Generic Lower Half LED Driver"
	default n
	---help---
		If the board supports the standard LED interfaces as
		defined in include/nuttx/board.h header file, then this
		standard LED lower half driver might be usable.

		In order for this generic driver to be usable:

		1. The board implementation must provide the LED
		   interfaces as defined in include/nuttx/board.h
		2. The board.h header file must provide the definition
		   BOARD_NLEDS, and
		3. The board.h header file must not include any other
		   header files that are not accessibble in this context
		   (such as those in arch/<arch>/src/<chip>) UNLESS those
		   inclusions are conditioned on __KERNEL__.  button_lower.c
		   will undefine __KERNEL__ before included board.h.

		If your board does not meet these requirements, then the
		userled_lower.c file can still be copied to your your
		board src/ directory and modified for your specific board
		requirements.

endif # USERLED
```

## drivers/dma/Kconfig
```kconfig
#
# For a description of the syntax of this configuration file,
# see the file kconfig-language.txt in the NuttX tools repository.
#

menuconfig DMA
	bool "DMA driver interfaces"
	default n
	select ARCH_DMA
	---help---
		Drivers for various DMA devices.

if DMA

config DMA_LINK
	bool "Support DMA link configure"

endif
```
