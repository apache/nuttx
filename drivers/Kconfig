## drivers/eeprom/Kconfig
```kconfig
#
# For a description of the syntax of this configuration file,
# see the file kconfig-language.txt in the NuttX tools repository.
#

menuconfig EEPROM
	bool "EEPROM support"
	default n
	---help---
		This directory holds implementations of EEPROM drivers.

if EEPROM

config SPI_EE_25XX
	bool "Microchip 25xxNNN / Atmel AT25NNN / ST M95NNN SPI EEPROM devices"
	default n
	depends on SPI
	---help---
		This selection enables support for the Microchip/Atmel/ST SPI EEPROM
		devices

if SPI_EE_25XX

config EE25XX_SPIMODE
	int "SPI mode (0-3)"
	default 0

config EE25XX_FREQUENCY
	int "SPI EEPROM SCK frequency"
	default 10000000
	---help---
		Default SPI bus frequency, it can be overwritten at runtime using the
		EEPIOC_SETSPEED ioctl. See eeprom/eeprom.h.

config EE25XX_START_DELAY
	int "SPI start delay"
	depends on SPI_DELAY_CONTROL
	range 0 1000000
	default 5000
	---help---
		The delay between CS active and first CLK. In ns.

config EE25XX_STOP_DELAY
	int "SPI stop delay"
	depends on SPI_DELAY_CONTROL
	range 0 1000000
	default 5000
	---help---
		The delay between last CLK and CS inactive. In ns.

config EE25XX_CS_DELAY
	int "SPI CS delay"
	depends on SPI_DELAY_CONTROL
	range 0 1000000
	default 5000
	---help---
		The delay between CS inactive and CS active again. In ns.

config EE25XX_IFDELAY
	int "SPI interface delay"
	depends on SPI_DELAY_CONTROL
	range 0 1000000
	default 5000
	---help---
		The delay between frames. In ns.

endif # SPI_EE_25XX

config I2C_EE_24XX
	bool "Microchip 24xxNNN / Atmel AT24NNN / ST M24NNN I2C EEPROM devices"
	default n
	depends on I2C
	---help---
		This selection enables support for the Microchip/Atmel/ST I2C EEPROM
		devices

if I2C_EE_24XX

config EE24XX_FREQUENCY
	int "I2C EEPROM frequency (100000 or 400000)"
	default 100000
	---help---
		Default I2C bus frequency, it can be overwritten at runtime using the
		EEPIOC_SETSPEED ioctl. See eeprom/eeprom.h.

config AT24CS_UUID
	bool "Device driver support for Atmel AT24CSxx UUID"
	default n
	---help---
		The Atmel AT24CSxx family have a 128-bit UUID which appears as
		another I2C slave whose address is offset from the EEPROM by +8.
		This option registers a char device driver with the ".uuid" suffix.

endif # I2C_EE_24XX

endif
```

## drivers/efuse/Kconfig
```kconfig
#
# For a description of the syntax of this configuration file,
# see the file kconfig-language.txt in the NuttX tools repository.
#

menuconfig EFUSE
	bool "EFUSE support"
	default n
	---help---
		This directory holds implementations of EFUSE subsystem.
```

## drivers/i2c/Kconfig
```kconfig
#
# For a description of the syntax of this configuration file,
# see the file kconfig-language.txt in the NuttX tools repository.
#

config ARCH_HAVE_I2CRESET
	bool
	default n

config BOARD_HAVE_I2CMUX
	bool
	default n

menuconfig I2C
	bool "I2C Driver Support"
	default n
	---help---
		This selection enables building of the "upper-half" I2C driver.
		See include/nuttx/i2c/i2c_master.h for further I2C driver information.

if I2C

config I2C_SLAVE
	bool "I2C Slave"
	default n

config I2C_POLLED
	bool "Polled I2C (no interrupts)"
	default n

config I2C_RESET
	bool "Support I2C reset interface method"
	default n
	depends on ARCH_HAVE_I2CRESET

config I2C_TRACE
	bool "Enable I2C trace debug"
	default n

config I2C_NTRACE
	int "Number of I2C trace records"
	default 32
	depends on I2C_TRACE

config I2C_BITBANG
	bool "I2C bitbang implementation"
	default n
	---help---
		Enable support for a bitbang implementation of I2C

if I2C_BITBANG

config I2C_BITBANG_NO_DELAY
	bool "Do not add delay"
	default n
	---help---
		If you want to go full speed (depending on how fast pins can be toggled)
		you can enable this option. This will not respect the desired frequency
		set during the I2C transfer operation.

config I2C_BITBANG_GPIO_OVERHEAD
	int "GPIO overhead"
	depends on !I2C_BITBANG_NO_DELAY
	default 0
	---help---
		Overhead of GPIO toggling operation to consider when computing
		delays. This overhead will be subtracted from sleep times to achieve
		desired frequency.

config I2C_BITBANG_TIMEOUT
	int "I2C timeout"
	default 1000
	---help---
		Timeout (microseconds) to abort wait on slave.

config I2C_BITBANG_CLOCK_STRETCHING
	bool "Support clock stretching"
	default n
	---help---
		This enables I2C clock stretching. This requires the hardware to set
		the pin into open-collector mode (master sets SCL high and waits until
		slave stops holding it low).

endif # I2C_BITBANG

config I2C_DRIVER
	bool "I2C character driver"
	default n
	---help---
		Build in support for a character driver at /dev/i2c[N] that may be
		used to perform I2C bus transfers from applications.  The intent of
		this driver is to support I2C testing.  It is not suitable for use
		in any real driver application.

menu "I2C Multiplexer Support"

config I2CMULTIPLEXER_PCA9540BDP
	bool "PCA9540BDP NXP multiplexer"
	default n
	depends on I2C
	select BOARD_HAVE_I2CMUX
	---help---
		Enable support for the NXP PCA9540BDP i2c multiplexer

config I2CMULTIPLEXER_TCA9548A
	bool "TCA9548A TI multiplexer"
	default n
	depends on I2C
	select BOARD_HAVE_I2CMUX
	---help---
		Enable support for the TI TCA9548A i2c multiplexer

# put more i2c mux devices here

endmenu # I2C Multiplexer Support

endif
```

## drivers/i2s/Kconfig
```kconfig
#
# For a description of the syntax of this configuration file,
# see the file kconfig-language.txt in the NuttX tools repository.
#

menuconfig I2S
	bool "I2S Driver Support"
	default n
	---help---
		This selection enables selection of common I2S options.  This option
		should be enabled by all platforms that support I2S interfaces.
		See include/nuttx/audio/i2s.h for further I2S driver information.

if I2S

config AUDIO_I2SCHAR
	bool "I2S character driver (for testing only)"
	default n
	---help---
		This selection enables a simple character driver that supports I2S
		transfers via a read() and write().  The intent of this driver is to
		support I2S testing.  It is not an audio driver but does conform to
		some of the buffer management heuristics of an audio driver.  It is
		not suitable for use in any real driver application in its current
		form.

if AUDIO_I2SCHAR

config AUDIO_I2SCHAR_RXTIMEOUT
	int "RX timeout"
	default 0
	---help---
		This is a fixed timeout value that will be used for all receiver
		transfers.  This is in units of system clock ticks (configurable).
		The special value of zero disables RX timeouts.  Default: 0

config AUDIO_I2SCHAR_TXTIMEOUT
	int "TX timeout"
	default 0
	---help---
		This is a fixed timeout value that will be used for all transmitter
		transfers.  This is in units of system clock ticks (configurable).
		The special value of zero disables RX timeouts.  Default: 0

endif # AUDIO_I2SCHAR

endif # I2S
```

## drivers/i3c/Kconfig
```kconfig
#
# For a description of the syntax of this configuration file,
# see the file kconfig-language.txt in the NuttX tools repository.
#

menuconfig I3C
	bool "I3C Driver Support"
	default n
	---help---
		This selection enables building of the "upper-half" I3C driver.
		See include/nuttx/i3c/master.h for further I3C driver information.

if I3C

config I3C_DRIVER
	bool "I3C character driver"
	default n
	---help---
		Build in support for a character driver at /dev/i3c[N] that may be
		used to perform I3C bus transfers from applications.  The intent of
		this driver is to support I3C testing.  It is not suitable for use
		in any real driver application.

endif # I3C
```
