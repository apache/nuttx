## drivers/wireless/spirit/Kconfig
```kconfig
#
# For a description of the syntax of this configuration file,
# see the file kconfig-language.txt in the NuttX tools repository.
#

config WL_SPIRIT
	bool "STMicro Spirit Radio Library"
	default n
	select SPI
	depends on ALLOW_BSD_COMPONENTS
	---help---
		Enable support for the STMicro Spirit Radio Library

if WL_SPIRIT

config WL_SPIRIT_SPIFREQUENCY
	int "Spirit SPI frequency"
	default 10000000
	---help---
		Frequency at which to operate the SPI interface to the Spirit part.
		The default is the absolute maximum and you may likely have to
		reduce this for your board.

config WL_SPIRIT_REGDEBUG
	bool "Enable register level debug"
	default n
	depends on DEBUG_WIRELESS_INFO
	---help---
		Enable logic to dump each value read from and written to the Spirit
		registers.

config WL_SPIRIT_FIFODUMP
	bool "Enable debug FIFO dump"
	default n
	depends on DEBUG_WIRELESS_INFO
	---help---
		Enable logic to dump data written to and read from the linear FIFO.

endif

source "drivers/wireless/spirit/drivers/Kconfig"
```

## drivers/wireless/spirit/drivers/Kconfig
```kconfig
#
# For a description of the syntax of this configuration file,
# see the file kconfig-language.txt in the NuttX tools repository.
#

config SPIRIT_NETDEV
	bool "STMicro Spirit1-based Network Driver"
	default n
	select WL_SPIRIT
	select ARCH_HAVE_NETDEV_STATISTICS
	---help---
		This selection enables support for the TMicro Spirit1-based device.
		This configuration generates an IEEE802.15.4 work-alike radio device that
		works with the 6LoWPAN stack.

if SPIRIT_NETDEV

config SPIRIT_PKTLEN
	int "Fixed packet length"
	default 96
	range 1 96 if !SPIRIT_FIFOS
	range 1 65535 if SPIRIT_FIFOS
	---help---
		Fixed pkt sizes are used.  This setting describes that fixed packet
		size.

		This comment exists in the STMicro Spirit driver.  I have not
		experienced this myself, but this is something you should be aware
		of:  "Sometimes Spirit1 seems to NOT deliver (correctly) the
		'IRQ_RX_DATA_READY' event for packets which have a length which is
		close to a multiple of RX FIFO size. Furthermore, in these cases
		also the content delivery seems to be compromised as well as the
		generation of RX/TX FIFO errors. This can be avoided by reducing
		the maximum packet length to a value which is lower than the RX FIFO
		size."

config SPIRIT_FIFOS
	bool "FIFO Watermarks"
	default n
	depends on EXPERIMENTAL
	---help---
		The Spirit hardware can provided interrupts when indicate when the
		RX or TX FIFOs are almost full or empty.  This is useful for
		supporting very large packets, larger than the FIFO size.  The RX/TX
		FIFO size is 96 bytes.  If the packet size is significantly less than
		96 bytes, this feature is not needed.  It is required for packet sizes
		greater than 96 bytes and if it is not selected, there may be
		occurrences of RX FIFO errors if the packet size is less than but close
		to 96.

		This comment exists in the STMicro Spirit driver.  I have not
		experienced this myself, but this is something you should be aware
		of:  "Sometimes Spirit1 seems to NOT deliver (correctly) the
		'IRQ_RX_DATA_READY' event for packets which have a length which is
		close to a multiple of RX FIFO size. Furthermore, in these cases
		also the content delivery seems to be compromised as well as the
		generation of RX/TX FIFO errors. This can be avoided by reducing
		the maximum packet length to a value which is lower than the RX FIFO
		size."

		From my reading, the only known work-around is to reduce the maximum
		packet size so that it is smaller than 96.  Hence, this option is
		conditioned on EXPERIMENTAL.

config SPIRIT_PROMISICUOUS
	bool "Promiscuous mode"
	default n
	---help---
		Disables all address filtering.  Otherwise, filtering the node
		address will be supported.

config SPIRIT_MULTICAST
	bool "Multicast address filter"
	default n
	depends on !SPIRIT_PROMISICUOUS
	---help---
		Enables address filtering for the multicast address 0xee.

config SPIRIT_BROADCAST
	bool "Broadcast address filter"
	default n
	depends on !SPIRIT_PROMISICUOUS
	---help---
		Enables address filtering for the broadcast address 0xff.

config SPIRIT_CRCDISABLE
	bool "Disable CRC"
	default n
	---help---
		Disables CRC calculation and filtering.  Default is enabled.

		Errata:  "Using the STack packet format and no CRC field, the
		reading from RX FIFO to the last received byte, is not possible. ..."
		Workaround: "By configuring the packet handler with at least one byte
		of CRC, the problem is solved. If the CRC is not required in the
		application, configure one byte of CRC in the receiver only, to read
		the payload correctly from RX FIFO."

config SPIRIT_HUBNODE
	hex "Address of hub node"
	default 0x34
	depends on NET_STAR
	---help---
		Provides the "well known" address of the hub node in the
		star configuration.

endif # SPIRIT_NETDEV
```

## fs/Kconfig
```kconfig
#
# For a description of the syntax of this configuration file,
# see the file kconfig-language.txt in the NuttX tools repository.
#

comment "File system configuration"

config DISABLE_MOUNTPOINT
	bool "Disable support for mount points"
	default n

config FS_AUTOMOUNTER
	bool "Auto-mounter"
	default n
	depends on !DISABLE_MOUNTPOINT
	select SCHED_LPWORK
	---help---
		The automounter provides an OS-internal mechanism for automatically
		mounting and unmounting removable media as the media is inserted and
		removed.  See include/nuttx/fs/automout.h for interfacing details.

config FS_AUTOMOUNTER_DEBUG
	bool "Auto-mounter debug"
	default n
	depends on FS_AUTOMOUNTER && DEBUG_FEATURES
	---help---
		Normally, the auto-mounter will generate debug output when sub-system
		level file system debug is enabled.  This option will select debug
		output from the logic related to the auto-mount feature even when file
		system debug is not enable.  This is useful primarily for in vivo
		unit testing of the auto-mount feature.

config FS_NEPOLL_DESCRIPTORS
	int "Maximum number of default epoll descriptors for epoll_create1(2)"
	default 8
	---help---
		The maximum number of default epoll descriptors for epoll_create1(2)

config DISABLE_PSEUDOFS_OPERATIONS
	bool "Disable pseudo-filesystem operations"
	default y if DEFAULT_SMALL
	default n if !DEFAULT_SMALL
	---help---
		Disable certain operations on pseudo-file systems include mkdir,
		rmdir, unlink, and rename.  These are necessary for the logical
		completeness of the illusion created by the pseudo-filesystem.
		However, in practical embedded system, they are seldom needed and
		you can save a little FLASH space by disabling the capability.

config PSEUDOFS_ATTRIBUTES
	bool "Pseudo-filesystem attributes"
	default n
	depends on !DISABLE_PSEUDOFS_OPERATIONS
	---help---
		Enable support for attributes(e.g. mode, uid, gid and time)
		in the pseudo file system.

config PSEUDOFS_SOFTLINKS
	bool "Pseudo-filesystem soft links"
	default n
	depends on !DISABLE_PSEUDOFS_OPERATIONS
	---help---
		Enable support for soft links in the pseudo file system.  Soft
		links are not supported within mounted volumes by any NuttX file
		system.  However, if this option is selected, then soft links
		may be add in the pseudo file system.  This might be useful, for
		to link a directory in the pseudo-file system, such as /bin, to
		to a directory in a mounted volume, say /mnt/sdcard/bin.

config SENDFILE_BUFSIZE
	int "sendfile() buffer size"
	default 512
	---help---
		Size of the I/O buffer to allocate in sendfile().  Default: 512b

config EVENT_FD
	bool "EventFD"
	default n
	---help---
		Create a file descriptor for event notification

if EVENT_FD

config EVENT_FD_VFS_PATH
	string "Path to eventfd storage"
	default "/var/event"
	---help---
		The path to where eventfd will exist in the VFS namespace.

config EVENT_FD_POLL
	bool "EventFD poll support"
	default y
	---help---
		Poll support for file descriptor based events

config EVENT_FD_NPOLLWAITERS
	int "Number of eventFD poll waiters"
	default 2
	depends on EVENT_FD_POLL
	---help---
		Maximum number of threads that can be waiting on poll()

endif # EVENT_FD

source "fs/aio/Kconfig"
source "fs/semaphore/Kconfig"
source "fs/mqueue/Kconfig"
source "fs/shm/Kconfig"
source "fs/mmap/Kconfig"
source "fs/partition/Kconfig"
source "fs/fat/Kconfig"
source "fs/nfs/Kconfig"
source "fs/nxffs/Kconfig"
source "fs/romfs/Kconfig"
source "fs/cromfs/Kconfig"
source "fs/tmpfs/Kconfig"
source "fs/smartfs/Kconfig"
source "fs/binfs/Kconfig"
source "fs/procfs/Kconfig"
source "fs/spiffs/Kconfig"
source "fs/littlefs/Kconfig"
source "fs/unionfs/Kconfig"
source "fs/userfs/Kconfig"
source "fs/hostfs/Kconfig"
```

## fs/archivefs/Kconfig
```kconfig
#
# For a description of the syntax of this configuration file,
# see the file kconfig-language.txt in the NuttX tools repository.
#

config FS_ARCHIVEFS
	bool "ARCHIVE File System"
	default n

if FS_ARCHIVEFS

config FS_ARCHIVEFS_BUFFER_SIZE
	int "Buffer size"
	default 32768
	---help---
		libarchive requires a buffer to read and write data.

config FS_ARCHIVEFS_FORMAT_ALL
	bool "support archive all format"
	default n
	---help---
		All format support will increase binary size.
if !FS_ARCHIVEFS_FORMAT_ALL
config FS_ARCHIVEFS_FORMAT_ZIP
	bool "support archive xar format"
	default y

config FS_ARCHIVEFS_FORMAT_7ZIP
	bool "support archive 7zip format"
	default n

config FS_ARCHIVEFS_FORMAT_AR
	bool "support archive ar format"
	default n

config FS_ARCHIVEFS_FORMAT_CAB
	bool "support archive cab format"
	default n

config FS_ARCHIVEFS_FORMAT_CPIO
	bool "support archive cpio format"
	default n

config FS_ARCHIVEFS_FORMAT_EMPTY
	bool "support archive empty format"
	default n

config FS_ARCHIVEFS_FORMAT_ISO9660
	bool "support archive iso9660 format"
	default n

config FS_ARCHIVEFS_FORMAT_LHA
	bool "support archive lha format"
	default n

config FS_ARCHIVEFS_FORMAT_MTREE
	bool "support archive mtree format"
	default n

config FS_ARCHIVEFS_FORMAT_RAR
	bool "support archive rar format"
	default n

config FS_ARCHIVEFS_FORMAT_RAR_V5
	bool "support archive rar_v5 format"
	default n

config FS_ARCHIVEFS_FORMAT_RAW
	bool "support archive raw format"
	default n

config FS_ARCHIVEFS_FORMAT_TAR
	bool "support archive raw format"
	default n

config FS_ARCHIVEFS_FORMAT_WARC
	bool "support archive warc format"
	default n

config FS_ARCHIVEFS_FORMAT_XAR
	bool "support archive xar format"
	default n

endif

endif
```

## fs/cromfs/Kconfig
```kconfig
#
# For a description of the syntax of this configuration file,
# see the file kconfig-language.txt in the NuttX tools repository.
#

config FS_CROMFS
	bool "CROMFS file system"
	default n
	depends on !DISABLE_MOUNTPOINT
	select LIBC_LZF
	---help---
		Enable Compessed Read-Only Filesystem (CROMFS) support

if FS_CROMFS
endif
```

## fs/event/Kconfig
```kconfig
#
# For a description of the syntax of this configuration file,
# see the file kconfig-language.txt in the NuttX tools repository.
#

config FS_NAMED_EVENTS
	bool "Named event group support"
	default n
	depends on SCHED_EVENTS
	---help---
		Include support for named event group.

if FS_NAMED_EVENTS

config FS_NAMED_EVENTS_VFS_PATH
	string "Path to event group storage"
	default "/var/event"
	---help---
		The path to where named event group will exist in the VFS namespace.

endif # FS_NAMED_EVENTS
```

## fs/exfat/Kconfig
```kconfig
config FS_EXFAT
	bool "EXFAT File System"
	default n
        select FS_LARGEFILE
	depends on !DISABLE_MOUNTPOINT
	---help---
		Build the EXFAT file system. https://en.wikipedia.org/wiki/ExFAT
```

## fs/fat/Kconfig
```kconfig
#
# For a description of the syntax of this configuration file,
# see the file kconfig-language.txt in the NuttX tools repository.
#

config FS_FAT
	bool "FAT file system"
	default n
	depends on !DISABLE_MOUNTPOINT
	---help---
		Enable FAT filesystem support

if FS_FAT

config FAT_COMPUTE_FSINFO
	bool "FAT compute free space in FSINFO at mount time"
	default n
	---help---
		Enables the computation of free clusters at mount time as suggested by the
		white paper for FAT. The standard behavior of NuttX is to trust the stored
		value and only recompute it once required. This works if the file system
		is never mounted to another OS. SD-cards which are mounted to Windows to
		modify the content might report wrong space after reinserting it to NuttX.
		It is recommended to activate this setting if the "SD-Card" is swapped
		between systems.

config FAT_LCNAMES
	bool "FAT upper/lower names"
	default n
	---help---
		Enable use of the NT-style upper/lower case 8.3
		file name support.

config FAT_LFN
	bool "FAT long file names"
	default n
	---help---
		Enable FAT long file names.  NOTE:  Microsoft claims
		patents on FAT long file name technology.  Please read the
		disclaimer in the top-level NOTICE file and only enable this
		feature if you understand these issues.

config FAT_MAXFNAME
	int "FAT maximum file name size"
	depends on FAT_LFN
	default NAME_MAX
	range 12 255
	---help---
		If FAT_LFN is defined, then the default, maximum long file
		name is 255 bytes.  This can eat up a lot of memory (especially stack
		space).  If you are willing to live with some non-standard, short long
		file names, then define this value to be something more reasonable.  A
		good choice would be the same value as selected for NAME_MAX which will
		limit the visibility of longer file names anyway.

		This setting may not exceed NAME_MAX.  That will be verified at compile
		time.  The minimum values is 12 due to assumptions in internal logic.

config FAT_LFN_ALIAS_HASH
	bool "Use faster method for forming long filename 8.3 alias"
	depends on FAT_LFN
	default n
	---help---
		Long filenames on FAT filesystems have associated 8.3 character alias
		short filenames. The traditional form of these is FILENA~1.EXT with
		a running count of the number of similar names. However creating this
		unique count can take several seconds if there are many similarly named
		files in the directory. Enabling FAT_LFN_ALIAS_HASH uses an alternative
		format of FI0123~1.TXT where the four digits are a hash of the original
		filename. This method is similar to what is used by Windows 2000 and
		later.

config FAT_LFN_UTF8
	bool "Allow UTF8 long filenames"
	depends on FAT_LFN
	default n
	---help---
		UTF8 long filenames are accepted and converted to UCS2.

config FAT_LFN_ALIAS_TRAILCHARS
	int "Number of trailing characters to use for 8.3 alias"
	depends on FAT_LFN
	default 0
	---help---
		Traditional format for long filename 8.3 aliases takes first 6
		characters of long filename. If this option is set to N > 0,
		NuttX will instead take first 6-N and last N characters to form
		the short name. This is useful for filenames like "datafile12.txt"
		where the first characters would always remain the same.

config FS_FATTIME
	bool "FAT timestamps"
	default n
	---help---
		Support FAT date and time. NOTE:  There is not
		much sense in supporting FAT date and time unless you have a
		hardware RTC or other way to get the time and date.

endif # FAT
```

## fs/fatfs/Kconfig
```kconfig
#
# For a description of the syntax of this configuration file,
# see the file kconfig-language.txt in the NuttX tools repository.
#

menuconfig FS_FATFS
	bool "FATFS File System"
	default n
	depends on !DISABLE_MOUNTPOINT
	---help---
		Build the FATFS file system. http://elm-chan.org/fsw/ff/00index_e.html

config FS_FATFS_SECTOR_RATIO
	int "The ratio between fatfs filesystem sector and block device sector"
	depends on FS_FATFS
	default 1
```
