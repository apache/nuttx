## fs/procfs/Kconfig
```kconfig
#
# For a description of the syntax of this configuration file,
# see the file kconfig-language.txt in the NuttX tools repository.
#

config FS_PROCFS
	bool "PROCFS File System"
	default n
	---help---
		The PROCFS file system provides access to task status and other driver
		status through the NuttX file system.  The PROCFS may, for example, be
		mount at /proc.  Then information about all of the currently active
		tasks and threads will be available in /proc.

if FS_PROCFS

config FS_PROCFS_REGISTER
	bool "Run-time registration"
	default n
	---help---
		Support run-time registration of the new entries in the procfs file
		system.

config FS_PROCFS_MAX_TASKS
	int "The maximum number of active tasks for procfs snapshot"
	default 128
	---help---
		The maximum number of active tasks for procfs snapshot.

menu "Exclude individual procfs entries"

config FS_PROCFS_EXCLUDE_BLOCKS
	bool "Exclude fs/blocks information"
	depends on !DISABLE_MOUNTPOINT
	default DEFAULT_SMALL
	---help---
		Causes the fs block usage information to be excluded from the procfs
		system.  This procfs file provides the text output for the NSH 'df'
		command.

config FS_PROCFS_EXCLUDE_CPULOAD
	bool "Exclude CPU load"
	depends on SCHED_CPULOAD
	default DEFAULT_SMALL

config FS_PROCFS_EXCLUDE_ENVIRON
	bool "Exclude environment information"
	depends on !FS_PROCFS_EXCLUDE_PROCESS
	default DEFAULT_SMALL
	---help---
		Causes the environment variable information to be excluded from the
		procfs system.  This will reduce code space slightly.

config FS_PROCFS_EXCLUDE_IOBINFO
	bool "Exclude iobinfo"
	depends on MM_IOB
	default DEFAULT_SMALL

config FS_PROCFS_EXCLUDE_PROCESS
	bool "Exclude process information"
	default DEFAULT_SMALL
	---help---
		Causes the process information to be excluded from the procfs system.
		This will reduce code space, but then giving access to process info
		was kinda the whole point of procfs, but hey, whatever.

config FS_PROCFS_INCLUDE_PROGMEM
	bool "Include prog mem"
	depends on ARCH_HAVE_PROGMEM && !FS_PROCFS_EXCLUDE_MEMINFO
	default DEFAULT_SMALL

config FS_PROCFS_EXCLUDE_MEMDUMP
	bool "Exclude memdump"
	depends on !FS_PROCFS_EXCLUDE_MEMINFO
	default DEFAULT_SMALL

config FS_PROCFS_EXCLUDE_MEMINFO
	bool "Exclude meminfo"
	default DEFAULT_SMALL

config FS_PROCFS_EXCLUDE_MODULE
	bool "Exclude module information"
	depends on MODULE
	default DEFAULT_SMALL
	---help---
		Causes the module information to be excluded from the procfs system.

config FS_PROCFS_EXCLUDE_MOUNT
	bool "Exclude fs/mount information"
	depends on !DISABLE_MOUNTPOINT
	default DEFAULT_SMALL
	---help---
		Causes the mount point information to be excluded from the procfs
		system.  This procfs file provides the text output for the NSH 'mount'
		command.

config FS_PROCFS_EXCLUDE_MOUNTS
	bool "Exclude mounts"
	depends on !DISABLE_MOUNTPOINT
	default DEFAULT_SMALL

config FS_PROCFS_EXCLUDE_NET
	bool "Exclude network"
	depends on NET
	default DEFAULT_SMALL

config FS_PROCFS_EXCLUDE_PARTITIONS
	bool "Exclude partitions"
	depends on MTD_PARTITION
	default DEFAULT_SMALL

config FS_PROCFS_EXCLUDE_ROUTE
	bool "Exclude routing table"
	depends on !FS_PROCFS_EXCLUDE_NET && NET_ROUTE
	default DEFAULT_SMALL

config FS_PROCFS_EXCLUDE_SMARTFS
	bool "Exclude fs/smartfs"
	depends on FS_SMARTFS
	default DEFAULT_SMALL

config FS_PROCFS_EXCLUDE_TCBINFO
	bool "Exclude tcbinfo procfs"
	depends on DEBUG_TCBINFO
	default DEFAULT_SMALL

config FS_PROCFS_EXCLUDE_UPTIME
	bool "Exclude uptime"
	default DEFAULT_SMALL

config FS_PROCFS_EXCLUDE_USAGE
	bool "Exclude fs/usage information"
	depends on !DISABLE_MOUNTPOINT
	default DEFAULT_SMALL
	---help---
		Causes the fs usage information to be excluded from the procfs
		system.  This procfs file provides the text output for the NSH 'df -h'
		command.

config FS_PROCFS_EXCLUDE_VERSION
	bool "Exclude version"
	default DEFAULT_SMALL

endmenu # Exclude individual procfs entries
endif # FS_PROCFS
```

## fs/romfs/Kconfig
```kconfig
#
# For a description of the syntax of this configuration file,
# see the file kconfig-language.txt in the NuttX tools repository.
#

config FS_ROMFS
	bool "ROMFS file system"
	default n
	depends on !DISABLE_MOUNTPOINT
	---help---
		Enable ROMFS filesystem support

if FS_ROMFS

config FS_ROMFS_CACHE_NODE
	bool "Enable cache node of ROMFS file system"
	default !DEFAULT_SMALL
	---help---
		All node will be cached to ram when file system
		is mounted so that we can quick access entry of ROMFS
		filesystem on emmc/sdcard.

endif
```

## fs/rpmsgfs/Kconfig
```kconfig
#
# For a description of the syntax of this configuration file,
# see the file kconfig-language.txt in the NuttX tools repository.
#

config FS_RPMSGFS
	bool "RPMSG File System"
	default n
	depends on RPMSG
	---help---
		Use RPMSG file system to mount remote directories to local.
		This the method for user to use remote file like own core.

config FS_RPMSGFS_SERVER
	bool "RPMSG File Server"
	default n
	depends on RPMSG
	---help---
		Initialize RPMSG file system server automatically.
```

## fs/semaphore/Kconfig
```kconfig
#
# For a description of the syntax of this configuration file,
# see the file kconfig-language.txt in the NuttX tools repository.
#

config FS_NAMED_SEMAPHORES
	bool "Named semaphore support"
	default n
	---help---
		Include support for named semaphores.

if FS_NAMED_SEMAPHORES

config FS_NAMED_SEMAPHORES_VFS_PATH
	string "Path to semaphore storage"
	default "/var/sem"
	---help---
		The path to where named semaphores will exist in the VFS namespace.

endif # FS_NAMED_SEMAPHORES
```

## fs/smartfs/Kconfig
```kconfig
#
# For a description of the syntax of this configuration file,
# see the file kconfig-language.txt in the NuttX tools repository.
#

config FS_SMARTFS
	bool "SMART file system"
	default n
	depends on !DISABLE_MOUNTPOINT
	---help---
		Enable NuttX SMART Flash file system (SMARTFS) support.

if FS_SMARTFS
config SMARTFS_ERASEDSTATE
	hex "FLASH erased state"
	default 0xff
	range 0x00 0xff
	---help---
		The erased state of FLASH.
		This must have one of the values of 0xff or 0x00.
		Default: 0xff.

config SMARTFS_MAXNAMLEN
	int "Maximum file name length"
	default 16
	---help---
		The maximum size of a SMARTFS file name at a given
		directory level.  Overall path name is not restricted
		by this value, only individual segments in a path,
		such as (assuming /usr is the mount point):

			/usr/games/chess/player_stats/game1.xml

		Default: 16.

config SMARTFS_MULTI_ROOT_DIRS
	bool "Support multiple Root Directories / Mount Points"
	default n
	---help---
		Enables support for multiple root directory entries
		on the SMART FLASH.  Multiple root directories means
		the device can have multiple mount point in the VFS,
		each with it's own unique directory structure under it.

		When this option is enabled, instead of reporting the
		SMART block devices as "/dev/mtdsmart0", they will be
		reported as "/dev/mtdsmart0d1", "/dev/mtdsmart0d2", etc.
		The number of root entries actually created is set
		during the "mksmartfs" command when the device is
		initialized.

		Default: y.

config SMARTFS_ALIGNED_ACCESS
	bool "Ensure 16 and 32 bit accesses are aligned"
	default n
	---help---
		Performs little endian byte accesses to 16 and 32 values
		within the directory list to ensure processors that can't
		handle un-aligned accesses don't bomb out.  Default should
		probably by 'Y', but set to 'N' in case any existing Big
		Endian instances of SmartFS exist that already have
		directories with data stored in big endian mode.

endif
```

## fs/spiffs/Kconfig
```kconfig
#
# For a description of the syntax of this configuration file,
# see the file kconfig-language.txt in the NuttX tools repository.
#

config FS_SPIFFS
	bool "SPIFFS File System"
	default n
	depends on !DISABLE_MOUNTPOINT && ALLOW_BSD_COMPONENTS
	select FS_LARGEFILE
	---help---
		Build the SPIFFS file system.  This is a port of version 0.3.7 of
		the SPIFFS file system by  Peter Andersson.  It was originally
		released under the MIT license.

if FS_SPIFFS

comment "In-memory Cache Options"

config SPIFFS_CACHE_SIZE
	int "Size of the cache"
	default 8192

config SPIFFS_CACHE_HITSCORE
	int "Cache Hit Score"
	default 4
	range 1 255
	---help---
		Temporal file cache hit score. Each time a file is opened, all
		cached files will lose one point. If the opened file is found in
		cache, that entry will gain CONFIG_SPIFFS_CACHE_HITSCORE points.
		One can experiment with this value for the specific access patterns
		of the application. However, it must be between 1 (no gain for
		hitting a cached entry often) and 255.

config SPIFFS_CACHEDBG
	bool "Enable cache debug output"
	default n
	depends on DEBUG_FS_INFO
	---help---
		Dumps cache debug output.  Depends on CONFIG_DEBUG_FS_INFO

comment "Garbage Collection (GC) Options"

config SPIFFS_GC_MAXRUNS
	int "Max GC runs"
	default 5
	---help---
		Define maximum number of gc runs to perform to reach desired free
		pages.

config SPIFFS_GC_DELWGT
	int "Deleted pages weight"
	default 5
	---help---
		Garbage collecting examines all pages in a block which and sums up
		to a block score. Deleted pages normally gives positive score and
		used pages normally gives a negative score (as these must be moved).
		To have a fair wear-leveling, the erase age is also included in
		score, whose factor normally is the most positive.  The larger the
		score, the more likely it is that the block will picked for garbage
		collection.

		This option provides the weight used for deleted pages.

config SPIFFS_GC_USEDWGT
	int "Used pages weight"
	default -1
	---help---
		Garbage collecting examines all pages in a block which and sums up
		to a block score. Deleted pages normally gives positive score and
		used pages normally gives a negative score (as these must be moved).
		To have a fair wear-leveling, the erase age is also included in
		score, whose factor normally is the most positive.  The larger the
		score, the more likely it is that the block will picked for garbage
		collection.

		This option provides the weight used for used pages.

config SPIFFS_GC_ERASEAGEWGT
	int "Used pages weight"
	default 50
	---help---
		Garbage collecting examines all pages in a block which and sums up
		to a block score. Deleted pages normally gives positive score and
		used pages normally gives a negative score (as these must be moved).
		To have a fair wear-leveling, the erase age is also included in
		score, whose factor normally is the most positive.  The larger the
		score, the more likely it is that the block will picked for garbage
		collection.

		This option provides the weight used weight used for time between
		last erased and erase of this block.

config SPIFFS_GCDBG
	bool "Enable garbage collection debug output"
	default n
	depends on DEBUG_FS_INFO
	---help---
		Dumps garbage collection debug output.  Depends on CONFIG_DEBUG_FS_INFO

comment "Consistency Check Options"

config SPIFFS_CHECK_ONMOUNT
	bool "Consistency check on mount"
	default n
	select SPIFFS_CHECK_OUTPUT
	---help---
		Perhaps a full, extended consistency check on mount.  By default, a
		simple scan of the file system only is performed.

config SPIFFS_CHECK_OUTPUT
	bool "Enable consistency check SYSLOG output"
	default n

config SPIFFS_DUMP
	bool "Dump Logical FLASH Content"
	default n
	depends on SPIFFS_CHECK_OUTPUT
	---help---
		Enables support for the FIOC_DUMP IOCTL command which will dump a
		terse summary of the state of each FLASH page.

comment "MTD Interface Options"

config SPIFFS_MTDDBG
	bool "Enable MTD Interface DEBUG"
	default n
	depends on DEBUG_FS_INFO
	---help---
		Dumps MTD debug output.  Depends on CONFIG_DEBUG_FS_INFO

config SPIFFS_MTDDUMP
	bool "Enable MTD Data Dump"
	default n
	depends on SPIFFS_MTDDBG
	---help---
		Dumps every byte of data going to and coming from FLASH.  You
		probably do not want this unless you are debugging a particular
		MTD interfacing issue.

comment "SPIFFS Core Options"

config SPIFFS_NO_BLIND_WRITES
	bool "No blind writes"
	default n
	---help---
		By default SPIFFS in some cases relies on the property of NOR flash
		that bits cannot be set from 0 to 1 by writing and that controllers
		will ignore such bit changes. This results in fewer reads as SPIFFS
		can in some cases perform blind writes, with all bits set to 1 and
		only those it needs reset set to 0.  Most of the chips and
		controllers allow this behavior, so the default is to use this
		technique. If your controller is one of the rare ones that don't,
		turn this option on and SPIFFS will perform a read-modify-write
		instead.

config SPIFFS_PAGE_CHECK
	bool "Check Page Headers"
	default y
	---help---
		Always check header of each accessed page to ensure consistent state.
		If enabled it will increase number of reads, will increase flash.

config SPIFFS_NAME_MAX
	int "Maximum Name Length"
	default 32
	---help---
		Object name maximum length. Note that this length include the zero
		termination character, meaning maximum string of characters.

		Note: This config affects the on-flash structure.

config SPIFFS_COPYBUF_STACK
	int "Max Stack Allocation"
	default 64
	---help---
		Size of buffer allocated on stack used when copying data.  Lower
		value generates more read/writes.  No meaning having it bigger
		than logical page size.

config SPIFFS_COMPAT_OLD_NUTTX
	bool "Compatibility with older NuttX SPIFFS"
	default n
	---help---
		Enable the compatibility with older NuttX versions.
		(Older than NuttX 11.0.0, where this option was introduced.)

		Note: For better compatibility, you may want to disable
		CONFIG_SPIFFS_LEADING_SLASH because those versions of NuttX
		didn't have the option.

		Note: This config affects the on-flash structure.

config SPIFFS_LEADING_SLASH
	bool "Prefix every filename with a slash"
	default y
	---help---
		Assume and ensure that on-flash filenames are always prefixed
		with a slash.
		This enables the compatibility with images generated by
		the following tools:

			* mkspiffs
			* ESP-IDF spiffsgen.py

		Note: SPIFFS_NAME_MAX doesn't include the leading slash appended
		by this option.

		Note: This config affects the on-flash structure.

endif # FS_SPIFFS
```
