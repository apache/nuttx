## fs/hostfs/Kconfig
```kconfig
#
# For a description of the syntax of this configuration file,
# see the file kconfig-language.txt in the NuttX tools repository.
#

config FS_HOSTFS
	bool "Host File System"
	default n
	depends on !DISABLE_MOUNTPOINT
	---help---
		The Host file system provides a mechanism to mount directories
		from the host OS during simulation mode.  The host directory
		to be "mounted" is specified during the mount command using
		the -o command line switch, such as:

			mount -t hostfs -o fs=/home/user/nuttx_root /host

		For non-NSH operation, the option "fs=home/user/nuttx_root" would
		be passed to the 'mount()' routine using the optional 'void *data'
		parameter.

		The backend implementation is arch-dependent.
		As of writing this, it's implemented for sim, arm and xtensa.

		Note: depending on the backend implementions, hostfs might
		only provide very restricted subset of filesystem operations.

		Sim: It's implemented with direct calls to the host OS API.
		It likely consumes a lot of stack than ordinary NuttX codebase.
		You likely need to make task stack sizes huge (e.g. 64KB) to
		avoid stack overrun.

		Arm, xtensa: It's implemented using a special CPU instruction
		to trigger a trap for a hypervisor.
		If you are using qemu, it has the `-semihosting` command line
		option to enable the handling of the trap.
		Theoretically, it can work for other environments as well.
		E.g. a real hardware + JTAG + OpenOCD.
```

## fs/littlefs/Kconfig
```kconfig
config FS_LITTLEFS
	bool "LITTLEFS File System"
	default n
	depends on !DISABLE_MOUNTPOINT
	---help---
		Build the LITTLEFS file system. https://github.com/littlefs-project/littlefs.

if FS_LITTLEFS
config FS_LITTLEFS_PROGRAM_SIZE_FACTOR
	int "LITTLEFS Program size multiplication factor"
	default 4
	---help---
		A factor used for multiplying program size.

		The result is used as the minimum size of a block program in bytes.
		All program operations will be a multiple of the result.

config FS_LITTLEFS_READ_SIZE_FACTOR
	int "LITTLEFS Read size multiplication factor"
	default FS_LITTLEFS_PROGRAM_SIZE_FACTOR
	---help---
		A factor used for multiplying read size.

		The result is used as the minimum size of a block read in bytes.
		All read operations will be a multiple of the result.

config FS_LITTLEFS_BLOCK_SIZE_FACTOR
	int "LITTLEFS Block size multiplication factor"
	default 1
	---help---
		A factor used for multiplying block size and dividing block count.

		The result is size of an erasable block in bytes. This does not impact ram consumption
		and may be larger than the physical erase size. However, non-inlined
		files take up at minimum one block. Must be a multiple of the read and
		program sizes.

config FS_LITTLEFS_CACHE_SIZE_FACTOR
	int "LITTLEFS Cache size multiplication factor"
	default FS_LITTLEFS_READ_SIZE_FACTOR
	---help---
		A factor used for multiplying cache size.

		The result is size of block caches in bytes.
		Each cache buffers a portion of a block in RAM.
		The littlefs needs a read cache, a program cache, and one additional
		cache per file. A larger cache can improve performance by storing more
		data and reducing the number of disk accesses. It must be a multiple of the
		read and program sizes, and a factor of the block size.

config FS_LITTLEFS_LOOKAHEAD_SIZE
	int "LITTLEFS Lookahead size"
	default 0
	---help---
		Size of the lookahead buffer in bytes. A larger lookahead buffer
		increases the number of blocks found during an allocation pass. The
		lookahead buffer is stored as a compact bitmap, so each byte of RAM
		can track 8 blocks. Must be a multiple of 8.

		Set value 0 for enabling internal calculation.

config FS_LITTLEFS_BLOCK_CYCLE
	int "LITTLEFS Block cycle"
	default 200
	---help---
		Number of erase cycles before littlefs evicts metadata logs and moves
		the metadata to another block. Suggested values are in the
		range 100-1000, with large values having better performance at the cost
		of less consistent wear distribution.

		Set to -1 to disable block-level wear-leveling.

config FS_LITTLEFS_NAME_MAX
	int "LITTLEFS LFS_NAME_MAX"
	default NAME_MAX
	---help---
		Configure LFS_NAME_MAX value for LITTLEFS file systems.

		Note: Using a larger value for this configuration makes the lfs_info
		structure larger and thus increases the stack usage.

		Note: To mount a LITTLEFS filesystem, this configuration should
		equal to or larger than the corresponding on-disk parameter.

		Note: Many of tools to generate LITTLEFS images use 255 for
		this by default.

		Note: NuttX releases prior to 10.4.0 (exclusive) uses 255
		for this. If you need to mount LITTLEFS filesystems used by
		previous versions of NuttX, it's safer to use 255.

config FS_LITTLEFS_FILE_MAX
	int "LITTLEFS LFS_FILE_MAX"
	default 2147483647
	---help---
		Configure LFS_FILE_MAX value for LITTLEFS file systems.

		Note: To mount a LITTLEFS filesystem, this configuration should
		equal to or larger than the corresponding on-disk parameter.

		Note: Many of tools to generate LITTLEFS images use 2147483647
		for this by default.

config FS_LITTLEFS_ATTR_MAX
	int "LITTLEFS LFS_ATTR_MAX"
	default 1022
	---help---
		Configure LFS_ATTR_MAX value for LITTLEFS file systems.

		Note: To mount a LITTLEFS filesystem, this configuration should
		equal to or larger than the corresponding on-disk parameter.

		Note: because NuttX's LITTLEFS driver does never use custom attributes,
		the value of this configuration doesn't matter much. The default value
		here is chosen to be compatible with filesystems created by external
		tools. Unlike LFS_NAME_MAX, a large LFS_ATTR_MAX value doesn't
		have any runtime overhead, at least with the implementation as of
		writing this.

		Note: Many of tools to generate LITTLEFS images use 1022
		for this by default.

config FS_LITTLEFS_LOCAL_PATCHES
	bool
	depends on FS_LITTLEFS_VERSION = "v2.5.1"
	default y
	---help---
		For the internal use to control the application of NuttX local
		patches for LITTLEFS.
		This is NOT expected to be tweaked directly by users.

config FS_LITTLEFS_HAS_LFS_DEFINES
	bool "Use LFS_DEFINES (available for littlefs >=2.10.0)"
	depends on !FS_LITTLEFS_LOCAL_PATCHES
	default y
	---help---
		Set this y if you are using littlefs versions which supports
		LFS_DEFINES. (that is, 2.10.0 and later)
		Otherwise, set this n.

		See the littlefs 2.10.0 release notes about what LFS_DEFINES is.
		https://github.com/littlefs-project/littlefs/releases/tag/v2.10.0

config FS_LITTLEFS_ATTR_UPDATE
	bool "LITTLEFS update attributes"
	depends on FS_LITTLEFS_ATTR_MAX > 0
	depends on FS_LITTLEFS_LOCAL_PATCHES
	default y
	---help---
		Enable support for attributes when create a file.

		CAVEAT: This feature is implemented with NuttX specific
		modifications to LITTLEFS v2.5.1. The modifications might
		not be compatible with other versions of LITTLEFS.

config FS_LITTLEFS_GETPATH
	bool "LITTLEFS FIOC_FILEPATH ioctl support"
	depends on FS_LITTLEFS_LOCAL_PATCHES
	default y
	---help---
		FIOC_FILEPATH ioctl support for LITTLEFS file system.

		CAVEAT: This feature is implemented with NuttX specific
		modifications to LITTLEFS v2.5.1. The modifications might
		not be compatible with other versions of LITTLEFS.

config FS_LITTLEFS_VERSION
	string "LITTLEFS version to use"
	default "v2.5.1"
	---help---
		The LITTLEFS version to use.

config FS_LITTLEFS_MULTI_VERSION
	bool "Support multiple on-disk versions"
	default n
	---help---
		Enable LFS_MULTIVERSION for LITTLEFS file system

config FS_LITTLEFS_DISK_VERSION
	hex "LITTLEFS on-disk version"
	default 0x0
	depends on FS_LITTLEFS_MULTI_VERSION
	---help---
		The LITTLEFS disk version to use.

		0 means to leave it to the default from the LITTLEFS.
		0x00020000 means 2.0.
		0x00020001 means 2.1.

endif
```

## fs/mmap/Kconfig
```kconfig
#
# For a description of the syntax of this configuration file,
# see the file kconfig-language.txt in the NuttX tools repository.
#

config FS_RAMMAP
	bool "File mapping emulation"
	default n
	---help---
		NuttX operates in a flat open address space and is focused on MCUs that do
		support Memory Management Units (MMUs).  Therefore, NuttX generally does not
		require mmap() functionality and the MCUs generally cannot support true
		memory-mapped files.

		However, memory mapping of files is the mechanism used by NXFLAT, the NuttX
		tiny binary format, to get files into memory in order to execute them.
		mmap() support is therefore required to support NXFLAT.

		If FS_RAMMAP is defined in the configuration, then mmap() will
		support simulation of memory mapped files by copying files whole
		into RAM.  These copied files have some of the properties of
		standard memory mapped files.

		See nuttx/fs/mmap/README.txt for additional information.

config FS_ANONMAP
	bool "Anonymous mapping emulation"
	default y
	---help---
		Simulate private anonymous mappings by plain malloc
```

## fs/mnemofs/Kconfig
```kconfig
#
# For a description of the syntax of this configuration file,
# see the file kconfig-language.txt in the NuttX tools repository.
#

config FS_MNEMOFS
	bool "MNEMOFS NAND Flash File System"
	default n
	depends on !DISABLE_MOUNTPOINT && MTD_NAND
	---help---
		Build the mnemofs NAND flash file system.
```

## fs/mqueue/Kconfig
```kconfig
#
# For a description of the syntax of this configuration file,
# see the file kconfig-language.txt in the NuttX tools repository.
#

if !DISABLE_MQUEUE

config FS_MQUEUE_VFS_PATH
	string "Path to message queue"
	default "/var/mqueue"
	---help---
		The path to where POSIX message queues will exist in the VFS namespace.

config FS_MQUEUE_NPOLLWAITERS
	int "Maximum number of poll waiters"
	default 4
	---help---
		The maximum number of waiters for the poll operation.

endif # !DISABLE_MQUEUE
```

## fs/nfs/Kconfig
```kconfig
#
# For a description of the syntax of this configuration file,
# see the file kconfig-language.txt in the NuttX tools repository.
#

config NFS
	bool "NFS client file system"
	default n
	depends on !DISABLE_MOUNTPOINT && ALLOW_BSD_COMPONENTS
	select FS_LARGEFILE
	---help---
		Enable network file system (NFS) client file system

if NFS

config NFS_DONT_BIND_TCP_SOCKET
	bool
	default n
	depends on NET_TCP
	---help---
		Some network drivers such as GS2200M do not support to bind
		a local port for TCP client socket. In this case, this config
		disables to bind the port.

config NFS_STATISTICS
	bool "NFS Statistics"
	default n
	depends on NFS
	---help---
		Collect support for NFS statistics.  There is no user interface to
		obtain these statistics, however.  So they would only be of value
		if you add debug instrumentation or use a debugger.

endif
```

## fs/notify/Kconfig
```kconfig
#
# For a description of the syntax of this configuration file,
# see the file kconfig-language.txt in the NuttX tools repository.
#

config FS_NOTIFY
	bool "FS Notify System"
	default n
	---help---
		The Fsnotify System

if FS_NOTIFY
config FS_NOTIFY_BUCKET_SIZE
	int "Dir hash bucket size"
	default 64

config FS_NOTIFY_MAX_EVENTS
	int "Max events in one notify device"
	default 1024

config FS_NOTIFY_FD_POLLWAITERS
	int "Max pollwaiters in one notify devcie"
	default 2

endif # FS_NOTIFY
```

## fs/nxffs/Kconfig
```kconfig
#
# For a description of the syntax of this configuration file,
# see the file kconfig-language.txt in the NuttX tools repository.
#

config FS_NXFFS
	bool "NXFFS file system"
	default n
	depends on !DISABLE_MOUNTPOINT
	---help---
		Enable NuttX FLASH file system (NXFF) support.

if FS_NXFFS

config NXFFS_SCAN_VOLUME
	bool "Scan volume"
	default n
	---help---
		Scan the media for bad blocks on start-up.  If too many bad or
		unformatted blocks are found, then re-format the volume.  Otherwise,
		the volume will be reformatted only if no NXFFS file system is
		found.

		Why might you want to do this?  If too many bad blocks accumulate
		over time, then attempting to reformat my be the only way to
		recover.  And what if you power down the device while formatting
		the FLASH so that you have only a partially formatted device?
		Scanning the volume can get you out of these situations.

		The down side is that scanning the volume can adversely affect
		your start-up time.  An option is to just erase the FLASH and
		reboot in these cases.  That can be done with MDIOC_BULKERASE
		IOCTL command.

config NXFFS_NAND
	bool "Enable NAND support"
	default n
	depends on EXPERIMENTAL
	---help---
		NAND differs from other other FLASH types several ways.  For one
		thing, NAND requires error correction (ECC) bytes that must be set
		in order to work around bit failures.  This affects NXFFS in two
		ways:

		First, write failures are not fatal. Rather, they should be tried by
		bad blocks and simply ignored.  This is because unrecoverable bit
		failures will cause read failures when reading from NAND.  Setting
		this option will enable this behavior.

		Secondly, NXFFS will write a block many times.  It tries to keep
		bits in the erased state and assumes that it can overwrite those
 		bits to change them from the erased to the non-erased state.  This
		works will with NOR-like FLASH.  NAND behaves this way too.  But the
		problem with NAND is that the ECC bits cannot be re-written in this
		way.  So once a block has been written, it cannot be modified.  This
		behavior has NOT been fixed in NXFFS.  Currently, NXFFS will attempt
		to re-write the ECC bits causing the ECC to become corrupted because
		the ECC bits cannot be overwritten without erasing the entire block.

		This may prohibit NXFFS from ever being used with NAND.

config NXFFS_REFORMAT_THRESH
	int "Reformat percentage"
	default 20
	range 0 100
	depends on NXFFS_SCAN_VOLUME
	---help---
		This defines the threshold for re-formatting.  Is less than this
		percentage of good blocks are found, then the volume is re-
		formatted.

config NXFFS_PREALLOCATED
	bool "Single, preallocated volume"
	default y
	---help---
		If CONFIG_NXFSS_PREALLOCATED is defined, then this is the single, pre-
		allocated NXFFS volume instance.  Currently required because full,
		dynamic allocation of NXFFS volumes in not yet supported.

config NXFFS_ERASEDSTATE
	hex "FLASH erased state"
	default 0xff
	---help---
		The erased state of FLASH.
		This must have one of the values of 0xff or 0x00.
		Default: 0xff.

config NXFFS_PACKTHRESHOLD
	int "Re-packing threshold"
	default 32
	---help---
		When packing flash file data,
		don't both with file chunks smaller than this number of data bytes.
		Default: 32.

config NXFFS_MAXNAMLEN
	int "Maximum file name length"
	default 255
	---help---
		The maximum size of an NXFFS file name.
		Default: 255.

config NXFFS_TAILTHRESHOLD
	int "Tail threshold"
	default 8192
	---help---
		Clean-up can either mean packing files together toward the end of
		the file or, if files are deleted at the end of the file, clean up
		can simply mean erasing the end of FLASH memory so that it can be
		re-used again.  However, doing this can also harm the life of the
		FLASH part because it can mean that the tail end of the FLASH is
		re-used too often. This threshold determines if/when it is worth
		erased the tail end of FLASH and making it available for re-use
		(and possible over-wear). Default: 8192.

endif
```

## fs/partition/Kconfig
```kconfig
#
# For a description of the syntax of this configuration file,
# see the file kconfig-language.txt in the NuttX tools repository.
#

if !DISABLE_MOUNTPOINT

menu "Partition Table"

config PTABLE_PARTITION
	bool "PTABLE support"
	default n

config MBR_PARTITION
	bool "MBR support"
	default n

config GPT_PARTITION
	bool "GPT support"
	default n

config TXTABLE_PARTITION
	bool "TXTABLE support"
	default n

if TXTABLE_PARTITION

config TXTABLE_PARTITION_MAX_NUM
	int "Max num of TXTABLE partition"
	default 16

endif

endmenu

endif
```
