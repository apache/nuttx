## drivers/reset/Kconfig
```kconfig
#
# For a description of the syntax of this configuration file,
# see the file kconfig-language.txt in the NuttX tools repository.
#

menuconfig RESET
	bool "reset driver Support"
	default n
	---help---
		This selection enables building of the "upper-half" reset driver.

config RESET_RPMSG
	bool "Reset rpmsg driver support"
	depends on RESET && RPTUN
	default n
	---help---
		This selection enables rpmsg support for reset.

config RESET_PROCFS
	bool "Reset procfs entry"
	depends on RESET && FS_PROCFS && FS_PROCFS_REGISTER
	default n
	---help---
		Create /proc/reset, listing every registered reset controller and,
		for those that supply a get_line method, one line per reset line
		in key:value form.

		status() reads one line at a time, but nothing else in the
		interface says how many lines a controller has or what any of them
		is called, so without this the only way to see which peripherals
		are held is a program that knows the numbering already.
```

## drivers/rpmsg/Kconfig
```kconfig
#
# For a description of the syntax of this configuration file,
# see the file kconfig-language.txt in the NuttX tools repository.
#

config RPMSG
	bool
	default n
	select OPENAMP

if RPMSG

config RPMSG_TRACE
	bool "rpmsg trace"
	default n
	depends on SCHED_INSTRUMENTATION_DUMP
	---help---
		Record the messages passed through the rpmsg transports in the
		note stream under NOTE_TAG_RPMSG, so they can be read back with
		the note drivers (e.g. /dev/note/ram).

config RPMSG_TRACE_BACKTRACE
	int "rpmsg trace backtrace depth"
	default 0
	range 0 16
	depends on RPMSG_TRACE
	---help---
		Number of frames recorded with a trace that asks for a
		backtrace. 0 disables backtraces.

config RPMSG_PROCFS
	bool "Include rpmsg info in procfs"
	depends on FS_PROCFS_REGISTER
	default !DEFAULT_SMALL
	---help---
		Add /proc/rpmsg, which lists the local and the remote CPU of every
		registered rpmsg device.

config RPMSG_LOCAL_CPUNAME
	string "Rpmsg Local Cpuname"
	default LIBC_HOSTNAME

config RPMSG_PING
	bool "rpmsg ping support"
	default n
	---help---
		This is for debugging & profiling, create ping rpmsg
		channel, user can use it to get send/recv speed & latency.

config RPMSG_TEST
	bool "rpmsg test support"
	default n

config RPMSG_WAKELOCK
	bool "rpmsg wakelock support"
	default n
	depends on PM
	---help---
		Let a CPU hold a PM wakelock on the remote CPU through the
		RPMSGIOC_ACQUIRE_WAKELOCK and RPMSGIOC_RELEASE_WAKELOCK ioctls.
		Both sides of the link must enable it.

config RPMSG_PANIC_DUMP_LEVEL
	int "rpmsg panic dump level"
	default 1 if DEFAULT_SMALL
	default 2 if !DEFAULT_SMALL
	---help---
		Control rpmsg auto dump behavior on panic at
		PANIC_KERNEL_FINAL stage:
		  0 - Disable: no dump on panic
		  1 - Info: brief dump on panic
		  2 - Verbose: full dump on panic
		Manual rpmsg dump command is not affected.

endif # RPMSG

config RPMSG_ROUTER
	bool "rpmsg router support"
	default n
	---help---
		Rpmsg router driver for enabling communication
		without physical channels.

config RPMSG_PORT
	bool
	default n
	select RPMSG
	---help---
		Rpmsg port transport layer used for cross chip communication.

config RPMSG_PORT_SPI
	bool "Rpmsg SPI Port Driver Support"
	default n
	depends on SPI
	select RPMSG_PORT
	---help---
		Rpmsg SPI Port driver used for cross chip communication.

config RPMSG_PORT_SPI_SLAVE
	bool "Rpmsg SPI Slave Port Driver Support"
	default n
	select RPMSG_PORT
	---help---
		Rpmsg SPI Slave Port driver used for cross chip communication.

if RPMSG_PORT_SPI || RPMSG_PORT_SPI_SLAVE

config RPMSG_PORT_SPI_THREAD_PRIORITY
	int "Rpmsg SPI Port Thread Priority"
	default 224

config RPMSG_PORT_SPI_THREAD_STACKSIZE
	int "Rpmsg SPI Port Stack Size"
	default 4096

config RPMSG_PORT_SPI_CRC
	bool "Rpmsg SPI Port Use Checksum"
	default n
	---help---
		Check every frame with a 16-bit XOR checksum (xorsum16()). It
		catches corrupted framing at little cost, but it is not a CRC: it
		misses errors that flip the same bit in two 16-bit words.

config RPMSG_PORT_SPI_RX_THRESHOLD
	int "Rpmsg SPI Port Rx Buffer Threshold"
	default 50
	range 0 100

config RPMSG_PORT_SPI_PM_TIMEOUT
	int "Rpmsg SPI Port PM Stay Timeout in Milliseconds"
	default 1
	depends on PM

endif # RPMSG_PORT_SPI

config RPMSG_PORT_UART
	bool "Rpmsg Uart Port Driver Support"
	default n
	depends on SCHED_EVENTS
	select RPMSG_PORT
	---help---
		Rpmsg Uart Port driver used for cross chip communication.

if RPMSG_PORT_UART

config RPMSG_PORT_UART_RX_THREAD_PRIORITY
	int "Rpmsg UART Port RX Thread Priority"
	default 224

config RPMSG_PORT_UART_RX_THREAD_STACKSIZE
	int "Rpmsg UART Port RX Stack Size"
	default DEFAULT_TASK_STACKSIZE

config RPMSG_PORT_UART_TX_THREAD_PRIORITY
	int "Rpmsg UART Port TX Thread Priority"
	default 224

config RPMSG_PORT_UART_TX_THREAD_STACKSIZE
	int "Rpmsg UART Port TX Stack Size"
	default DEFAULT_TASK_STACKSIZE

config RPMSG_PORT_UART_CRC
	bool "Rpmsg UART Port Checksum Enable"
	default n
	---help---
		Check every frame with a 16-bit XOR checksum (xorsum16()). It
		catches corrupted framing at little cost, but it is not a CRC: it
		misses errors that flip the same bit in two 16-bit words.

config RPMSG_PORT_UART_COMPRESSION
	bool "Rpmsg UART Port LZF Compression"
	default n
	depends on LIBC_LZF
	---help---
		Enable LZF compression for rpmsg port uart data frames.
		Compresses payload before byte-escaping to reduce UART
		bandwidth usage. Both TX and RX sides must enable this.

config RPMSG_PORT_UART_DEBUG
	bool "Rpmsg UART DEBUG Enable"
	default n

endif # RPMSG_PORT_UART

config RPMSG_VIRTIO
	bool
	default n
	select RPMSG
	---help---
		The Rpmsg VirtIO Lite, VirtIO-Rpmsg and VHost-Rpmsg common
		part.

if RPMSG_VIRTIO

config RPMSG_VIRTIO_PRIORITY
	int "rpmsg virtio priority"
	default 224

config RPMSG_VIRTIO_STACKSIZE
	int "rpmsg virtio stack size"
	default DEFAULT_TASK_STACKSIZE

config RPMSG_VIRTIO_PM
	bool "RPMsg VirtIO power management"
	depends on PM
	default n
	---help---
		If TX/RX buffer is supplied and powered by each CPU.
		And when one CPU in DEEP sleep, then it's buffer will
		goto RAM-retention mode, can't access from another CPU.
		So, we provide this method to resolve this.

config RPMSG_VIRTIO_PM_AUTORELAX
	bool "RPMsg VirtIO pm autorelax"
	depends on RPMSG_VIRTIO_PM
	default y
	---help---
		Enable automatic power management wakelock relaxation using watchdog timer.

		When enabled, this option uses a watchdog timer to periodically check if
		there are any tx buffers is not returned by remote core. If the tx buffers
		are returned by remote core, the power management wakelock is automatically
		released, allowing the system to enter low-power states. If the tx buffers
		are still not returned by remote core, the wakelock is maintained and the
		timer is restarted.

		Autorelax feature can improve power efficiency in multi-core systems because
		it prevents unnecessary power consumption by reducing the times that system
		enter and leave low-power states.

endif # RPMSG_VIRTIO
```

## drivers/rptun/Kconfig
```kconfig
#
# For a description of the syntax of this configuration file,
# see the file kconfig-language.txt in the NuttX tools repository.
#

menuconfig RPTUN
	bool "Remote Proc Tunnel Driver Support"
	default n
	select RPMSG_VIRTIO
	---help---
		RPTUN driver is used for multi-cores' communication.

if RPTUN

choice RPTUN_AUTO_RESET
	prompt "rptun auto reset peer"
	default RPTUN_AUTO_RESET_IN_PANIC_NOTIFIER

config RPTUN_AUTO_RESET_DISABLE
	bool "rptun auto reset feature disabled"

config RPTUN_AUTO_RESET_IN_PANIC_NOTIFIER
	bool "rptun panic other core in panic notifier"
	---help---
		Panic peer in the panic notifier and Reboot/Poweroff peer in
		the reboot notifier. This mode is used for the case that the
		main core do the coredump after panic all the peer cores.

config RPTUN_AUTO_RESET_IN_REBOOT_NOTIFIER
	bool "rptun panic other core in reboot notifier"
	---help---
		Panic/Reboot/Poweroff peer all in the reboot notifier.
		This mode is used for the case that all the core do its
		coredump by itself.

endchoice # RPTUN_AUTO_RESET

config RPTUN_BMP
	bool "rptun bmp support"
	default n
	---help---
		This is a rptun driver for communications in bmp
		environments. With this driver, Each ends communicate with each
		other by using the native rpmsg
		or various Rpmsg services have been implemented in NuttX.

config RPTUN_IVSHMEM
	bool "rptun ivshmem support"
	default n
	depends on PCI_IVSHMEM && DEV_SIMPLE_ADDRENV
	---help---
		This is rptun driver based on pci ivshmem.

if RPTUN_IVSHMEM

config RPTUN_IVSHMEM_NAME
	string "rptun ivshmem name"
	---help---
		Using this config to custom the rptun ivshmem cpuname and role,
		using ";" to split the names.
		For example, if RPTUN_IVSHMEM_CPUNAME = "0:cpu1:m;1:cpu2:s" and pass
		two ivshmem devices to the qemu, we will get two rptun ivshmem
		drivers with ivshmem device match id: [0, 1],
		remote cpu names: ["cpu1", "cpu2"] and roles: ["master", "slave"']

config RPTUN_IVSHMEM_BUFFSIZE
	int "rptun ivshmem rpmsg buffer size"
	default 2048
	---help---
		The rpmsg buffer size in resource table, the RX and TX buffer size
		are same for now.

config RPTUN_IVSHMEM_BUFFNUM
	int "rptun ivshmem rpmsg buffer number"
	default 8
	---help---
		The rpmsg buffer number in resource table, the RX and TX buffer number
		are same for now.

endif

config RPTUN_PRIORITY
	int "rptun thread priority"
	default 224

config RPTUN_STACKSIZE
	int "rptun stack size"
	default 4096

config RPTUN_STATUS_TIMEOUT_MS
	int "rptun status timeout ms"
	default 5000

config RPTUN_LOADER
	bool "rptun loader support"
	default n

endif # RPTUN
```

## drivers/tee/Kconfig
```kconfig
#
# For a description of the syntax of this configuration file,
# see the file kconfig-language.txt in the NuttX tools repository.
#

choice
	prompt "Select OP-TEE dev implementation"
	default DEV_OPTEE_NONE
	---help---
		There are three implementations of optee server,
		one is soft tee server which does not distinguish
		between secure and non-secure states and uses socket communication,
		and the other two is teeos which runs in the secure state of
		the cpu and uses either RPMsg cross-core communication or arm SMCs.
		Warning: SMC implementation has only been tested on arm64.

config DEV_OPTEE_LOCAL
	bool "OPTEE Local Socket Support"
	depends on NET_LOCAL
	depends on FS_ANONMAP
	depends on ALLOW_BSD_COMPONENTS

config DEV_OPTEE_RPMSG
	bool "OP-TEE RPMSG Socket Support"
	depends on NET_RPMSG
	depends on FS_ANONMAP
	depends on ALLOW_BSD_COMPONENTS

config DEV_OPTEE_SMC
	bool "OP-TEE SMC CC Support"
	depends on ARCH_ARM || ARCH_ARM64
	depends on FS_ANONMAP
	depends on ALLOW_BSD_COMPONENTS

config DEV_OPTEE_NONE
	bool "Disable OP-TEE driver"

endchoice

config DEV_OPTEE_SUPPLICANT
	bool "Enables kernel driver for TEE supplicant"
	default n
	depends on DEV_OPTEE_SMC

if DEV_OPTEE_RPMSG

config OPTEE_REMOTE_CPU_NAME
	string "The cpuname on which the OP-TEE server runs"
	default "tee"

endif # DEV_OPTEE_RPMSG

if DEV_OPTEE_SMC

choice
	prompt "Select OP-TEE conduit method"
	default DEV_OPTEE_SMC_CONDUIT_SMC
	---help---
		Select between the 2 supported conduit methods for invoking the secure
		world: SMC (when running at EL1) and HVC (when running at EL2, which is
		not supported by NuttX yet).

config DEV_OPTEE_SMC_CONDUIT_SMC
	bool "Use SMC calls to invoke OP-TEE"

config DEV_OPTEE_SMC_CONDUIT_HVC
	bool "Use HVC calls to invoke OP-TEE"

endchoice

endif # DEV_OPTEE_SMC
```

## drivers/thermal/Kconfig
```kconfig
#
# For a description of the syntax of this configuration file,
# see the file kconfig-language.txt in the NuttX tools repository.
#

menuconfig THERMAL
	bool "Thermal framework"
	default n
	depends on SCHED_LPWORK
	---help---
		Enable thermal framework.

if THERMAL

config THERMAL_DEFAULT_GOVERNOR
	string "Thermal default governor name"
	default "step_wise"
	---help---
		Default governor name.

config THERMAL_GOVERNOR_STEP_WISE
	bool "Enable step wise governor"
	default y
	---help---
		Enable step wise governor.

config THERMAL_CDEV_DEVFREQ
	bool "Thermal devfreq cooling device"
	default n
	depends on DEVFREQ
	---help---
		Enable thermal devfreq cooling device, which cools a device by
		capping the frequency of its devfreq instance.

if THERMAL_CDEV_DEVFREQ

config THERMAL_CDEV_DEVFREQ_NAME
	string "Name of the devfreq device to cool"
	default "cpu"
	---help---
		The devfreq device this cooling device caps, and the name the
		cooling device itself takes, so that a zone's cooling map can
		refer to it.  The devfreq device must be registered before
		thermal_init() runs.

endif # THERMAL_CDEV_DEVFREQ

config THERMAL_PROCFS
	bool "Thermal PROCFS support"
	default n
	depends on FS_PROCFS
	---help---
		Enable thermal procfs.

config THERMAL_DUMMY
	bool "Thermal dummy driver"
	default n
	---help---
		Enable thermal dummy driver.

if THERMAL_DUMMY

config THERMAL_DUMMY_POLLING_DELAY
	int "Polling delay"
	default 200
	---help---
		Polling delay(tick).

config THERMAL_DUMMY_DEVFREQ
	bool "Dummy devfreq driver"
	default n
	depends on DEVFREQ
	select THERMAL_CDEV_DEVFREQ
	---help---
		Enable devfreq dummy driver, giving the dummy zone a frequency
		capped cooling device as well as its fan.

endif # THERMAL_DUMMY

endif # THERMAL
```
