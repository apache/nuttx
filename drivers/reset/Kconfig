## drivers/vhost/Kconfig
```kconfig
#
# For a description of the syntax of this configuration file,
# see the file kconfig-language.txt in the NuttX tools repository.
#

config ARCH_HAVE_VHOST_IOMAP
	bool
	default n

config DRIVERS_VHOST
	bool
	select OPENAMP
	select SCHED_WORKQUEUE
	default n
	---help---
		Framework for implementing the DEVICE side of virtio links
		(the peer's driver uses us as the device, e.g. a remoteproc
		master like Linux).  rptun registers device-role vdevs from the
		resource table through this bus; without it such vdevs are
		rejected with -ENODEV.

config DRIVERS_VHOST_I2C
	bool "Virtual Host I2C Device Support"
	default n
	select I2C
	select DRIVERS_VHOST
	---help---
		Enable the vhost (device-side) I2C backend.  When an rptun resource
		table exposes a VirtIO I2C adapter device (device ID 34) in the
		device role, this driver serves the request virtqueue, decodes each
		request with the OASIS VirtIO I2C wire format, and forwards it to the
		local I2C device node named in the device config space.  This lets
		one NuttX instance export an I2C bus to a remote VirtIO I2C frontend,
		the native-VirtIO counterpart of the RPMSG I2C server.

config DRIVERS_VHOST_BLK
	bool "Virtual Host Blk Device Support"
	default n
	select DRIVERS_VHOST

if DRIVERS_VHOST_BLK

config DRIVERS_VHOST_BLK_PRIORITY
	int "vhost blk thread priority"
	default 224

config DRIVERS_VHOST_BLK_STACKSIZE
	int "vhost blk stack size"
	default 4096

endif # DRIVERS_VHOST_BLK

config DRIVERS_VHOST_RNG
	bool "Virtual Host Rng Device Support"
	default n
	select DRIVERS_VHOST

config DRIVERS_VHOST_NET
	bool "Virtual Host Network Device Support"
	default n
	depends on NETDEVICES
	select ARCH_HAVE_NETDEV_STATISTICS
	select DRIVERS_VHOST
	---help---
		Device-role virtio-net: expose this side as a network card to a
		peer processor running a standard virtio-net driver (e.g. Linux
		via remoteproc), providing a NuttX ethN interface.

config DRIVERS_VHOST_NET_MACADDR
	hex "vhost-net MAC address"
	default 0x0
	depends on DRIVERS_VHOST_NET
	---help---
		Fixed, software-assigned, locally administered MAC address
		presented to the network stack when the peer does not publish a
		valid address in the configuration space.  Set to 0 to generate
		a random locally administered unicast address instead.

config DRIVERS_VHOST_RPMSG
	bool "Virtual Host Rpmsg Device Support"
	default n
	select RPMSG_VIRTIO
	select DRIVERS_VHOST

config DRIVERS_VHOST_CAN
	bool "Virtual Host CAN Device Support"
	depends on NET_CAN
	default n
	select DRIVERS_VHOST
	---help---
		Enable the vhost CAN backend.  It bridges a VirtIO CAN device
		(device ID 36) to a local SocketCAN interface, forwarding frames
		between the peer's tx/rx/control virtqueues and the local bus.

config DRIVERS_VHOST_RPMB
	bool "Virtual Host RPMB Device Support"
	default n
	select DRIVERS_VHOST
	---help---
		Enable the vhost (device-side) RPMB backend.  It bridges a VirtIO
		RPMB device (device ID 22) to the RPMB partition of a local eMMC,
		forwarding the peer's RPMB frames as MMC_IOC_MULTI_CMD requests.
		The local block device is named by a path in the device config
		space, and the capacity and reliable-write count read from its
		EXT_CSD are published back through the config space.

if DRIVERS_VHOST_RPMB

config DRIVERS_VHOST_RPMB_PRIORITY
	int "vhost rpmb thread priority"
	default 224

config DRIVERS_VHOST_RPMB_STACKSIZE
	int "vhost rpmb stack size"
	default DEFAULT_TASK_STACKSIZE

endif

config DRIVERS_VHOST_SERIAL
	bool "Virtual Host Serial Device Support"
	default n
	select DRIVERS_VHOST

if DRIVERS_VHOST_SERIAL

config DRIVERS_VHOST_SERIAL_PRIORITY
	int "vhost serial thread priority"
	default 224

config DRIVERS_VHOST_SERIAL_STACKSIZE
	int "vhost serial stack size"
	default DEFAULT_TASK_STACKSIZE

endif # DRIVERS_VHOST_SERIAL
```

## drivers/wireless/ieee80211/morse/Kconfig
```kconfig
#
# For a description of the syntax of this configuration file,
# see the file kconfig-language.txt in the NuttX tools repository.
#

config IEEE80211_MORSE
	bool "Morse Micro Wi-Fi HaLow (IEEE 802.11ah) support"
	default n
	depends on SPI && NET && NETDEV_WIRELESS_HANDLER
	depends on ARCH_CORTEXM4 || ARCH_CORTEXM7 || ARCH_CORTEXM33
	depends on ARCH_FPU
	depends on !LIBC_LOCALTIME
	depends on ARCH_HAVE_SETJMP
	depends on DEV_RANDOM || DEV_URANDOM
	select ARCH_SETJMP_H
	select LIBC_CTYPE_TABLE
	select SCHED_WORKQUEUE
	select SCHED_HPWORK
	---help---
		Driver for the Morse Micro MM6108/MM8108 Wi-Fi HaLow transceivers
		(e.g. the Quectel FGH100M module) connected through SPI.

		The 802.11ah MAC, the WPA3-SAE/OWE supplicant and the transceiver
		transport are provided by the Morse Micro host library (libmorse,
		part of the MM-IoT-SDK).  The needed SDK files (about 3 MB) are
		downloaded at build time and libmorse is linked as a pre-built
		library distributed under the Morse Micro Binary Distribution
		License.  The chip firmware and the board configuration file (BCF)
		are embedded in the NuttX image.

		See Documentation/os/drivers/special/wireless/morse.rst.

		libmorse is built against newlib: it needs setjmp() and the
		newlib compatible _ctype_ table.  The NuttX localtime support
		(LIBC_LOCALTIME) is not compatible because its mktime() writes the
		NuttX specific tm_gmtoff/tm_zone fields of struct tm.

		WPA3-SAE needs a good entropy source: a random device
		(DEV_RANDOM, ideally backed by a hardware RNG, or DEV_URANDOM) is
		required.

if IEEE80211_MORSE

choice
	prompt "Transceiver"
	default IEEE80211_MORSE_MM6108

config IEEE80211_MORSE_MM6108
	bool "MM6108"

config IEEE80211_MORSE_MM8108
	bool "MM8108"

endchoice # Transceiver

config IEEE80211_MORSE_SDK_VERSION
	string "MM-IoT-SDK version"
	default "2.13.1"
	---help---
		Version (git tag) of the Morse Micro MM-IoT-SDK the files are
		downloaded from (https://github.com/MorseMicro/mm-iot-sdk).  The
		driver is tested with the default version.

choice
	prompt "Board configuration file (BCF)"
	default IEEE80211_MORSE_BCF_QUECTEL_FGH100MH

config IEEE80211_MORSE_BCF_QUECTEL_FGH100MH
	bool "Quectel FGH100M-H (FGH100MHAAMD)"
	depends on IEEE80211_MORSE_MM6108
	---help---
		BCF of the Quectel FGH100M-H module (used e.g. on the Seeed Studio
		Wi-Fi HaLow module for XIAO).  It is downloaded from the
		MorseMicro/morse-firmware repository and converted to the mbin
		format with the SDK tool (requires python3 with pyelftools).

config IEEE80211_MORSE_BCF_SDK
	bool "BCF from the SDK"
	---help---
		Use one of the BCF files distributed with the SDK, in
		framework/morsefirmware/<chip>/bcfs.

config IEEE80211_MORSE_BCF_CUSTOM
	bool "Custom BCF file"

endchoice # BCF

config IEEE80211_MORSE_BCF_NAME
	string "SDK BCF file name"
	default "bcf_mf16858.mbin"
	depends on IEEE80211_MORSE_BCF_SDK

config IEEE80211_MORSE_BCF_PATH
	string "Custom BCF file path"
	default ""
	depends on IEEE80211_MORSE_BCF_CUSTOM
	---help---
		Absolute path of the BCF file, in mbin format.

config IEEE80211_MORSE_COUNTRY
	string "Default country code"
	default "US"
	---help---
		Two letter country code selecting the regulatory domain (channel
		list and transmit power limits).  It can be changed at run time
		while disconnected, e.g. "wapi country wlan0 AU".

config IEEE80211_MORSE_SPI_FREQUENCY
	int "SPI frequency (Hz)"
	default 20000000
	---help---
		Default SPI clock frequency, used when the board lower half does
		not provide one.  The SPI driver selects the closest frequency
		that is not higher.

config IEEE80211_MORSE_TASK_PRIORITY
	int "Driver task priority"
	default 110
	---help---
		Priority of the libmorse "normal" priority tasks and of the network
		RX thread.  The other libmorse task priorities are spread around
		this value.

config IEEE80211_MORSE_CONNECT_TIMEOUT
	int "Connection timeout (s)"
	default 30
	---help---
		Maximum time the connect request (e.g. "wapi essid") waits for the
		link to come up.  On timeout the driver keeps on trying in the
		background.

config IEEE80211_MORSE_TX_TIMEOUT
	int "TX flow control timeout (ms)"
	default 100
	---help---
		Maximum time to wait for the transceiver TX queues before dropping
		a packet.

config IEEE80211_MORSE_TX_QUOTA
	int "TX packet quota"
	default 8

config IEEE80211_MORSE_RX_QUOTA
	int "RX packet quota"
	default 8

config IEEE80211_MORSE_SCAN_BUFSIZE
	int "Scan result buffer size"
	default 4096

config IEEE80211_MORSE_LIBLOG
	bool "Enable libmorse log output"
	default n
	---help---
		Route the libmorse log messages to the syslog.

endif # IEEE80211_MORSE
```

## drivers/wireless/lpwan/Kconfig
```kconfig
#
# For a description of the syntax of this configuration file,
# see the file kconfig-language.txt in the NuttX tools repository.
#

if DRIVERS_LPWAN

config LPWAN_LORA_GW
	bool
	default n
	---help---
		Selected by the driver of a LoRa gateway, that is, of a concentrator
		registering the character device described by
		include/nuttx/wireless/lpwan/lora_gw.h.  An application driving a
		gateway depends on this symbol rather than on one particular chip.

config LPWAN_RN2XX3
	bool "Microchip RN2xx3 driver support"
	default n
	depends on SERIAL
	---help---
		Enable driver support for the RN2xx3 LoRa radio transceiver family.

config LPWAN_SX126X
	bool "SX126X Low Power Long Range transceiver support"
	default n
	select SPI
	---help---
		This options adds driver support for the Samtech SX126X chip.

source "drivers/wireless/lpwan/sx126x/Kconfig"

config LPWAN_SX127X
	bool "SX127X Low Power Long Range transceiver support"
	default n
	select SPI
	---help---
		This options adds driver support for the Samtech SX127X chip.

source "drivers/wireless/lpwan/sx127x/Kconfig"

config LPWAN_SX1301
	bool "SX1301 LoRa concentrator (gateway) support"
	default n
	select SPI
	select LPWAN_LORA_GW
	---help---
		This option adds driver support for the Semtech SX1301 LoRa
		concentrator, the baseband processor of a LoRaWAN gateway, together
		with its two SX125x radio front-ends.  Registers a character device
		delivering received packets and accepting downlinks.

source "drivers/wireless/lpwan/sx1301/Kconfig"

endif # DRIVERS_LPWAN
```

## drivers/wireless/lpwan/sx127x/Kconfig
```kconfig
#
# For a description of the syntax of this configuration file,
# see the file kconfig-language.txt in the NuttX tools repository.
#

if LPWAN_SX127X

config LPWAN_SX127X_RFFREQ_DEFAULT
	int "SX127X default RF frequency"
	default 433000000

config LPWAN_SX127X_SPIFREQ
	int "SX127X SPI frequency"
	default 1000000
	---help---
		SX127X SPI frequency up to 10MHz

config LPWAN_SX127X_TXPOWER_DEFAULT
	int "SX127X default TX power"
	default 17

config LPWAN_SX127X_PREAMBLE_DEFAULT
	int "SX127X default preamble length"
	default 8

config LPWAN_SX127X_MODULATION_DEFAULT
	int "SX127X default modulation scheme"
	default 3 if LPWAN_SX127X_LORA
	default 1 if LPWAN_SX127X_FSKOOK
	range 1 3
	---help---
		1 - FSK, 2 - OOK, 3 - LORA

config LPWAN_SX127X_CRCON
	int "SX127X CRC ON"
	range 0 1
	default 1

config LPWAN_SX127X_RXSUPPORT
	bool "SX127X RX support"
	default n

if LPWAN_SX127X_RXSUPPORT

config LPWAN_SX127X_RXFIFO_LEN
	int "SX127X RX FIFO length"
	default 5

config LPWAN_SX127X_RXFIFO_DATA_LEN
	int "SX127X RX FIFO data length"
	default 64

config LPWAN_SX127X_RX_TIMEOUT
	int "SX127X RX Timeout in Milliseconds"
	default 10000
	---help---
		If device stopped receiving data for more than
		LPWAN_SX127X_RX_TIMEOUT milliseconds it means the
		frequency drift is too high that AFC failed to fix
		the reception frequency. So if we leave the RX mode,
		entering in standby and returning will clear the
		AFC and fix the communication again.
		If you don't want to use RX timeout set it to -1.

endif #LPWAN_SX127X_RXSUPPORT

config LPWAN_SX127X_TXSUPPORT
	bool "SX127X TX support"
	default n

config LPWAN_SX127X_LORA
	bool "SX127X LORA support"
	default y

if LPWAN_SX127X_LORA

config LPWAN_SX127X_LORA_IMPHEADER
	int "SX127X LORA implicit header ON"
	range 0 1
	default 0

config LPWAN_SX127X_LORA_SYNCWORD
	hex "SX127X LORA sync word"
	default 0x12
	---help---
		Sync word written to the modem: 0x12 for a private network, 0x34
		for the public LoRaWAN network.  A gateway configured for the
		public network does not even detect a frame sent with the private
		sync word, so this has to match the other end.

config LPWAN_SX127X_LORA_BW_DEFAULT
	int "SX127X LORA default bandwidth"
	default 0
	range 0 9
	---help---
		Bandwidth used until it is changed: 0 = 7.8 kHz, 1 = 10.4 kHz,
		2 = 15.6 kHz, 3 = 20.8 kHz, 4 = 31.2 kHz, 5 = 41.4 kHz,
		6 = 62.5 kHz, 7 = 125 kHz, 9 = 250 kHz.  LoRaWAN uses 125 kHz.

config LPWAN_SX127X_LORA_SF_DEFAULT
	int "SX127X LORA default spreading factor"
	default 7
	range 6 12

endif # LPWAN_SX127X_LORA

config LPWAN_SX127X_FSKOOK
	bool "SX127X FSK/OOK support"
	default n

if LPWAN_SX127X_FSKOOK

choice
	prompt "SX127X Bitrate"
	default LPWAN_SX127X_FSKOOK_4800

config LPWAN_SX127X_FSKOOK_4800
	bool "4800 BPS"

config LPWAN_SX127X_FSKOOK_38400
	bool "38400 BPS"

config LPWAN_SX127X_FSKOOK_76800
	bool "76800 BPS"

endchoice

endif # LPWAN_SX127X_FSKOOK

endif # WL_SX127X
```

## drivers/wireless/lpwan/sx1301/Kconfig
```kconfig
#
# For a description of the syntax of this configuration file,
# see the file kconfig-language.txt in the NuttX tools repository.
#

if LPWAN_SX1301

config LPWAN_SX1301_SPIFREQ
	int "SX1301 SPI frequency"
	default 8000000
	---help---
		SPI clock frequency used to talk to the concentrator.  The SX1301
		accepts up to 10 MHz.

config LPWAN_SX1301_DEFAULT_REGION
	string "Default channel plan"
	default "AU915"
	---help---
		Channel plan selected when the driver is registered.  One of AU915,
		AU915-1, US915, US915-1, EU868, AS923, KR920 or IN866, and it can be
		changed at runtime with WLIOC_GW_SETREGION.

		AU915 and US915 default to the second sub-band (channels 8 to 15 plus
		the 500 kHz channel 65), which is what The Things Network and the
		Brazilian deployments use.  The "-1" variants select the first
		sub-band (channels 0 to 7 plus channel 64).

config LPWAN_SX1301_PRIVATE_NETWORK
	bool "Private network sync word"
	default n
	---help---
		Use the sync word of a private LoRa network (frame synchronisation
		peaks at 1 and 2, matching 0x12 on an SX127x) instead of the public
		LoRaWAN one (peaks at 3 and 4, matching 0x34).  A gateway that does
		not match the end devices never detects a frame.

config LPWAN_SX1301_RXBADCRC
	bool "Report packets with a bad CRC"
	default n
	---help---
		By default a packet whose CRC failed is counted and dropped, since
		most of them are correlator false triggers and a gateway must not
		forward them to the network server.  Enable this to have them
		returned by read() with status LORA_GW_STAT_CRC_BAD, which is useful
		when debugging the receive chain.

config LPWAN_SX1301_RXNOCRC
	bool "Report packets received without CRC"
	default n
	---help---
		A LoRaWAN uplink always carries a CRC, so a packet arriving without
		one is either a correlator false trigger or the downlink of another
		gateway nearby.  Both are counted and dropped by default, as the
		reference packet forwarder does.  Enable this to have them returned
		by read() with status LORA_GW_STAT_NO_CRC.

endif # LPWAN_SX1301
```
