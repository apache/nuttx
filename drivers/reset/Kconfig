## fs/aio/Kconfig
```kconfig
#
# For a description of the syntax of this configuration file,
# see the file kconfig-language.txt in the NuttX tools repository.
#

config FS_AIO
	bool "Asynchronous I/O support"
	default n
	depends on SCHED_WORKQUEUE && !DISABLE_ALL_SIGNALS
	---help---
		Enable support for asynchronous I/O.  This selection enables the
		interfaces declared in include/aio.h.

config FS_AIO_LISTIO_MAX
	int "Maximum number of AIO operations in listio"
	default 10
	---help---
		This option sets the maximum number of asynchronous I/O (AIO) operations
		that can be submitted in a single call to lio_listio().

		This value defines the upper limit for the 'nent' parameter in
		lio_listio(mode, aiocb_list, nent, sevp). Increasing this value allows
		more operations to be queued.
		Default: 10

if FS_AIO

config FS_NAIOC
	int "Pre-allocated AIO containers"
	default 8
	---help---
		The AIO containers hold an AIO control block and appends information
		needed by the logic running within the RTOS.  These structures are
		pre-allocated, the number pre-allocated controlled by this setting.

		This setting controls the number of asynchronous I/O operations that
		can be queued at one time.  When this count is exhausted, the caller
		of aio_read(), aio_write(), or aio_fsync() will be forced to wait
		for an available container.  That wait is minimized because each
		container is released prior to starting the next I/O.

		The AIO logic includes priority inheritance logic to prevent
		priority inversion problems:  The priority of the low-priority work
		queue will be boosted, if necessary, to level of the waiting thread.

endif
```

## fs/shm/Kconfig
```kconfig
#
# For a description of the syntax of this configuration file,
# see the file kconfig-language.txt in the NuttX tools repository.
#

config FS_SHMFS
	bool "Shared memory support"
	default n
	select ARCH_VMA_MAPPING if BUILD_KERNEL
	---help---
		Include support for shm_open() and shm_close.

if FS_SHMFS

config FS_SHMFS_VFS_PATH
	string "Path to shared memory object storage"
	default "/var/shm"
	---help---
		The path to where shared memory objects will exist in the VFS
		namespace.

config FS_SHMFS_NO_ALIGN
	bool "Skip cache-line alignment/padding of shm objects"
	default n
	---help---
		Skip cache-line alignment of the shm object metadata header and
		the object length. Saves RAM in FLAT builds where shm objects
		are never used as DMA targets and no cache maintenance is
		performed on their contents. Callers that need DMA-safe shm
		buffers must not enable this.

endif # FS_SHMFS
```

## fs/xipfs/Kconfig
```kconfig
#
# For a description of the syntax of this configuration file,
# see the file kconfig-language.txt in the NuttX tools repository.
#

config FS_XIPFS
	bool "XIPFS contiguous execute-in-place file system"
	default n
	depends on !DISABLE_MOUNTPOINT && MTD
	---help---
		Enable support for XIPFS, a file system that stores each file as a
		single physically contiguous, erase-block aligned extent on memory
		mapped flash.

		Because files are contiguous and the media is directly addressable,
		XIPFS can return a real pointer into flash from mmap(), so a module
		can be executed in place without its read-only text and rodata ever
		being copied into RAM.  This requires the underlying MTD driver to
		implement the BIOC_XIPBASE ioctl.

		Files are write once: a file is created at a known size, written
		sequentially, closed, and is immutable thereafter until it is
		deleted.  Random writes, appends and growth are not supported.

		Directories are supported.  They are records in the same metadata
		generation the files are, not objects in the data region, so an
		empty one costs one entry out of the volume's fixed supply and no
		flash blocks at all.

if FS_XIPFS

config FS_XIPFS_FAULT_INJECT
	bool "XIPFS flash fault injection"
	default n
	---help---
		Add a countdown to the XIPFS flash write and erase paths so that a
		test can fail an arbitrary flash operation and then remount, which
		models a power loss at that exact point.

		This is a test-only facility.  Do not enable it in production.

endif # FS_XIPFS
```

## libs/libc/machine/risc-v/Kconfig
```kconfig
#
# For a description of the syntax of this configuration file,
# see the file kconfig-language.txt in the NuttX tools repository.
#

config RISCV_STRING_FUNCTION
	bool "Enable optimized RISC-V specific string function"
	default n
	depends on ARCH_TOOLCHAIN_GNU
	select RISCV_MEMCPY
	select RISCV_MEMSET
	select RISCV_MEMMOVE
	select RISCV_MEMCMP
	select RISCV_MEMCHR
	select RISCV_STRCMP
	select RISCV_STRLEN
	select RISCV_STRNLEN
	select RISCV_STRCPY
	select RISCV_STRNCPY
	select RISCV_STPCPY
	select RISCV_STPNCPY
	select RISCV_STRCHR
	select RISCV_STRCHRNUL
	select RISCV_STRRCHR
	select RISCV_STRNCMP
	select RISCV_STRCAT
	select RISCV_STRLCPY

config RISCV_MEMCPY
	bool "Enable optimized memcpy() for RISC-V"
	select LIBC_ARCH_MEMCPY
	depends on ARCH_TOOLCHAIN_GNU
	---help---
		Enable optimized RISC-V specific memcpy() library function

config RISCV_MEMSET
	bool "Enable optimized memset() for RISC-V"
	default n
	select LIBC_ARCH_MEMSET
	depends on ARCH_TOOLCHAIN_GNU
	---help---
		Enable optimized RISC-V specific memset() library function

config RISCV_MEMMOVE
	bool "Enable optimized memmove() for RISC-V"
	default n
	select LIBC_ARCH_MEMMOVE
	depends on ARCH_TOOLCHAIN_GNU
	---help---
		Enable optimized RISC-V specific memmove() library function

config RISCV_MEMCMP
	bool "Enable optimized memcmp() for RISC-V"
	default n
	select LIBC_ARCH_MEMCMP
	depends on ARCH_TOOLCHAIN_GNU
	---help---
		Enable optimized RISC-V specific memcmp() library function

config RISCV_MEMCHR
	bool "Enable optimized memchr() for RISC-V"
	default n
	select LIBC_ARCH_MEMCHR
	depends on ARCH_TOOLCHAIN_GNU
	---help---
		Enable optimized RISC-V specific memchr() library function

config RISCV_STRCMP
	bool "Enable optimized strcmp() for RISC-V"
	default n
	select LIBC_ARCH_STRCMP
	depends on ARCH_TOOLCHAIN_GNU
	---help---
		Enable optimized RISC-V specific strcmp() library function

config RISCV_STRLEN
	bool "Enable optimized strlen() for RISC-V"
	default n
	select LIBC_ARCH_STRLEN
	depends on ARCH_TOOLCHAIN_GNU
	---help---
		Enable optimized RISC-V specific strlen() library function

config RISCV_STRNLEN
	bool "Enable optimized strnlen() for RISC-V"
	default n
	select LIBC_ARCH_STRNLEN
	depends on ARCH_TOOLCHAIN_GNU
	---help---
		Enable optimized RISC-V specific strnlen() library function

config RISCV_STRCPY
	bool "Enable optimized strcpy() for RISC-V"
	default n
	select LIBC_ARCH_STRCPY
	depends on ARCH_TOOLCHAIN_GNU
	---help---
		Enable optimized RISC-V specific strcpy() library function

config RISCV_STRNCPY
	bool "Enable optimized strncpy() for RISC-V"
	default n
	select LIBC_ARCH_STRNCPY
	depends on ARCH_TOOLCHAIN_GNU
	---help---
		Enable optimized RISC-V specific strncpy() library function

config RISCV_STPCPY
	bool "Enable optimized stpcpy() for RISC-V"
	default n
	select LIBC_ARCH_STPCPY
	depends on ARCH_TOOLCHAIN_GNU
	---help---
		Enable optimized RISC-V specific stpcpy() library function

config RISCV_STPNCPY
	bool "Enable optimized stpncpy() for RISC-V"
	default n
	select LIBC_ARCH_STPNCPY
	depends on ARCH_TOOLCHAIN_GNU
	---help---
		Enable optimized RISC-V specific stpncpy() library function

config RISCV_STRCHR
	bool "Enable optimized strchr() for RISC-V"
	default n
	select LIBC_ARCH_STRCHR
	depends on ARCH_TOOLCHAIN_GNU
	---help---
		Enable optimized RISC-V specific strchr() library function

config RISCV_STRCHRNUL
	bool "Enable optimized strchrnul() for RISC-V"
	default n
	select LIBC_ARCH_STRCHRNUL
	depends on ARCH_TOOLCHAIN_GNU
	---help---
		Enable optimized RISC-V specific strchrnul() library function

config RISCV_STRRCHR
	bool "Enable optimized strrchr() for RISC-V"
	default n
	select LIBC_ARCH_STRRCHR
	depends on ARCH_TOOLCHAIN_GNU
	---help---
		Enable optimized RISC-V specific strrchr() library function

config RISCV_STRNCMP
	bool "Enable optimized strncmp() for RISC-V"
	default n
	select LIBC_ARCH_STRNCMP
	depends on ARCH_TOOLCHAIN_GNU
	---help---
		Enable optimized RISC-V specific strncmp() library function

config RISCV_STRCAT
	bool "Enable optimized strcat() for RISC-V"
	default n
	select LIBC_ARCH_STRCAT
	depends on ARCH_TOOLCHAIN_GNU
	---help---
		Enable optimized RISC-V specific strcat() library function

config RISCV_STRLCPY
	bool "Enable optimized strlcpy() for RISC-V"
	default n
	select LIBC_ARCH_STRLCPY
	depends on ARCH_TOOLCHAIN_GNU
	---help---
		Enable optimized RISC-V specific strlcpy() library function
```

## libs/libc/machine/tricore/Kconfig
```kconfig
#
# For a description of the syntax of this configuration file,
# see the file kconfig-language.txt in the NuttX tools repository.
#

config TRICORE_STRING_FUNCTION
	bool "Enable optimized TriCore specific string/memory functions"
	default n
	select TRICORE_MEMCPY
	select TRICORE_MEMSET
	select TRICORE_MEMMOVE
	select TRICORE_MEMCMP
	select TRICORE_MEMCHR
	select TRICORE_STRCMP
	select TRICORE_STRCPY
	select TRICORE_STRLEN
	select TRICORE_STRCHR
	select TRICORE_STRCHRNUL
	select TRICORE_STRNCMP
	select TRICORE_STRNLEN
	select TRICORE_STRNCPY
	select TRICORE_STPCPY
	select TRICORE_STRRCHR
	---help---
		Enable the full set of TriCore assembly library functions as a
		group: memcpy/memset/memmove/memcmp/memchr and the string ops
		strcmp/strcpy/strlen/strchr/strchrnul/strncmp/strnlen/strncpy/
		stpcpy/strrchr.  Real on-board benchmarks (rzcu/lzcu B2, TC4Z9)
		show the group ahead of the BSD C versions overall, most functions
		substantially so.
		The block-move routines (memcpy/memset/memmove) align to an 8-byte
		boundary before issuing quad ld.dd/st.dd so that stores to DLMU
		shared memory (0xB0/0x90, 64-bit ECC granularity) always write whole
		ECC words; memcmp/strcmp are read-only (ld.w) and carry no ECC risk.
		strlen and the remaining functions are enabled individually once
		their assembly proves faster than the C baseline.

config TRICORE_MEMCPY
	bool "Enable optimized memcpy() for TriCore"
	default n
	select LIBC_ARCH_MEMCPY
	---help---
		Enable the optimized TriCore specific memcpy() library function.
		Uses ld.d/st.d block moves and the hardware loop instruction.

config TRICORE_MEMSET
	bool "Enable optimized memset() for TriCore"
	default n
	select LIBC_ARCH_MEMSET
	---help---
		Enable the optimized TriCore specific memset() library function.

config TRICORE_MEMMOVE
	bool "Enable optimized memmove() for TriCore"
	default n
	select LIBC_ARCH_MEMMOVE
	---help---
		Enable the optimized TriCore specific memmove() library function.

config TRICORE_MEMCMP
	bool "Enable optimized memcmp() for TriCore"
	default n
	select LIBC_ARCH_MEMCMP
	---help---
		Enable the optimized TriCore specific memcmp() library function.

config TRICORE_MEMCHR
	bool "Enable optimized memchr() for TriCore"
	default n
	select LIBC_ARCH_MEMCHR
	---help---
		Enable the optimized TriCore specific memchr() library function.

config TRICORE_STRCPY
	bool "Enable optimized strcpy() for TriCore"
	default n
	select LIBC_ARCH_STRCPY
	---help---
		Enable the optimized TriCore specific strcpy() library function.

config TRICORE_STRCMP
	bool "Enable optimized strcmp() for TriCore"
	default n
	select LIBC_ARCH_STRCMP
	---help---
		Enable the optimized TriCore specific strcmp() library function.
		On-board benchmarks show a 1.13-1.71x win for strings >= 32 bytes.

config TRICORE_STRLEN
	bool "Enable optimized strlen() for TriCore"
	default n
	select LIBC_ARCH_STRLEN
	---help---
		Enable the optimized TriCore specific strlen() library function.
		Note: the BSD C word-at-a-time strlen currently outperforms a
		byte-scanning assembly version on long strings, so this is left
		off by default until a word-at-a-time assembly proves faster.

config TRICORE_STRCHR
	bool "Enable optimized strchr() for TriCore"
	default n
	select LIBC_ARCH_STRCHR
	---help---
		Enable the optimized TriCore specific strchr() library function.

config TRICORE_STRCHRNUL
	bool "Enable optimized strchrnul() for TriCore"
	default n
	select LIBC_ARCH_STRCHRNUL
	---help---
		Enable the optimized TriCore specific strchrnul() library function.

config TRICORE_STRNCMP
	bool "Enable optimized strncmp() for TriCore"
	default n
	select LIBC_ARCH_STRNCMP
	---help---
		Enable the optimized TriCore specific strncmp() library function.

config TRICORE_STRNLEN
	bool "Enable optimized strnlen() for TriCore"
	default n
	select LIBC_ARCH_STRNLEN
	---help---
		Enable the optimized TriCore specific strnlen() library function.

config TRICORE_STRRCHR
	bool "Enable optimized strrchr() for TriCore"
	default n
	select LIBC_ARCH_STRRCHR
	---help---
		Enable the optimized TriCore specific strrchr() library function.

config TRICORE_STRNCPY
	bool "Enable optimized strncpy() for TriCore"
	default n
	select LIBC_ARCH_STRNCPY
	---help---
		Enable the optimized TriCore specific strncpy() library function.

config TRICORE_STPCPY
	bool "Enable optimized stpcpy() for TriCore"
	default n
	select LIBC_ARCH_STPCPY
	---help---
		Enable the optimized TriCore specific stpcpy() library function.
```

## libs/libc/pthread/Kconfig
```kconfig
#
# For a description of the syntax of this configuration file,
# see the file kconfig-language.txt in the NuttX tools repository.
#

menu "pthread support"
	depends on !DISABLE_PTHREAD

config PTHREAD_SPINLOCKS
	bool "pthread spinlock support"
	default n
	depends on BUILD_FLAT || LIBC_ATOMIC_TOOLCHAIN || LIBC_ATOMIC_ARCH
	---help---
		Enable support for pthread spinlocks (pthread_spin_init() and
		the other pthread_spin_*() functions).  A spin lock is an atomic
		variable in the memory of the program: lock and unlock need no
		system call, also in protected and kernel builds.

		Outside a flat build, the atomic operations must work in user
		mode.  LIBC_ATOMIC_IRQ and LIBC_ATOMIC_HWSPINLOCK disable the
		interrupts, which user mode cannot do.

		Prefer a mutex: a spin lock only helps on SMP, with very short
		critical sections.

config PTHREAD_ATFORK
	bool "pthread_atfork support"
	default n
	---help---
		Enable support for pthread_atfork.

endmenu # pthread support
```
