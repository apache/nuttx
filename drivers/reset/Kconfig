## libs/libc/stdlib/Kconfig
```kconfig
#
# For a description of the syntax of this configuration file,
# see the file kconfig-language.txt in the NuttX tools repository.
#

menu "stdlib Options"

config LIBC_HOMEDIR
	string "Home directory"
	default "/"
	---help---
		The home directory to use with operations like such as 'cd ~'

config LIBC_TMPDIR
	string "Temporary file directory"
	default "/tmp"
	---help---
		If a write-able file system is selected, this string will be
		provided to specify the full path to a directory where temporary
		files can be created.  This would be a good application of RAM disk:
		To provide temporary storage for application data.

config LIBC_MAX_TMPFILE
	int "Maximum size of a temporary file path"
	default 32
	---help---
		If a write-able file system is selected, then temporary file may be
		supported at the path provided by LIBC_TMPDIR.  The tmpnam() interface
		keeps a static copy of this last filename produced; this value is the
		maximum size of that last filename.  This size is the size of the full
		file path.

config LIBC_MAX_EXITFUNS
	int "Number of preallocated exit functions"
	default 0
	---help---
		The number of exit functions (atexit(), on_exit(), at_quick_exit()
		and the C++ __cxa_atexit()) that the task information of each
		process holds.  More functions come from the heap, 8 at a time,
		so the number is limited only by memory.  The entries in the task
		information need no heap, also not at start-up.

		With 0, there are no exit functions: atexit(), on_exit() and
		at_quick_exit() are not built, so a program that calls them does
		not link, and __cxa_atexit() registers nothing (the destructors
		of static C++ objects do not run).  A C++ ELF program (built with
		-fno-use-cxa-atexit) with a static object in a function calls
		atexit(), so it needs a value larger than 0.

config LIBC_DISABLE_HEXSTR_TO_FLOAT
	bool "Disable hex-string to float/double conversions"
	default DEFAULT_SMALL
	---help---
		Disables parsing of hexadecimal floating-point constants (C99 %a),
		e.g., "0x1.fp3", in strtod(), strtof(), strtold(), and sscanf("%a").
		This saves flash space since hex-float parsing adds significant code
		and is rarely needed in embedded systems. Decimal float parsing remains
		available.

endmenu # stdlib Options
```

## libs/libc/stream/Kconfig
```kconfig
#
# For a description of the syntax of this configuration file,
# see the file kconfig-language.txt in the NuttX tools repository.
#

menu "Stream C I/O"

if LIBC_LZF

config STREAM_LZF_BLOG
	int "Log2 of block size"
	default 10
	range 9 12
	---help---
		This stream uses two buffers of size a little more than
		(1 << CONFIG_STREAM_LZF_BLOG) to compress and decompress data in
		chunks. Slightly better compression should be obtainable with larger

		NOTE:  This is a pairing option for using the decompression tool,
		       chunks must match with compression

endif

config STREAM_OUT_BUFFER_SIZE
	int "Output stream buffer size"
	default 64

config STREAM_HEXDUMP_BUFFER_SIZE
	int "Output hexdump stream buffer size"
	default 128

config STREAM_BASE64_BUFFER_SIZE
	int "Output base64 stream buffer size"
	default 128

config LIBC_BFORMAT_B16
	bool "Treat %hf in binary format strings as b16_t"
	default n
	---help---
		The binary format functions lib_bsprintf() and lib_bscanf() (used,
		for example, by the uORB listener and generator) read and write
		the members of a structure according to a printf-style format
		string.  By default %hf is a float.  If this option is enabled,
		%hf is a b16_t (16.16 fixed-point) value instead.

		This option is selected by SENSORS_USE_B16, so that the sensor
		data can be printed and scanned when sensor_data_t is b16_t.

		Without LIBC_FLOATINGPOINT, b16_t values are printed as
		"integer.fraction" with four decimal digits and the width and
		precision of the conversion are ignored.  Scanning %hf into a
		b16_t requires LIBC_FLOATINGPOINT; without it, scanning is not
		supported (as for float).

endmenu # Locale Support
```

## libs/libc/tls/Kconfig
```kconfig
#
# For a description of the syntax of this configuration file,
# see the file kconfig-language.txt in the NuttX tools repository.
#

menu "Thread Local Storage (TLS)"

config TLS_EMUTLS
	bool "Per-thread copies of emulated TLS variables"
	default y
	depends on (ARCH_TOOLCHAIN_GNU && !ARCH_TOOLCHAIN_ARMCLANG && !ARCH_TOOLCHAIN_GHS && !ARCH_AVR && !ARCH_SIM) || (ARCH_SIM && SIM_TOOLCHAIN_GCC && !HOST_MACOS && !WINDOWS_NATIVE)
	---help---
		GCC and clang call __emutls_get_address() for __thread variables
		when the target has no native TLS, or with -femulated-tls.  libc
		then gives one copy of each variable per thread, and the link
		sends the calls to it with --wrap.  8-bit AVR has no atomic pointer
		loads.  The sim has it only with GCC and the GNU linker (Linux,
		MinGW): the macOS linker and the MSVC linker have no --wrap.

		With LTO every program links this code (about 1 KiB on Cortex-M).
		A board that has no space for it can disable it: then all threads
		share one copy of each __thread variable, as with libgcc.

config TLS_ALIGNED
	bool "Require stack alignment"
	default BUILD_KERNEL || BUILD_PROTECTED
	---help---
		Aligned TLS works by fetching thread information from the beginning
		of the stack memory allocation.  In order to do this, the memory
		must be aligned in such a way that the executing logic can simply
		mask the current stack pointer to get the beginning of the stack
		allocation.

		The advantage of using an aligned stack is no OS interface need
		be called to get the beginning of the stack.  It is simply an
		AND operation on the current stack pointer.  The disadvantages
		are that the alignment (1) causes memory fragmentation which can
		be a serious problem for memory limited systems, and (2) limits
		the maximum size of the stack.  Any mask places a limit on the
		maximum size of the stack; stack sizes about that would map to
		an incorrect address.

		In general, CONFIG_TLS_ALIGNED is preferred for the KERNEL
		build where the virtualized stack address can be aligned with
		no implications to physical memory.  In other builds, the
		unaligned stack implementation is usually superior.

config TLS_LOG2_MAXSTACK
	int "Maximum stack size (log2)"
	default 13
	range 11 24
	depends on TLS_ALIGNED
	---help---
		This setting specifies the alignment of the stack as a power of 2:
		11=2KB, 12=4KB, 13=8KB, etc.  The exact alignment is not so critical
		except that (1) a very large value can cause you to run out of
		alignable memory (and fail memory allocations), and (2) smaller
		values will limit the maximum size of the stack (hence the naming
		of this configuration value).  A request for a larger stack fails
		with EINVAL.

config TLS_NELEM
	int "Number of TLS elements"
	depends on !DISABLE_PTHREAD
	default 0
	range 0 255
	---help---
		The number of unique TLS elements.  These can be accessed with
		the user library functions tls_get_value() and tls_set_value()
		and the OS interfaces tls_alloc() and tls_free().

		NOTE that the special value of CONFIG_TLS_NELEM disables these
		TLS interfaces.

config TLS_TASK_NELEM
	int "Number of Task Local Storage elements"
	depends on !BUILD_KERNEL
	default 0
	range 0 255
	---help---
		The number of unique Task Local Storage elements similar with
		Thread Local Storage.
		These can be accessed with task_tls_alloc/task_tls_get_value/task_tls_set_value.
		NOTE that the 0 value of CONFIG_SCHED_TLS_NELEM disables these
		TLS interfaces.

config TLS_NCLEANUP
	int "Number of cleanup stack levels"
	default 0
	range 0 255
	---help---
		The number of cleanup stack levels.  These are used to support
		POSIX pthread cancellation.  The number of cleanup stack levels
		is the maximum number of pthread_cleanup_push() calls that can
		be made without a corresponding pthread_cleanup_pop() call.
		With 0, pthread_cleanup_push() and pthread_cleanup_pop() do not
		exist and a program that calls them does not link.  Each level
		costs two pointers in every thread.

endmenu # Thread Local Storage (TLS)
```

## libs/libc/wqueue/Kconfig
```kconfig
#
# For a description of the syntax of this configuration file,
# see the file kconfig-language.txt in the NuttX tools repository.
#

menu "User Work Queue Support"
	depends on !BUILD_FLAT

config LIBC_USRWORK
	bool "User mode worker thread"
	default n
	depends on BUILD_PROTECTED || !DISABLE_PTHREAD
	---help---
		User-space work queues provide deferred processing in protected and
		kernel builds.  Dynamically allocated user-mode work queues require
		pthread support.  The predefined protected-build USRWORK queue does
		not require pthread support.

if LIBC_USRWORK

config LIBC_USRWORKPRIORITY
	int "User mode priority worker thread priority"
	default 100
	---help---
		The execution priority of the user-mode priority worker thread.  Default: 100

config LIBC_USRWORKSTACKSIZE
	int "User mode worker thread stack size"
	default DEFAULT_TASK_STACKSIZE
	---help---
		The stack size allocated for the lower priority worker thread.  Default: 2K.

endif # LIBC_USRWORK
endmenu # User Work Queue Support
```

## libs/zblue/audio/Kconfig
```kconfig
############################################################################
# libs/zblue/audio/Kconfig
#
# Ported to Apache NuttX by chao an
# <anchao.archer@bytedance.com>.
#
############################################################################

# Bluetooth Audio configuration options

#
# Copyright (c) 2020 Intel Corporation
# Copyright (c) 2022-2026 Nordic Semiconductor ASA
#
# SPDX-License-Identifier: Apache-2.0
#

menuconfig BT_AUDIO
	bool "Bluetooth Audio support"
	help
	  This option enables Bluetooth Audio support. The specific
	  features that are available may depend on other features
	  that have been enabled in the stack, such as Periodic
	  Advertisement for Broadcast and L2CAP Dynamic Channel
	  for Unicast.

if BT_AUDIO

config BT_AUDIO_RX
	def_bool BT_ASCS_ASE_SNK || BT_BAP_UNICAST_CLIENT_ASE_SRC || BT_BAP_BROADCAST_SINK
	help
	  Indicates that the stack is configured with support for receiving
	  audio (for example as a unicast Audio Stream sink or a Broadcast
	  Sink). This internal option is derived automatically and is not meant
	  to be set directly.

config BT_AUDIO_TX
	def_bool BT_ASCS_ASE_SRC || BT_BAP_UNICAST_CLIENT_ASE_SNK || BT_BAP_BROADCAST_SOURCE
	help
	  Indicates that the stack is configured with support for transmitting
	  audio (for example as a unicast Audio Stream source or a Broadcast
	  Source). This internal option is derived automatically and is not
	  meant to be set directly.

config BT_AUDIO_NOTIFY_RETRY_DELAY
	int "Delay for notification sending retried attempt in 1.25 ms units"
	range 6 3200
	default 20
	help
	  This option sets the time in 1.25 ms units before the stack will
	  retry to send notification that failed due to lack of TX buffers
	  available.

source "libs/zblue/audio/Kconfig.bap"
source "libs/zblue/audio/Kconfig.ccp"
source "libs/zblue/audio/Kconfig.vocs"
source "libs/zblue/audio/Kconfig.aics"
source "libs/zblue/audio/Kconfig.vcp"
source "libs/zblue/audio/Kconfig.micp"
source "libs/zblue/audio/Kconfig.csip"
source "libs/zblue/audio/Kconfig.tbs"
source "libs/zblue/audio/Kconfig.mcs"
source "libs/zblue/audio/Kconfig.has"
source "libs/zblue/audio/Kconfig.mpl"
source "libs/zblue/audio/Kconfig.mctl"
source "libs/zblue/audio/Kconfig.cap"
source "libs/zblue/audio/Kconfig.tmap"
source "libs/zblue/audio/Kconfig.gmap"
source "libs/zblue/audio/Kconfig.pbp"

module = BT_AUDIO
module-str = "Bluetooth Audio"
# source "subsys/logging/Kconfig.template.log_config"

endif # BT_AUDIO
```
