## drivers/wireless/cc3000/Kconfig
```kconfig
#
# For a description of the syntax of this configuration file,
# see misc/tools/kconfig-language.txt.
#

config WL_CC3000
	bool "CC3000 Wireless Module"
	default n
	select SPI
	select ARCH_HAVE_NET
	---help---
		Enable support for the TI CC3000 Wifi Module

if WL_CC3000

config CC3000_MULTIPLE
	bool "Multiple CC3000 Devices"
	default n
	---help---
		Can be defined to support multiple CC3000 devices on board.

config CC3000_NPOLLWAITERS
	int "Number poll waiters"
	default 4
	depends on !DISABLE_POLL
	---help---
		Maximum number of threads that can be waiting on poll()

config CC3000_SPIDEV
	int "SPI bus number"
	default 2
	---help---
		Selects the SPI bus number identying that SPI interface that
		connects the CC3000 to the MCU.

config CC3000_DEVMINOR
	int "Input device minor number"
	default 0
	---help---
		The CC3000 device will be registered as /dev/wirelessN where N is the
		value provided by this setting.

config CC3000_SPI_MODE
	int "SPI mode"
	default 1
	range 0 3
	---help---
		Controls the SPI mode. The device should work in mode 1, but
		sometimes you need to experiment.

config CC3000_SPI_FREQUENCY
	int "SPI frequency"
	default 16000000
	---help---
		Define to use a different SPI bus frequency.

config CC3000_WORKER_STACKSIZE
	int "Worker thread stack size"
	default 240

config CC3000_SELECT_STACKSIZE
	int "Select thread stack size"
	default 368

config CC3000_UNSOLICED_STACKSIZE
	int "Unsolicited thread stack size"
	default 264

config CC3000_PROBES
	bool "Thread probes"
	default n
	---help---
		Select to use DO and D1 to indicate worker thread and ISR

endif
```

## drivers/wireless/ieee80211/bcm43xxx/Kconfig
```kconfig
#
# For a description of the syntax of this configuration file,
# see the file kconfig-language.txt in the NuttX tools repository.
#

config IEEE80211_BROADCOM_FULLMAC
	bool
	default n

config IEEE80211_BROADCOM_HAVE_CLM
	bool
	default n

config IEEE80211_BROADCOM_BCM4301X
	bool "Broadcom 4301x chip support"
	depends on IEEE80211_BROADCOM_FULLMAC
	default n
	select IEEE80211_BROADCOM_HAVE_CLM

config IEEE80211_BROADCOM_BCM43362
	bool "Broadcom 43362 chip support"
	depends on IEEE80211_BROADCOM_FULLMAC
	default n

config IEEE80211_BROADCOM_BCM43438
	bool "Broadcom 43438 chip support"
	depends on IEEE80211_BROADCOM_FULLMAC
	default n
	select IEEE80211_BROADCOM_HAVE_CLM

config IEEE80211_BROADCOM_BCM43455
	bool "Broadcom 43455 chip support"
	depends on IEEE80211_BROADCOM_FULLMAC
	default n
	select IEEE80211_BROADCOM_HAVE_CLM

config IEEE80211_BROADCOM_FWFILES
	bool "Firmware files"
	default y
	depends on IEEE80211_BROADCOM_BCM4301X || \
               IEEE80211_BROADCOM_BCM43362 || \
               IEEE80211_BROADCOM_BCM43438 || \
               IEEE80211_BROADCOM_BCM43455
	---help---
		By default, firmware and CLM files are provided in memory.
		This selection enables an option to load the firmware and CLM
		files from a mounted file system.

		A snapshot of file for the BCM43362 are available in the tools
		repository:  https://bitbucket.org/nuttx/tools/src/master/bcm43438/

		The latest files from Cypress are available in the Linux kernel:
		https://git.kernel.org/pub/scm/linux/kernel/git/firmware/linux-firmware.git/tree/brcm
		The 43438 is a variant of the 43430 and will even identify itself as
		such.  The calibration file used in the past is called:
		brcmfmac43430-sdio.AP6212.txt. The firmware is brcmfmac43430-sdio.bin

		If not defined, then your board support logic will have to
		to provide the firmware files (and CLM files for the CBM43438)
		in board/src directory.  For the BCM43362, the following would
		need to be provided:

		  const uint8_t bcm43362_firmware_image[];
		  const unsigned int bcm43362_firmware_image_len;

		For the BCM43438, the following would need to be provided.

		  const uint8_t ap6212_firmware_image[];
		  const unsigned int ap6212_firmware_len;

		  const uint8_t ap6212_clm_blob[];
		  const unsigned int ap6212_clm_blob_len;

		NVRAM files are currently only supported from memory.  The following
		must be provided all configurations.  For the BCM43362:

		  const char bcm43362_nvram_image[];
		  const unsigned int bcm43362_nvram_image_len;

		And for the BCM43438:

		  const char ap6212_nvram_image[];
		  const unsigned int ap6212_nvram_image_len;

config IEEE80211_BROADCOM_FWFILENAME
	string "Firmware file"
	default "/mnt/sdcard/firmware.bin"
	depends on IEEE80211_BROADCOM_FWFILES
	---help---
		If firmware files are provided on a file system, then this option
		provides the full path to the file on a mounted file system where
		the firmware can be found.

config IEEE80211_BROADCOM_NVFILENAME
	string "Firmware file"
	default "/mnt/sdcard/nvram.bin"
	depends on IEEE80211_BROADCOM_FWFILES
	---help---
		If firmware files are provided on a file system, then this option
		provides the full path to the file on a mounted file system where
		the firmware can be found.

config IEEE80211_BROADCOM_FWCLMNAME
	string "CLM file"
	default "/mnt/sdcard/blob.bin"
	depends on IEEE80211_BROADCOM_FWFILES && IEEE80211_BROADCOM_HAVE_CLM
	---help---
		If firmware files are provided on a file system, then this option
		provides the full path to the file on a mounted file system where
		the CLM blob can be found.

config IEEE80211_BROADCOM_FULLMAC_SDIO
	bool "Broadcom FullMAC driver on SDIO bus"
	depends on ARCH_HAVE_SDIO
	select IEEE80211_BROADCOM_FULLMAC
	default n
	---help---
		This selection enables support for broadcom
		FullMAC-compliant devices using SDIO bus.

config IEEE80211_BROADCOM_SCHED_PRIORITY
	int "Broadcom BCMF daemon thread schedule priority"
	default 255
	---help---
		This parameter should be set the bcmf daemon thread
		schedule priority

if IEEE80211_BROADCOM_FULLMAC

config IEEE80211_BROADCOM_NINTERFACES
	int "Number of Broadcom FullMAC interfaces"
	default 1
	depends on EXPERIMENTAL

config IEEE80211_BROADCOM_DMABUF_ALIGNMENT
	int "DMA buffer address alignment boundary"
	default 4
	range 4 64
	---help---
		This parameter should be set depending on
		the used SOC DMA configuration.

config IEEE80211_BROADCOM_FRAME_POOL_SIZE
	int "SDPCM frame pool size"
	default 8
	---help---
		This parameter sets the size of the shared SDPCM frame pool
		used for both RX and TX transfers.

config IEEE80211_BROADCOM_SDIO_EHS_MODE
	bool "High-Speed Mode over SDIO"
	default n
	---help---
		This selection enables High-Speed timing mode
		with a clock rate up to 50MHz.

endif # IEEE80211_BROADCOM_FULLMAC
```

## drivers/wireless/ieee802154/Kconfig
```kconfig
#
# For a description of the syntax of this configuration file,
# see the file kconfig-language.txt in the NuttX tools repository.
#

if DRIVERS_IEEE802154

config IEEE802154_MRF24J40
	bool "Microchip MRF24J40 IEEE 802.15.4 transceiver"
	default n
	---help---
		This selection enables support for the Microchip MRF24J40 device.

source "drivers/wireless/ieee802154/mrf24j40/Kconfig"

config IEEE802154_AT86RF233
	bool "ATMEL RF233 IEEE 802.15.4 transceiver"
	default n
	depends on EXPERIMENTAL
	---help---
		This selection enables support for the Atmel RF233 device.

source "drivers/wireless/ieee802154/at86rf23x/Kconfig"

config IEEE802154_XBEE
	bool "XBee IEEE 802.15.4  Radio (w/ MAC)"
	default n
	---help---
		This selection enables support for the XBee Radio device.

source "drivers/wireless/ieee802154/xbee/Kconfig"

endif # DRIVERS_IEEE802154
```

## drivers/wireless/ieee802154/mrf24j40/Kconfig
```kconfig
#
# For a description of the syntax of this configuration file,
# see the file kconfig-language.txt in the NuttX tools repository.
#

if IEEE802154_MRF24J40

config IEEE802154_MRF24J40_FREQUENCY
	int "SPI Frequency for MRF24J40"
	default 8000000
	---help---
		SPI SLCK frequency in Hz

endif # IEEE802154_MRF24J40
```

## drivers/wireless/ieee802154/xbee/Kconfig
```kconfig
#
# For a description of the syntax of this configuration file,
# see the file kconfig-language.txt in the NuttX tools repository.
#

if IEEE802154_XBEE

config XBEE_DEFAULT_PREFIX_0
	hex "IPv6 Prefix 0"
	default 0xfe80
	---help---
		First section of IPv6 Prefix

config XBEE_DEFAULT_PREFIX_1
	hex "IPv6 Prefix 1"
	default 0x0000
	---help---
		Second section of IPv6 Prefix

config XBEE_DEFAULT_PREFIX_2
	hex "IPv6 Prefix 2"
	default 0x0000
	---help---
		Third section of IPv6 Prefix

config XBEE_DEFAULT_PREFIX_3
	hex "IPv6 Prefix 3"
	default 0x0000
	---help---
		Fourth section of IPv6 Prefix

config IEEE802154_XBEE_FREQUENCY
	int "SPI Frequency for XBee Radio"
	default 2000000
	---help---
		SPI SLCK frequency in Hz

config XBEE_NETDEV_RECVRPRIO
	int "Priority of frame receiver registered with the MAC layer"
	default 1
	---help---
		When the MAC layer receives an incoming data frame, it passes the frame
		to registered receivers, in order of receiver priority, until one of the
		receivers claim the frame.

		An example case would be when 6LoWPAN and the MAC character driver are
		enabled. Both have receivers registered with the MAC. The 6LoWPAN layer
		should get assigned a higher priority than the character driver. In this
		case, the 6LoWPAN receiver will receive the frame first. If the frame is
		a 6LoWPAN frame, it will claim the frame and the MAC will not pass the
		frame to any additional receivers. If it does not claim the frame, the
		MAC layer will call the next highest priority receiver, in this case,
		the MAC character driver (which should always be lowest priority since
		it is a "catch-all" type receiver).

config XBEE_LOCKUP_WORKAROUND
	bool "Enable workaround to counteract XBee lockup"
	default y
	---help---
		When receiving large amounts of data over the XBee, there is some probability
		that the XBee will lockup and stop sending us data over SPI. In most cases,
		querying the XBee will get it out of this state and communication will resume.
		In some cases however, the XBee will freeze completely and won't ever respond
		to our queries.

		This workaround periodically queries the XBee if there hasn't been any
		recent interaction. Additionally, if any query does not get a response
		after 10 attempts, the XBee is reset.

endif # IEEE802154_XBEE
```

## drivers/wireless/lpwan/sx126x/Kconfig
```kconfig
#
# For a description of the syntax of this configuration file,
# see the file kconfig-language.txt in the NuttX tools repository.
#

if LPWAN_SX126X

config LPWAN_SX126X_RFFREQ_DEFAULT
	int "SX126X default RF frequency Hz"
	default 869252000

config LPWAN_SX126X_SF_DEFAULT
	int "SX126X default spreading factor"
	default 10

config LPWAN_SX126X_BW_DEFAULT
	int "SX126X default bandwidth kHz"
	default 125

config LPWAN_SX126X_CR_DEFAULT
	int "SX126X default coding rate"
	default 8

config LPWAN_SX126X_MAX_DEVICES
	int "SX126X maximum devices"
	default 1

endif # DRIVERS_LPWAN
```
