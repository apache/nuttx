## drivers/video/vnc/Kconfig
```kconfig
#
# For a description of the syntax of this configuration file,
# see the file kconfig-language.txt in the NuttX tools repository.
#

menuconfig VNCSERVER
	bool "VNC server"
	default n
	depends on NET_TCP
	select FB_UPDATE
	---help---
		Enable support for a VNC Remote Frame Buffer (RFB) server.

if VNCSERVER

choice
	prompt "VNC server protocol"
	default VNCSERVER_PROTO3p8

config VNCSERVER_PROTO3p3
	bool "Version 3.3"
	depends on EXPERIMENTAL

config VNCSERVER_PROTO3p8
	bool "Version 3.8"

endchoice # VNC server protocol

config VNCSERVER_NDISPLAYS
	int "Number of displays"
	default 1
	range 1 99
	---help---
		Specifies the number of RFB displays supported by the server.
		Normally this should be one.

config VNCSERVER_NAME
	string "VNC display name"
	default "NuttX"

config VNCSERVER_PRIO
	int "VNC server task priority"
	default 100

config VNCSERVER_STACKSIZE
	int "VNC server stack size"
	default DEFAULT_TASK_STACKSIZE

config VNCSERVER_UPDATER_PRIO
	int "VNC updater thread priority"
	default 100

config VNCSERVER_UPDATER_STACKSIZE
	int "VNC updater thread stack size"
	default DEFAULT_TASK_STACKSIZE

choice
	prompt "VNC color format"
	default VNCSERVER_COLORFMT_RGB16

config VNCSERVER_COLORFMT_RGB8
	bool "RGB8 3:3:2"

config VNCSERVER_COLORFMT_RGB16
	bool "RGB16 5:6:5"

config VNCSERVER_COLORFMT_RGB32
	bool "RGB32 8:8:8"

endchoice # VNC color format

config VNCSERVER_SCREENWIDTH
	int "Framebuffer width (pixels)"
	default 320
	---help---
		This setting defines the width in pixels of the local framebuffer.

			Memory usage: PixelWidth * ScreenWidth * ScreenHeight

		So, for example, a 320x240 screen with RGB16 pixels would require
		2x320x240 = 150 KB of RAM.

config VNCSERVER_SCREENHEIGHT
	int "Framebuffer height (rows)"
	default 240
	---help---
		This setting defines the height in rows of the local framebuffer.

			Memory usage: PixelWidth * ScreenWidth * ScreenHeight

		So, for example, a 320x240 screen with RGB16 pixels would require
		2x320x240 = 150 KB of RAM.

config VNCSERVER_NUPDATES
	int "Number of pre-allocate update structures"
	default 48
	---help---
		This setting provides the number of pre-allocated update structures
		that will be used.  Dynamic memory allocations are never made.  In
		the likely event that we run out of update structures, the graphics
		subsystem will pause and wait for the next structures to be released.

		Overhead is 12-bytes per update structure.

config VNCSERVER_UPDATE_BUFSIZE
	int "Max update buffer size (bytes)"
	default 1024
	---help---
		A single buffer is pre-allocated for rendering updates.  This
		setting specifies the maximum in bytes of that update buffer.  For
		example, an update buffers of 32 pixels at 8-bits per pixel and
		32-rows would yield a buffer size of 1024!

		There is a very strong interaction with this setting and the network MTU.
		Ideally, this buffer should fit in one network packet to avoid accessive
		re-assembly of partial TCP packets.

		REVISIT:  In fact, if the buffer does not fit in one network packet,
		then there appears to be reliability issues in the connection.  I am
		not sure why that is; TCP is a stream so it should not matter how
		many packets are in a transfer.

		Example:  Negotiated pixel depth = 8 BPP, window width = 800 pixels.
		CONFIG_VNCSERVER_UPDATE_BUFSIZE needs to be the payload size (MSS)
		of the transfer or 800 bytes.  The MTU is then:

		  MSS = MTU - sizeof(IP Header) - sizeof(VNC FramebufferUpdate Header)

		For IPv4, the IP Header is 20 bytes; 40 bytes for IPv6.  The
		FramebufferUpdate header is 16 bytes so.  The desired MSS is 800 bytes
		so MTU = 836 or 856.  For Ethernet, this is a total packet size of 870
		bytes.

config VNCSERVER_KBDENCODE
	bool "Encode keyboard input"
	default n
	depends on LIBC_KBDCODEC
	---help---
		Use a special encoding of keyboard characters as defined in
		include/nuttx/input/kbd_coded.h.

config VNCSERVER_TOUCH
	bool "Enable touch input"
	default n
	select INPUT
	select INPUT_TOUCHSCREEN
	---help---
		Use touchscreen based input driver

config VNCSERVER_TOUCH_DEVNAME
	string "Touch input device name prefix"
	default "/dev/input"
	depends on VNCSERVER_TOUCH
	---help---
		Touch device name prefix, final devi name is /dev/inputX by default,
		X is display number

config VNCSERVER_INBUFFER_SIZE
	int "Input buffer size"
	default 80

config VNCSERVER_DEBUG
	bool "VNC Server debug"
	default n
	depends on DEBUG_FEATURES && !DEBUG_GRAPHICS
	---help---
		Normally VNC debug output is selected with DEBUG_GRAPHICS.  The
		VNC server support this special option to enable GRAPHICS debug
		output for the VNC server while GRAPHICS debug is disabled.  This
		provides an cleaner, less cluttered output when you only wish to
		debug the VNC server versus enabling DEBUG_GRAPHICS globally.

config VNCSERVER_UPDATE_DEBUG
	bool "Detailed updater debug"
	default n
	depends on DEBUG_GRAPHICS || VNCSERVER_DEBUG

endif # VNCSERVER
```

## drivers/virt/Kconfig
```kconfig
#
# For a description of the syntax of this configuration file,
# see the file kconfig-language.txt in the NuttX tools repository.
#
#
#
menuconfig VIRT
	bool "Virtualization"
	default n
	---help---
		Drivers for virtualized and emulated devices

if VIRT

config VIRT_QEMU_PCI_TEST
	bool "Driver for QEMU PCI test device"
	default n
	select PCI
	---help---
		Driver for QEMU PCI test device

config VIRT_QEMU_EDU
	bool "Driver for QEMU EDU test device"
	default n
	select PCI
	---help---
		Driver for QEMU EDU test device

endif # VIRT
```

## drivers/virtio/Kconfig
```kconfig
#
# For a description of the syntax of this configuration file,
# see the file kconfig-language.txt in the NuttX tools repository.
#

menuconfig DRIVERS_VIRTIO
	bool "Virtio Device Support"
	select OPENAMP
	default n

if DRIVERS_VIRTIO
config DRIVERS_VIRTIO_MMIO
	bool "Virtio MMIO Device Support"
	default n

config DRIVERS_VIRTIO_MMIO_QUEUE_LEN
	int "Virtio MMIO Virtio Queue Length"
	default 0
	range 0 1024
	depends on DRIVERS_VIRTIO_MMIO
	---help---
		If this value equals to 0, use the max queue length get from
		mmio register.

config DRIVERS_VIRTIO_BLK
	bool "Virtio block support"
	depends on !DISABLE_MOUNTPOINT
	default n

config DRIVERS_VIRTIO_GPU
	bool "Virtio gpu support"
	default n
	depends on VIDEO_FB
	select FB_UPDATE

config DRIVERS_VIRTIO_INPUT
	bool "Virtio input support"
	default n
	depends on INPUT

config DRIVERS_VIRTIO_NET
	bool "Virtio network support"
	depends on NETDEVICES
	default n
	select ARCH_HAVE_NETDEV_STATISTICS
	select NETDEV_LATEINIT

config DRIVERS_VIRTIO_NET_BUFNUM
	int "Virtio network driver buffer number"
	default 0
	depends on DRIVERS_VIRTIO_NET
	---help---
		The buffer number in each virtqueue. (We have 2 virtqueues.)
		If this value equals to 0, use CONFIG_IOB_NBUFFERS / 4 for each.
		Normally we get just a little improvement for >8 buffers, and very little for >32.

config DRIVERS_VIRTIO_RNG
	bool "Virtio rng support"
	default n
	select ARCH_HAVE_RNG

config DRIVERS_VIRTIO_RPMB
	bool "Virtio RPMB support"
	default n

config DRIVERS_VIRTIO_SERIAL
	bool "Virtio serial support"
	depends on SERIAL
	default n
	select SERIAL_RXDMA
	select SERIAL_TXDMA

if DRIVERS_VIRTIO_SERIAL
config DRIVERS_VIRTIO_SERIAL_BUFSIZE
	int "Virtio serial driver buffer size"
	default 256
endif

config DRIVERS_VIRTIO_SOUND
	bool "Virtio sound support"
	default n
	depends on DRIVERS_AUDIO

if DRIVERS_VIRTIO_SOUND
config DRIVERS_VIRTIO_SOUND_PERIOD_TIME
	int "Virtio snd driver period time"
	default 40

config DRIVERS_VIRTIO_SND_BUFFER_COUNT
	int "Virtio snd driver buffer count"
	default 6
endif

endif # DRIVERS_VIRTIO
```

## drivers/wiegand/Kconfig
```kconfig
#
# For a description of the syntax of this configuration file,
# see the file kconfig-language.txt in the NuttX tools repository.
#

menuconfig DRIVERS_WIEGAND
	bool "Wiegand  Support"
	default n
	---help---
	Drivers for Wiegand Protocol.

if DRIVERS_WIEGAND

choice
	prompt "Wigand Format"
	default WIEGAND_FORMAT_26_BIT

config WIEGAND_FORMAT_26_BIT
	bool "26-bit Wiegand"
	---help---
		Enables support for wiegand 26 bit ouput

config WIEGAND_FORMAT_34_BIT
	bool "34-bit Wiegand format"
	---help---
		Enables support for wiegand 34 bit ouput

endchoice
endif
```

## drivers/wireless/Kconfig
```kconfig
#
# For a description of the syntax of this configuration file,
# see the file kconfig-language.txt in the NuttX tools repository.
#

menuconfig DRIVERS_WIRELESS
	bool "Wireless Device Support"
	default n
	---help---
		Drivers for various wireless devices.

if DRIVERS_WIRELESS

config WL_CC1101
	bool "CC1101 RF transceiver support"
	default n
	select SPI
	select SCHED_HPWORK

if WL_CC1101

config CC1101_SPIDEV
	int "SPI bus number"
	default 2
	---help---
		Selects the SPI bus number identifying that SPI interface that
		connects the CC1101 to the MCU.

endif

config WL_GS2200M
	bool "Telit GS2200M Wi-Fi support"
	default n
	select SPI
	select LIBC_SCANSET
	select SCHED_LPWORK
	select DRIVERS_IEEE80211

if WL_GS2200M

config WL_GS2200M_ENABLE_WEP
	bool "WEP support in AP mode"
	default false

config WL_GS2200M_SPI_FREQUENCY
	int "SPI frequency for GS2200M"
	default 4000000
	range 4000000 10000000

config WL_GS2200M_DISABLE_DHCPC
	bool "Disable the internal dhcp client"
	default n

config WL_GS2200M_CHECK_VERSION
	bool "Check the version of GS2200M"
	default n

config WL_GS2200M_LOGLEVEL
	int "Log level"
	default 0
	range 0 2
	---help---
		The debug level of GS2200M. (AT+LOGLVL)

endif

source "drivers/wireless/spirit/Kconfig"

menuconfig DRIVERS_IEEE802154
	bool "IEEE 802.15.4 Device Support"
	default n
	---help---
		Select to enable building of IEEE802.15.4 device drivers.

source "drivers/wireless/ieee802154/Kconfig"

menuconfig DRIVERS_IEEE80211
	bool "IEEE 802.11 Device Support"
	default n
	---help---
		Select to enable building of IEEE802.11 device drivers.

source "drivers/wireless/ieee80211/Kconfig"

menuconfig DRIVERS_BLUETOOTH
	bool "Bluetooth Device Support"
	default n
	---help---
		Select to enable building of Bluetooth device drivers.

source "drivers/wireless/bluetooth/Kconfig"

menuconfig DRIVERS_LPWAN
	bool "LPWAN Device Support"
	default n
	---help---
		Select to enable building of LPWAN device drivers.

source "drivers/wireless/lpwan/Kconfig"

config WL_NRF24L01
	bool "nRF24l01+ transceiver support"
	default n
	select SPI
	---help---
		This options adds driver support for the Nordic nRF24L01+ chip.

if WL_NRF24L01

config WL_NRF24L01_DFLT_ADDR_WIDTH
	int "Default address width"
	default 5
	range 3 5
	---help---
		Default address width to be used by the nRF24l01+ driver.
		Note that this default can be changed through the driver API.

config WL_NRF24L01_CHECK_PARAMS
	bool "Check call parameters"
	default y
	---help---
		This option adds some sanity check code to parameters given in the
		driver API functions. If this option is disabled, parameter
		values are passed 'as is' to the module hardware registers.

config WL_NRF24L01_RXSUPPORT
	bool "Support messages reception"
	default y
	---help---
		If this option is disabled the driver supports only the transmission of messages.
		Reception of messages will be disabled (and corresponding functions removed).
		Note: this option is intended to reduce driver code size for 'transmission
		only' devices.

if WL_NRF24L01_RXSUPPORT

config WL_NRF24L01_RXFIFO_LEN
	int "RX fifo length"
	default 128
	range 34 2048
	---help---
		Length of the software based fifo used to store content of
		received messages.

endif # WL_NRF24L01_RXSUPPORT
endif # WL_NRF24L01

endif # DRIVERS_WIRELESS
```

## drivers/wireless/bluetooth/Kconfig
```kconfig
#
# For a description of the syntax of this configuration file,
# see the file kconfig-language.txt in the NuttX tools repository.
#

if DRIVERS_BLUETOOTH

config BLUETOOTH_DEVICE_ID
	int "Bluetooth Device ID, eg: /dev/ttyBT0"
	default 0
	---help---
		Bluetooth Device ID.

config BLUETOOTH_UART
	bool "Bluetooth UART driver"
	default n
	select SCHED_HPWORK
	depends on ALLOW_BSD_COMPONENTS
	---help---
		Enable Bluetooth UART driver.

config BLUETOOTH_UART_GENERIC
	bool
	default n

config BLUETOOTH_UART_SHIM
	bool "Bluetooth UART SHIM driver"
	default n

if BLUETOOTH_UART

choice
	prompt "Bluetooth UART HCI device"
	default BLUETOOTH_UART_OTHER

config BLUETOOTH_UART_CC2564
	bool "TI CC2564"
	depends on EXPERIMENTAL

config BLUETOOTH_BCM4343X
	bool "Broadcom (Cypress) BCM4343X device support"
	---help---
		Enables download support for the bluetooth component of BCM4343X devices.
		Note that firmware needs to be provided for these devices to operate. In
		general this firmware is available in the Cypress WICED SDK.

config BLUETOOTH_UART_OTHER
	bool "Other generic HCI UART device"
	select BLUETOOTH_UART_GENERIC

endchoice # Bluetooth UART HCI device

config BLUETOOTH_UART_DUMP
	bool "Dump HCI UART I/O buffers"
	default n
	depends on DEBUG_WIRELESS_INFO
	---help---
		Dump the full content of all outgoing and incoming messages.

config BLUETOOTH_UART_RXBUFSIZE
	int "Bluetooth UART RX Buffer size"
	default 2048
	---help---
		Bluetooth UART RX Buffer size.  Default: 2048

endif # BLUETOOTH_UART

config BLUETOOTH_BRIDGE
	bool "Bluetooth BT/BLE Dual Mode Bridge Driver"
	default n
	---help---
		Enable Bluetooth BT/BLE Dual Mode Bridge Driver.

config BLUETOOTH_BRIDGE_BTSNOOP
	bool "Bluetooth bridge btsnoop support"
	default n
	depends on BLUETOOTH_BRIDGE
	---help---
		Enable Bluetooth hci btsnoop log

config BLUETOOTH_NULL
	bool "NULL Bluetooth device"
	default n
	---help---
		A do-nothing Bluetooth device driver to permit some basic testing of
		the Bluetooth stack on the simulator.  This driver just "closes the
		loop" and nothing more:  It is a just a bit-bucket for outgoing
		packets; it generates no incoming packets.

config BLUETOOTH_RPMSG_SERVER
	bool "RPMSG Bluetooth HCI server support"
	depends on EXPERIMENTAL && RPTUN
	default n

config BLUETOOTH_RPMSG
	bool "RPMSG Bluetooth HCI client support"
	depends on EXPERIMENTAL && RPTUN
	default n

config BLUETOOTH_SLIP
	bool "Bluetooth SLIP support"
	default n

if BLUETOOTH_SLIP

config BLUETOOTH_SLIP_TXBUFSIZE
	int "BT H5 UART TX Buffer Size"
	default 2048
	---help---
		H5 UART TX Buffer Size.  Default: 2048

config BLUETOOTH_SLIP_TXWIN
	int "BT H5 Uart TX Window Size"
	default 4
	---help---
		H5 UART TX Window Size.  Default: 4

endif # BLUETOOTH_SLIP

endif # DRIVERS_BLUETOOTH
```
