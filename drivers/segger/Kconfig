## drivers/usbmisc/Kconfig
```kconfig
#
# For a description of the syntax of this configuration file,
# see misc/tools/kconfig-language.txt.
#

menuconfig USBMISC
	bool "USB Miscellaneous drivers"
	default n
	---help---
		USB Miscellaneous drivers.

if USBMISC

config FUSB301
	bool "On Semiconductor FUSB301 USB Type-C controller support"
	default n
	select I2C
	---help---
		Enable device driver for Fairchild/On Semiconductor USB Type-C controller

if FUSB301

config FUSB301_I2C_FREQUENCY
	int "FUSB301 I2C frequency"
	default 400000
	range 1 400000

config DEBUG_FUSB301
	bool "Enable debug support for the FUSB301"
	default n
	---help---
		Enables debug support for the FUSB301

config FUSB301_NPOLLWAITERS
	int "Number of waiters to poll"
	default 2
	---help---
		Maximum number of threads that can be waiting on poll()

endif

config FUSB303
	bool "On Semiconductor FUSB303 USB Type-C controller support"
	default n
	select I2C
	---help---
		Enable device driver for Fairchild/On Semiconductor USB Type-C controller

if FUSB303

config FUSB303_I2C_FREQUENCY
	int "FUSB303 I2C frequency"
	default 400000
	range 1 400000

config DEBUG_FUSB303
	bool "Enable debug support for the FUSB303"
	default n
	---help---
		Enables debug support for the FUSB303

config FUSB303_NPOLLWAITERS
	int "Number of waiters to poll"
	default 2
	---help---
		Maximum number of threads that can be waiting on poll()

endif

endif # USBMISC
```

## drivers/usbmonitor/Kconfig
```kconfig
#
# For a description of the syntax of this configuration file,
# see the file kconfig-language.txt in the NuttX tools repository.
#

config HAVE_USBTRACE
	bool
	default n

menuconfig USBMONITOR
	bool "USB Monitor"
	default n
	depends on HAVE_USBTRACE
	---help---
		If USB device tracing (USBDEV_TRACE) AND/OR USB host tracing
		(USBHOST_TRACE) are enabled then this option will select the USB
		monitor.  The USB monitor is a daemon that will periodically collect
		the buffered USB trace data and dump it to the SYSLOG device.

if USBMONITOR

config USBMONITOR_STACKSIZE
	int "USB Monitor daemon stack size"
	default DEFAULT_TASK_STACKSIZE
	---help---
		The stack size to use the USB monitor daemon.  Default: 2048

config USBMONITOR_PRIORITY
	int "USB Monitor daemon priority"
	default 50
	---help---
		The priority to use the USB monitor daemon.  Default: 50

config USBMONITOR_INTERVAL
	int "USB Monitor dump frequency"
	default 2
	---help---
		The rate in seconds that the USB monitor will wait before dumping
		the next set of buffered USB trace data.  Default:  2 seconds.

if USBDEV && USBDEV_TRACE

config USBMONITOR_TRACEINIT
	bool "Show USB device initialization events"
	default n
	---help---
		Show initialization events

config USBMONITOR_TRACECLASS
	bool "Show USB device class driver events"
	default n
	---help---
		Show class driver events

config USBMONITOR_TRACETRANSFERS
	bool "Show USB device data transfer events"
	default n
	---help---
		Show data transfer events

config USBMONITOR_TRACECONTROLLER
	bool "Show USB device controller events"
	default n
	---help---
		Show controller events

config USBMONITOR_TRACEINTERRUPTS
	bool "Show USB device interrupt-related events"
	default n
	---help---
		Show interrupt-related events

endif # USBDEV && USBDEV_TRACE

endif # USBMONITOR
```

## drivers/usrsock/Kconfig
```kconfig
#
# For a description of the syntax of this configuration file,
# see the file kconfig-language.txt in the NuttX tools repository.
#

if NET_USRSOCK

menu "Usrsock Driver Support"

choice
	prompt "Select usrsock device interface"
	default NET_USRSOCK_DEVICE

config NET_USRSOCK_DEVICE
	bool "/dev/usrsock"
	---help---
		Will export /dev/usrsock device node for usrsock request/response operations

config NET_USRSOCK_RPMSG
	bool "rpmsg transport"
	---help---
		Will send usrsock request or receive usrsock response via rpmsg channel directly

config NET_USRSOCK_CUSTOM
	bool "Customerized interface"
	---help---
		Will send usrsock request or receive usrsock response via other kind of interface

endchoice

config NET_USRSOCK_RPMSG_CPUNAME
	string "The cpuname on which the rpmsg server runs"
	depends on NET_USRSOCK_RPMSG

endmenu

endif # NET_USRSOCK

config NET_USRSOCK_RPMSG_SERVER
	bool "RPMSG usrsock"
	default n
	depends on NET && RPTUN
	---help---
		Enable usrsock through rpmsg channel.

if NET_USRSOCK_RPMSG_SERVER

config NET_USRSOCK_RPMSG_SERVER_NSOCKS
	int "The maximum number of socket descriptors for usrsock monitoring"
	default 64
	---help---
		The maximum number of socket description for usrsosck monitoring.

config NET_USRSOCK_RPMSG_SERVER_NIOVEC
	int "The maximum number of I/O vector for reassemble buffer"
	default 8
	---help---
		The maximum number of I/O vector for reassemble buffer.

endif # NET_USRSOCK_RPMSG_SERVER
```

## drivers/video/Kconfig
```kconfig
#
# For a description of the syntax of this configuration file,
# see the file kconfig-language.txt in the NuttX tools repository.
#

config FB_CMAP
	bool
	default n
	---help---
		Set by driver-specific configuration to indicate support for color
		mapping.  Not directly user selectable.

config FB_TRANSPARENCY
	bool
	default n
	---help---
		Set by driver-specific configuration to indicate support for color
		transparency.  Not directly user selectable.

config FB_UPDATE
	bool
	default n

config FB_SYNC
	bool "Hardware signals vertical sync"
	default n

config FB_OVERLAY
	bool "Framebuffer overlay support"
	default n

config FB_MODULEINFO
	bool "Framebuffer module information support"
	default n

config FB_OVERLAY_BLIT
	bool "Framebuffer overlay blit support"
	depends on FB_OVERLAY
	default n

menuconfig DRIVERS_VIDEO
	bool "Video Device Support"
	default n
	---help---
		Enable support for video device drivers.

if DRIVERS_VIDEO

config VIDEO_FB
	bool "Framebuffer character driver"
	default n

config VIDEO_STREAM
	bool "Video Stream Support"
	default n
	---help---
		Enable video Stream support

if VIDEO_STREAM

config VIDEO_REQBUFS_COUNT_MAX
	int "Maximum Video reqbuf buffers count"
	default 3

config VIDEO_SCENE_BACKLIGHT
	bool "Enable backlight scene"
	default y
	---help---
		Enable backlight scene

config VIDEO_SCENE_BEACHSNOW
	bool "Enable beach snow scene"
	default y
	---help---
		Enable beach snow scene

config VIDEO_SCENE_CANDLELIGHT
	bool "Enable candle light scene"
	default y
	---help---
		Enable candle light scene

config VIDEO_SCENE_DAWNDUSK
	bool "Enable dawn dusk scene"
	default y
	---help---
		Enable dawn dusk scene

config VIDEO_SCENE_FALLCOLORS
	bool "Enable fall colors scene"
	default y
	---help---
		Enable fall colors scene

config VIDEO_SCENE_FIREWORKS
	bool "Enable fireworks scene"
	default y
	---help---
		Enable fireworks scene

config VIDEO_SCENE_LANDSCAPE
	bool "Enable landscape scene"
	default y
	---help---
		Enable landscape scene

config VIDEO_SCENE_NIGHT
	bool "Enable night scene"
	default y
	---help---
		Enable night scene

config VIDEO_SCENE_PARTYINDOOR
	bool "Enable party and indoor scene"
	default y
	---help---
		Enable party and indoor scene

config VIDEO_SCENE_PORTRAIT
	bool "Enable portrait scene"
	default y
	---help---
		Enable portrait scene

config VIDEO_SCENE_SPORTS
	bool "Enable sports scene"
	default y
	---help---
		Enable sports scene

config VIDEO_SCENE_SUNSET
	bool "Enable sunset scene"
	default y
	---help---
		Enable sunset scene

config VIDEO_SCENE_TEXT
	bool "Enable text scene"
	default y
	---help---
		Enable text scene
endif

config VIDEO_MAX7456
	bool "Maxim 7456 Monochrome OSD"
	default n
	select SPI
	---help---
		Support for the Maxim 7456 monochrome on-screen display
		multiplexer.

config VIDEO_ISX012
	bool "ISX012 Image sensor"
	default n
	select I2C

if VIDEO_ISX012

config VIDEO_ISX012_REGDEBUG
	bool "Enable to read registers of ISX012 for test"
	default n
	---help---
		Enable to read registers of ISX012 for test.

endif

config VIDEO_ISX019
	bool "ISX019 Image sensor"
	default n
	select I2C

if VIDEO_ISX019
choice
	prompt "HDR mode selection"
	default VIDEO_ISX019_DOL3
	---help---
		ISX019 has the DOL-HDR feature, which combines images with different exposure so that
		both bright and dark data of high-contrast subject can be viewed at the same time.
		Select DOLX(X = 2 or 3), in which X represents the number of combined images.

config VIDEO_ISX019_DOL3
	bool "DOL3"
	---help---
		DOL3 is the mode that combines 3 images with different exposure.

config VIDEO_ISX019_DOL2
	bool "DOL2"
	---help---
		DOL2 is the mode that combines 2 images with different exposure.

endchoice

config VIDEO_ISX019_INITIAL_JPEG_QUALITY
	int "Initial JPEG quality"
	default 70
	range 1 100
	---help---
		The initial JPEG quality.

config VIDEO_ISX019_NAME_WITH_VERSION
	bool "ISX019 Image sensor name with version number"
	default n
	---help---
		ISX019 Camera board has FPGA for encoding JPEG image.
		This FPGA has a version number for the circuit.
		This option enables to report FPGA version with driver name.

config VIDEO_ISX019_REGDEBUG
	bool "Enable to read registers of ISX019 for test"
	default n
	---help---
		Enable to read registers of ISX019 for test.

endif

config VIDEO_OV2640
	bool "OV2640 camera chip"
	default n
	depends on ALLOW_GPL_COMPONENTS
	select I2C

if VIDEO_OV2640

config OV2640_I2CADDR
	hex "I2C address (7-bit)"
	default 0x21
	---help---
		OV2640 I2C address in 7-bit format

config OV2640_FREQUENCY
	int "I2C frequency"
	default 400000
	---help---
		OV2640 I2C frequency
choice
	prompt "Color format"
	default OV2640_RGB565_COLORFMT

config OV2640_RGB565_COLORFMT
	bool "RGB565"

config OV2640_YUV422_COLORFMT
	bool "YUV422"

endchoice

config OV2640_JPEG
	bool "JPEG output format"
	default n
	---help---
	Select JPEG output format

choice
	prompt "JPEG resolution"
	default OV2640_JPEG_SVGA_RESOLUTION
	depends on OV2640_JPEG

config OV2640_JPEG_QCIF_RESOLUTION
	bool "QCIF (176x144)"

config OV2640_JPEG_QVGA_RESOLUTION
	bool "QVGA (320x240)"

config OV2640_JPEG_CIF_RESOLUTION
	bool "CIF (352x288)"

config OV2640_JPEG_VGA_RESOLUTION
	bool "VGA (640x480)"

config OV2640_JPEG_SVGA_RESOLUTION
	bool "SVGA (800x600)"

config OV2640_JPEG_XVGA_RESOLUTION
	bool "XVGA (1024x768)"

config OV2640_JPEG_SXVGA_RESOLUTION
	bool "SXVGA (1280x1024)"

config OV2640_JPEG_UXGA_RESOLUTION
	bool "UXVGA (1600x1200)"

endchoice

choice
	prompt "Output resolution"
	default OV2640_SVGA_RESOLUTION
	depends on !OV2640_JPEG

config OV2640_QCIF_RESOLUTION
	bool "QCIF (176x144)"

config OV2640_QVGA_RESOLUTION
	bool "QVGA (320x240)"

config OV2640_CIF_RESOLUTION
	bool "CIF (352x288)"

config OV2640_VGA_RESOLUTION
	bool "VGA (640x480)"

config OV2640_SVGA_RESOLUTION
	bool "SVGA (800x600)"

config OV2640_XVGA_RESOLUTION
	bool "XVGA (1024x768)"

config OV2640_SXGA_RESOLUTION
	bool "SXVGA (1280x1024)"

config OV2640_UXGA_RESOLUTION
	bool "UXVGA (1600x1200)"

endchoice

config OV2640_REGDEBUG
	bool "Register level debug output"
	default n
	depends on DEBUG_FEATURES
	---help---
		Enable details, register level debug output.

endif

source "drivers/video/vnc/Kconfig"
source "drivers/video/mipidsi/Kconfig"

endif # DRIVERS_VIDEO
```

## drivers/video/mipidsi/Kconfig
```kconfig
#
# For a description of the syntax of this configuration file,
# see the file kconfig-language.txt in the NuttX tools repository.
#

menuconfig MIPI_DSI
	bool "Dsi Driver Support"
	default n
	---help---
		Enables building of a dsi generic driver.

if MIPI_DSI

config MIPI_DSI_DRIVER
	bool "MIPI DSI Character Driver"
	default n

endif
```
