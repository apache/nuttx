## drivers/mmcsd/Kconfig
```kconfig
#
# For a description of the syntax of this configuration file,
# see the file kconfig-language.txt in the NuttX tools repository.
#

# MMC/SD-related platform capabilities

config ARCH_HAVE_SDIO
	bool
	default n

config ARCH_HAVE_SDIOWAIT_WRCOMPLETE
	bool
	default n

config ARCH_HAVE_SDIO_PREFLIGHT
	bool
	default n

menuconfig MMCSD
	bool "MMC/SD Driver Support"
	default n
	---help---
		Support for MMC/SD block drivers.  MMC/SD block drivers based on
		SPI and SDIO/MCI interfaces are supported.  See include/nuttx/mmcsd.h
		and include/nuttx/sdio.h for further information.

if MMCSD

config MMCSD_NSLOTS
	int "Number of MMC/SD slots"
	default 1
	---help---
		Number of MMC/SD slots supported by the
		driver. Default is one.

config MMCSD_READONLY
	bool "Disable MMC/SD write access"
	default n
	---help---
		Provide read-only access.  Default is
		Read/Write

config MMCSD_MULTIBLOCK_DISABLE
	bool "Disable MMC/SD multiblock transfer"
	default n
	---help---
		Use only the single block transfer method.
		This setting is used to work around buggy SDIO drivers that cannot handle
		multiple block transfers.

config MMCSD_MMCSUPPORT
	bool "MMC cards support"
	default y
	---help---
		Enable support for MMC cards

config MMCSD_HAVE_CARDDETECT
	bool "MMC/SD card detect pin"
	default y
	---help---
		SDIO driver card present detection is supported.

config MMCSD_HAVE_WRITEPROTECT
	bool "MMC/SD write protect pin"
	default y
	---help---
		SDIO driver write protection detection is supported.

config MMCSD_SPI
	bool "MMC/SD SPI transfer support"
	default y
	depends on SPI

if MMCSD_SPI

config MMCSD_SPICLOCK
	int "MMC/SD maximum SPI clock"
	default 20000000
	depends on MMCSD_SPI
	---help---
		Maximum SPI clock to drive MMC/SD card.
		Default is 20MHz.

config MMCSD_SPIMODE
	int "MMC/SD SPI mode"
	default 0
	---help---
		Should be mode 0.  However, sometimes this is useful for experimenting.

config MMCSD_IDMODE_CLOCK
	int "MMC/SD ID Mode SPI clock"
	default 400000
	depends on MMCSD_SPI
	---help---
		SPI clock identify MMC/SD card.
		Should be 400KHz or less.

endif

config SDIO_DMA
	bool
	default n

config MMCSD_SDIO
	bool "MMC/SD SDIO transfer support"
	default n
	depends on ARCH_HAVE_SDIO

if MMCSD_SDIO

config SDIO_MUXBUS
	bool "SDIO bus share support"
	default n
	---help---
		Set this SDIO interface if the SDIO interface
		or hardware resources are shared with other drivers.

config MMCSD_SDIOWAIT_WRCOMPLETE
	bool "Use D0 Busy to detect Write Complete"
	default n
	depends on ARCH_HAVE_SDIOWAIT_WRCOMPLETE
	---help---
		SDIO driver will use D0 Busy signalling to detect Write Complete.
		This option when selected, will enable the MMCSD driver to use the
		underlying SDIO drivers implementation of the SD specification's
		D0 Busy signalling to detect Write Complete.  This will avoid
		potentially very long (600Ms+) busy waiting in the MMCSD driver.

		To implement D0 Busy signalling, the underlying driver must
		be capable of switching the D0 GPIO to be a rising edge sensitive
		interrupt pin. It must then, condition that pin to detect the rising edge
		on receipt of SDWAIT_WRCOMPLETE in the SDIO_WAITENABLE call and
		return it back to regular SDIO mode, when either the ISR fires or pin is
		found to be high in the SDIO_EVENTWAIT call.

config SDIO_WIDTH_D1_ONLY
	bool "SDIO 1-bit transfer"
	default n
	---help---
		Select 1-bit transfer mode.  Default:
		4-bit transfer mode.

config SDIO_BLOCKSETUP
	bool "SDIO block setup"
	default n
	---help---
		Some hardware needs to be informed of the selected blocksize and the
		number of blocks.  Others just work on the byte stream.  This option
		enables the block setup method in the SDIO vtable.

endif

endif # MMCSD
```

## drivers/modem/Kconfig
```kconfig
#
# For a description of the syntax of this configuration file,
# see the file kconfig-language.txt in the NuttX tools repository.
#

menuconfig MODEM
	bool "Modem Support"
	default n
	---help---
		Enable modem support.

if MODEM

config MODEM_U_BLOX
	bool "Enable u-blox modem driver"
	default n
	depends on ALLOW_BSD_COMPONENTS
	---help---
		Compile the u-blox serial modem driver. The driver consists of
		the upper half in the OS and the lower half with implementation
		in the chosen board.

config MODEM_U_BLOX_DEBUG
	bool "Debug u-blox modem driver"
	default n
	depends on MODEM_U_BLOX
	---help---
		Allow the u-blox modem driver print debug information.

source "drivers/modem/altair/Kconfig"

endif # MODEM
```

## drivers/modem/alt1250/Kconfig
```kconfig
#
# For a description of the syntax of this configuration file,
# see the file kconfig-language.txt in the NuttX tools repository.
#

menuconfig MODEM_ALT1250
	bool "ALT1250 modem support"
	default n
	select SPI
	select NET
	select NETDEV_MODEM_LTE_IOCTL
	---help---
		Enable driver for the ALT1250 modem.

if MODEM_ALT1250

menuconfig MODEM_ALT1250_RESTRICTIONS
	bool "ALT1250 modem restrictions [Attention. See help]"
	default n
	---help---
		Enable restrict the modem function is at your own risk.
		If you don't have enough knowledge of this firmware,
		you may get unexpected situation.

if MODEM_ALT1250_RESTRICTIONS

config MODEM_ALT1250_DISABLE_PV1
	bool "Disable PV1"
	default n
	---help---
		Enable restrict the modem function is at your own risk.
		If you don't have enough knowledge of this firmware,
		you may get unexpected situation.

config MODEM_ALT1250_DISABLE_PV4
	bool "Disable PV4"
	default n
	---help---
		Enable restrict the modem function is at your own risk.
		If you don't have enough knowledge of this firmware,
		you may get unexpected situation.

endif

config MODEM_ALT1250_ADDITIONAL_FUNC
	bool
	default n

config MODEM_ALT1250_LOG_ACCESS
	bool "Enable modem log access"
	default n
	---help---
		Enables the feature to access the modem logs.

config MODEM_ALT1250_DEBUG
	bool "Enable debug mode for ALT1250 modem driver"
	default n
	---help---
		Allow the ALT1250 modem driver print debug information.

endif
```

## drivers/modem/altair/Kconfig
```kconfig
#
# For a description of the syntax of this configuration file,
# see the file kconfig-language.txt in the NuttX tools repository.
#

menuconfig MODEM_ALTMDM
	bool "Altair modem support"
	default n
	select SPI
	---help---
		Enable driver for the Altair modem.

if MODEM_ALTMDM

config MODEM_ALTMDM_XFER_TASK_PRIORITY
	int "transfer task priority"
	default 170
	range 1 255

config MODEM_ALTMDM_DEBUG
	bool "Enable debug mode for Altair modem driver"
	default n
	depends on MODEM_ALTMDM
	---help---
		Allow the Altair modem driver print debug information.

config MODEM_ALTMDM_KEEP_WAKE_STATE
	bool "Configuration to keep wake state of modem"
	default n
	depends on MODEM_ALTMDM
	---help---
		none

config MODEM_ALTMDM_MAX_PACKET_SIZE
	int "Max size to be transfer in bytes"
	default 2064
	depends on MODEM_ALTMDM
	---help---
		none

config MODEM_ALTMDM_SLEEP_TIMER_VAL
	int "Modem sleep timer"
	default 20
	depends on MODEM_ALTMDM
	---help---
		Modem sleep timer in milliseconds.
		Modem may sleep if there is no data to be transferred
		during specified time. Values smaller than 20 milliseconds
		can not be specified.

endif
```

## drivers/motor/Kconfig
```kconfig
#
# For a description of the syntax of this configuration file,
# see the file kconfig-language.txt in the NuttX tools repository.
#

menuconfig MOTOR
	bool "Motor control drivers"
	default n

if MOTOR

config MOTOR_UPPER
	bool "Motor generic upper-half driver"
	default n
	---help---
		Enables building of a motor generic upper half driver.

if MOTOR_UPPER

config MOTOR_UPPER_HAVE_POSITION
	bool "Have position control"
	default n

config MOTOR_UPPER_HAVE_DIRECTION
	bool "Have direction control"
	default n

config MOTOR_UPPER_HAVE_SPEED
	bool "Have speed control"
	default n

config MOTOR_UPPER_HAVE_TORQUE
	bool "Have torque control (rotary motors)"
	default n

config MOTOR_UPPER_HAVE_FORCE
	bool "Have force control (linear motors)"
	default n

config MOTOR_UPPER_HAVE_ACCELERATION
	bool "Have acceleration control"
	default n

config MOTOR_UPPER_HAVE_DECELERATION
	bool "Have deceleration control"
	default n

config MOTOR_UPPER_HAVE_INPUT_VOLTAGE
	bool "Have input voltage protection"
	default n

config MOTOR_UPPER_HAVE_INPUT_CURRENT
	bool "Have input current protection"
	default n

config MOTOR_UPPER_HAVE_INPUT_POWER
	bool "Have input power protection"
	default n

endif

source "drivers/motor/foc/Kconfig"

endif # MOTOR
```

## drivers/motor/foc/Kconfig
```kconfig
menuconfig MOTOR_FOC
	bool "FOC (Field Oriented Controller) driver support"
	default n
	---help---
		Enables building of the "upper-half" FOC driver.

if MOTOR_FOC

config MOTOR_FOC_INST
	int "FOC instances"
	default 1

config MOTOR_FOC_PHASES
	int "FOC phases number"
	default 3

config MOTOR_FOC_SHUNTS
	int "FOC number of shunts"
	range 1 3
	default 3
	---help---
		Number of shunts supported (or other types of current sensors).
		Any current reconstruction must be done on the lower-half side.

config MOTOR_FOC_BEMF_SENSE
	bool "FOC support for Back-EMF sensing"
	default n

config MOTOR_FOC_TRACE
	bool "FOC trace support"
	default n
	---help---
		Enables FOC driver trace interface.

config MOTOR_FOC_DUMMY
	bool "Simulated FOC device"
	default n
	---help---
		Build a simulated lower-half FOC device

config MOTOR_FOC_FOCPWR
	bool

config MOTOR_FOC_DRV8301
	bool "DRV8301 Three-Phase Gate Driver"
	default n
	select MOTOR_FOC_FOCPWR
	---help---
		Enables FOC power-stage DRV8301 driver.

endif #MOTOR_FOC
```
