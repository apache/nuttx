## drivers/net/oa_tc6/Kconfig
```kconfig
#
# For a description of the syntax of this configuration file,
# see the file kconfig-language.txt in the NuttX tools repository.
#

menuconfig NET_OA_TC6
	bool "OPEN Alliance 10BASE-T1x MAC-PHYs"
	default n
	depends on NETDEVICES
	---help---
		Enable support for OPEN Alliance protocol SPI MAC-PHYs.

if NET_OA_TC6

config NET_OA_TC6_NCV7410
	bool "Onsemi NCV7410 (NCN26010) 10BASE-T1S SPI MAC-PHY Support"
	default n

config NET_OA_TC6_NCV7410_LEDS
	bool "Setup NCV7410 DIO outputs as status LEDs"
	default n
	depends on NET_OA_TC6_NCV7410
	---help---
		Setup DIO0 to blink on TX/RX and DIO1 to reflect the LCTL bit in the PHY CONTROL register (Up/Down).

endif
```

## drivers/pci/Kconfig
```kconfig
#
# For a description of the syntax of this configuration file,
# see the file kconfig-language.txt in the NuttX tools repository.
#

menuconfig PCI
	bool "Support for PCI Bus"
	default n
	---help---
		Enables support for the PCI bus.
		Backend must be provided by per-arch or per-board implementation.

if PCI

config PCI_LATE_DRIVERS_REGISTER
	bool
	default n
	---help---
		This option disables PCI driver registration in drivers_initialize().
		Care must be taken to call pci_register_drivers() in later code, most likely
		as board specific code.

config PCI_MSIX
	bool "PCI MSI-X support"
	default n
	---help---
		Enables support for PCI MSI-X. When enabled, MSI-X takse priority 
		over MSI when a device supports it.
	
config PCI_ASSIGN_ALL_BUSES
	bool "Assign resource to all buses"
	default !ARCH_X86 && !ARCH_X86_64
	---help---
		Assign resources to all buses. This is required for some
		platforms that have multiple PCI buses.

config PCI_QEMU_TEST
	bool "Driver for QEMU PCI test device"
	default n
	---help---
		Driver for QEMU PCI test device

config PCI_QEMU_EDU
	bool "Driver for QEMU EDU test device"
	default n
	---help---
		Driver for QEMU EDU test device

config PCI_IVSHMEM
	bool "PCI ivshmem driver"
	default n
	---help---
		Enable Inter-VM share memory device driver.

config PCI_UIO_IVSHMEM
	bool "Enable uio ivshmem driver support"
	default n
	depends on PCI_IVSHMEM
	---help---
		When this option is enabled, char ivshmem driver will register
		char device with name: "/dev/uioX" to the VFS, then
		application can open this device and use `mmap()` to get the
		share memory provided by ivshmem device.

config PCI_UIO_IVSHMEM_IDTABLE
	string "The id table of uio ivshmem device"
	depends on PCI_UIO_IVSHMEM
	---help---
		"id0;id1;id2", e.g.: "0;1;2"

config PCI_UIO_IVSHMEM_NPOLLWAITERS
	int "PCI uio ivshmem poll waiter number"
	default 2
	depends on PCI_UIO_IVSHMEM

endif # PCI

menuconfig PCI_ENDPOINT
	bool "PCI Endpoint Support"
	default n
	---help---
		Enable this configuration option to support configurable PCI
		endpoint. This should be enabled if the platform has a PCI
		controller that can operate in endpoint mode.

if PCI_ENDPOINT

config PCI_QEMU_EPC
	bool "QEMU Ep Controller Support"
	---help---
		Enable qemu ep controller

config PCI_EPF_TEST
	bool "PCI epf test"
	---help---
		pci epf test driver

config PCI_EP_TEST
	bool "PCI endpoint test"
	---help---
		pci endpoint test driver

endif # PCI_ENDPOINT
```

## drivers/pcie/Kconfig
```kconfig
#
# For a description of the syntax of this configuration file,
# see the file kconfig-language.txt in the NuttX tools repository.
#

config PCIE
	bool "Support for PCI-E Bus"
	default n
	---help---
		Enables support for the PCI-E bus.
		Backend bust be provided by per-arch or per-board implementation..
```

## drivers/pcnt/Kconfig
```kconfig
#
# For a description of the syntax of this configuration file,
# see the file kconfig-language.txt in the NuttX tools repository.
#

menuconfig PCNT
	bool "PCNT (Pulse Counter) Driver Support"
	default n
	---help---
		This option selects common PCNT (Pulse Counter) options and should be
		enabled by the platforms that implement a Pulse Counter Peripheral.

if PCNT

config PCNTCHAR
	bool "PCNT character driver"
	default n

endif # PCNT
```

## drivers/pipes/Kconfig
```kconfig
#
# For a description of the syntax of this configuration file,
# see the file kconfig-language.txt in the NuttX tools repository.
#

config DEV_PIPE_MAXSIZE
	int "Maximum pipe/FIFO size"
	default 1024 if !DEFAULT_SMALL
	default 256 if DEFAULT_SMALL
	---help---
		Maximum configurable size of a pipe or FIFO at runtime.

config DEV_PIPE_SIZE
	int "Default pipe size"
	default 1024 if !DEFAULT_SMALL
	default 256 if DEFAULT_SMALL
	---help---
		Sets the default size of the pipe ringbuffer in bytes.  A value of
		zero disables pipe support.

config DEV_FIFO_SIZE
	int "Default FIFO size"
	default 1024 if !DEFAULT_SMALL
	default 256 if DEFAULT_SMALL
	---help---
		Sets the default size of the FIFO ringbuffer in bytes.  A value of
		zero disables FIFO support.
```

## drivers/power/Kconfig
```kconfig
#
# For a description of the syntax of this configuration file,
# see the file kconfig-language.txt in the NuttX tools repository.
#

source "drivers/power/pm/Kconfig"
source "drivers/power/battery/Kconfig"
source "drivers/power/supply/Kconfig"
```

## drivers/power/battery/Kconfig
```kconfig
#
# For a description of the syntax of this configuration file,
# see the file kconfig-language.txt in the NuttX tools repository.
#

menu "Battery Management Support"

config BATTERY_CHARGER
	bool "Battery Charger support"
	default n

config BQ2425X
	bool "BQ2425X Battery charger support"
	default n
	select I2C
	select I2C_BQ2425X
	depends on BATTERY_CHARGER
	depends on ALLOW_BSD_COMPONENTS
	---help---
		The BQ24250/BQ24251 are battery charger for lithium-ion batteries.

config I2C_BQ2425X
	bool

config BQ2429X
	bool "BQ2429X Battery charger support"
	default n
	select I2C
	select I2C_BQ2429X
	depends on BATTERY_CHARGER
	---help---
		The BQ24296/BQ24297/BQ24296M are battery charger for lithium-ion batteries.

config I2C_BQ2429X
	bool

if BQ2429X

config DEBUG_BQ2429X
	bool "BQ2429X Debug Features"
	default n
	---help---
		Enable BQ2429X battery management debug features.

endif # BQ2429X

config BQ25618
	bool "BQ25618 Battery charger support"
	default n
	select I2C
	select I2C_BQ25618
	depends on BATTERY_CHARGER
	---help---
		The BQ25618 are battery charger for lithium-ion batteries.

config I2C_BQ25618
	bool

config DA9168
	bool "DA9168 Battery charger support"
	default n
	select I2C
	select I2C_DA9168
	depends on BATTERY_CHARGER
	---help---
		The DA9168 are battery charger for lithium-ion batteries.

config I2C_DA9168
	bool

config SC8551
	bool "SC8551 Battery charger support"
	default n
	select I2C
	select I2C_SC8551
	depends on BATTERY_CHARGER
	---help---
		The SC8551 are battery charger for lithium-ion batteries.

config I2C_SC8551
	bool

config STWLC38
	bool "STWLC38 Battery charger support"
	default n
	select I2C
	select I2C_STWLC38
	depends on BATTERY_CHARGER
	---help---
		The STWLC38 are wireless rx for power supply.

config I2C_STWLC38
	bool

config PLUG_IN
	bool "PLUG_IN Battery charger support"
	default n
	depends on BATTERY_CHARGER
	---help---
		The plug in for power supply.

config CPS4019
	bool "CPS4019 Battery charger support"
	default n
	select I2C
	select I2C_CPS4019
	depends on BATTERY_CHARGER
	---help---
		The CPS4019 are wireless rx for power supply.

config AXP202
	bool "AXP202 Battery charger support"
	default n
	select I2C
	select I2C_AXP202
	depends on BATTERY_CHARGER
	---help---
		axp202 are battery charger for lithium-ion batteries.

config I2C_AXP202
	bool

config AXP202_DC2_VOLTAGE
	int "AXP202 DC2 output voltage"
	default 0
	depends on AXP202
	---help---
		AXP202 DC2 output voltage. 0 is disable, enable range: [700, 2275] mV.

config AXP202_DC3_VOLTAGE
	int "AXP202 DC3 output voltage"
	default 3300
	depends on AXP202
	---help---
		AXP202 DC3 output voltage. 0 is disable, enable range: [700, 3500] mV.

config AXP202_LDO2_VOLTAGE
	int "AXP202 LDO2 output voltage"
	default 0
	depends on AXP202
	---help---
		AXP202 LDO2 output voltage. 0 is disable, enable range: [1800, 3300] mV.

config AXP202_LDO3_VOLTAGE
	int "AXP202 LDO3 output voltage"
	default 0
	depends on AXP202
	---help---
		Enable LDO3 output voltage. 0 is disable, enable range: [700, 2275] mV.

config AXP202_LDO4_VOLTAGE
	int "AXP202 LDO4 output voltage"
	default 0
	depends on AXP202
	---help---
		Enable LDO4 output voltage. 0 is disable, other value:
			1250 1300 1400 1500 1600 1700 1800 1900
			2000 2500 2700 2800 3000 3100 3200 3300 mV.

config MCP73871
	bool "Microchip MCP73871 Battery charger support"
	default n
	depends on BATTERY_CHARGER
	---help---
		A simple driver to report MCP73871 status.

config BATTERY_GAUGE
	bool "Battery Fuel Gauge support"
	default n

config MAX1704X
	bool "MAX1704X Battery fuel gauge support"
	default n
	select I2C
	select I2C_MAX1704X
	depends on BATTERY_GAUGE
	---help---
		The MAX17040/MAX17041 are ultra-compact, low-cost, host-side fuel-gauge
		systems for lithium-ion (Li+) batteries in handheld and portable equipment.
		The MAX17040 is configured to operate with a single lithium cell and the
		MAX17041 is configured for a dual-cell 2S pack.

config I2C_MAX1704X
	bool

config BQ27426
	bool "BQ27426 Battery fuel gauge support"
	default n
	select I2C
	depends on BATTERY_GAUGE
	---help---
		The bq27426 battery fuel gauge accurately predicts the battery capacity and other
		operational characteristics of a single, Li-based, rechargeable cell.
		It can be interrogated by a system processor to provide cell information,
		such as state-of-charge (SOC).

config CW2218
	bool "CW2218 Battery fuel gauge support"
	default n
	select I2C
	depends on BATTERY_GAUGE
	---help---
		The CW2218 is an ultra-compact, system-side or pack-side fuel gauging
		IC for Lithium-ion based batteries used in wearable and portable devices

config BATTERY_MONITOR
	bool "Battery Monitor/Management support"
	default n

config BQ769X0
	bool "BQ769X0 Battery monitor support"
	default n
	select I2C
	select I2C_BQ769X0
	depends on BATTERY_MONITOR
	---help---
		The BQ76920/BQ76930/BQ76940 provide monitoring, balancing, and
		protection features for up to 15 cells in series.

config I2C_BQ769X0
	bool

if BQ769X0
	config BQ769X0_USE_INTERNAL_TS
		bool "Use internal temperature sensor on BQ769X0"
		default n
endif

endmenu
```
