## drivers/pwm/Kconfig
```kconfig
#
# For a description of the syntax of this configuration file,
# see the file kconfig-language.txt in the NuttX tools repository.
#

if PWM

config PWM_PULSECOUNT
	bool "PWM Pulse Count Support"
	default n
	depends on ARCH_HAVE_PWM_PULSECOUNT
	---help---
		Some hardware will support generation of a fixed number of pulses.
		This might be used, for example to support a stepper motor.  If the
		hardware will support a fixed pulse count, then this configuration
		should be set to enable the capability.

config PWM_MULTICHAN
	bool "PWM Multiple Output Channel Support"
	default n
	depends on ARCH_HAVE_PWM_MULTICHAN
	depends on !PWM_PULSECOUNT
	---help---
		Enables support for multiple output channels per timer.

if PWM_MULTICHAN

config PWM_NCHANNELS
	int "Number of Output Channels Per Timer"
	default 1
	range 1 6
	---help---
		Specifies the number of output channels per timer.  Each timer
		may support fewer output channels than this value.

endif # PWM_MULTICHAN

endif # PWM
```

## drivers/rc/Kconfig
```kconfig
#
# For a description of the syntax of this configuration file,
# see the file kconfig-language.txt in the NuttX tools repository.
#

menuconfig DRIVERS_RC
	bool "Remote Control Device Support"
	default n
	---help---
		Drivers for various remote control

if DRIVERS_RC

config RC_DUMMY
	bool "Dummy RC Device Support"
	select SCHED_LPWORK
	default n
	---help---
		We test RC driver architecture by dummy rc device.
		Test Item: 1. Test all the IOCTL commands; 2. Test all API interface,
                ex: tx_ir, tx_scancode; 3. We use the way of workqueue to periodically
		feed data to the downstream buffer(userspace->kernelspace) to simulate
		reading data from IR device; 4. Write IR data to device by tx_ir/tx_scancode
		to simulate as remote control.

endif # DRIVERS_RC
```

## drivers/regmap/Kconfig
```kconfig
#
# For a description of the syntax of this configuration file,
# see the file kconfig-language.txt in the NuttX tools repository.
#

menuconfig REGMAP
	bool "Regmap Subsystems Support"
	default n
	---help---
		This selection enables building of the regmap subsystems.
		See include/nuttx/regmap/regmap.h for further regmpap subsystems information.
```

## drivers/rf/Kconfig
```kconfig
#
# For a description of the syntax of this configuration file,
# see the file kconfig-language.txt in the NuttX tools repository.
#

menuconfig DRIVERS_RF
	bool "RF Device Support"
	default n
	---help---
		Drivers for various RF devices

if DRIVERS_RF

config RF_DAT31R5SP
	bool "Mini-Circuits DAT-31R5-SP digital attenuator support"
	default n
	select SPI
	---help---
		Enable driver support for the Mini-Circuits DAT-31R5-SP digital
		attenuator.

endif # DRIVERS_RF
```

## drivers/rmt/Kconfig
```kconfig
#
# For a description of the syntax of this configuration file,
# see the file kconfig-language.txt in the NuttX tools repository.
#

menuconfig RMT
	bool "RMT (Remote Control) Driver Support"
	default n
	---help---
		This option selects common RMT (Remote Control) options and should be
		enabled by the platforms that implement a Remote Control Peripheral.

if RMT

config RMTCHAR
	bool "RMT character driver (for testing only)"
	default n
	---help---
		The RMT character driver is a simple character driver that supports
		RMT transfers via read() and write(). This driver is primarily
		intended to support RMT testing. It is not suitable for use in any
		real driver application in its current form because its buffer
		management heuristics are dependent on the lower half driver
		(device-specific). Applications that use the RMT peripheral to
		implement protocols such as NEC (for Remote Control), or use this
		driver to implement other 1-wire protocols such as WS2812 LED must
		provide their specific driver implementation.

config RMT_DEFAULT_RX_BUFFER_SIZE
	int "Default RX buffer size"
	default 100
	---help---
		The RMT RX default buffer size. This is the expected buffer size
		that should be returned on a `read()` operation.

config RMT_LOOP_TEST_MODE
	bool "RMT character driver loopback test mode (for testing only)"
	depends on EXPERIMENTAL
	default n
	---help---
		This enables a lower-half driver-specific loopback test
		mode that attaches the transmitter to the receiver, being
		able to test the RMT peripheral without any external
		connection. This feature depends on lower-half driver
		implementation.

endif # RMT
```

## drivers/safety/Kconfig
```kconfig
#
# For a description of the syntax of this configuration file,
# see the file kconfig-language.txt in the NuttX tools repository.
#

menu "Safety Driver Support"

config SAFETY
	bool "Safety Character Driver Support"
	default n
	---help---
		This selection enables building of the "upper-half" Safety driver.
		See include/nuttx/safety/safety.h for further Safety
		driver information.

if SAFETY

config SAFETY_REGISTER_MONITOR
	bool "Register Monitor Support"
	default n
	---help---
		use the Register Monitor to check whether the register has been changed.
		If the register has been changed, the Register Monitor will send a
		message to the Safety driver.

endif # SAFETY

endmenu # Safety Driver Support
```
