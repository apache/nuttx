## boards/sim/sim/sim/configs/thermal/defconfig
```kconfig
#include "../nsh/defconfig"
CONFIG_DEBUG_FEATURES=y
CONFIG_DEBUG_THERMAL=y
CONFIG_DEBUG_THERMAL_ERROR=y
CONFIG_DEBUG_THERMAL_INFO=y
CONFIG_DEBUG_THERMAL_WARN=y
CONFIG_PM=y
CONFIG_READLINE_CMD_HISTORY=y
CONFIG_SCHED_LPWORK=y
CONFIG_THERMAL=y
CONFIG_THERMAL_DUMMY=y
CONFIG_THERMAL_PROCFS=y
```

## boards/sparc/bm3803/xx3803/Kconfig
```kconfig
#
# For a description of the syntax of this configuration file,
# see the file kconfig-language.txt in the NuttX tools repository.
#

if ARCH_BOARD_XX3803

config XX3803_WDG
	bool "xx3803 wdg kicker support"
	depends on BM3803_WDG
	depends on WATCHDOG

config XX3803_WDG_TIMEOUT
	int "xx3803 wdg Timeout (ms)"
	default 1000
	depends on XX3803_WDG
	---help---
		Watchdog timeout value in milliseconds.

if XX3803_WDG
config XX3803_WDG_THREAD
	bool "Watchdog Daemon Thread"

if XX3803_WDG_THREAD
config XX3803_WDG_THREAD_NAME
	string "Watchdog Thread Name"
	default "wdog"

config XX3803_WDG_THREAD_INTERVAL
	int "Watchdog Thread Interval (ms)"
	default 500

config XX3803_WDG_THREAD_PRIORITY
	int "Watchdog Thread Priority"
	default 200

config XX3803_WDG_THREAD_STACKSIZE
	int "Watchdog Thread Stacksize"
	default 2048

endif # XX3803_WDG_THREAD
endif # XX3803_WDG

config XX3803_FLASH
	bool "MTD driver for AM29LV FLASH"
	default n
	select MTD
	select MTD_AM29LV
	---help---
		Configures an MTD device for use with the onboard flash

config XX3803_FLASH_PARA
	bool "Create application para data on partition or sector of FLASH"
	default n
	depends on XX3803_FLASH
	---help---
		Enables creation of a /dev/para on the FLASH

config XX3803_FLASH_MINOR
	int "Minor number for the FLASH /dev/smart entry"
	default 0
	depends on XX3803_FLASH
	depends on FS_SMARTFS
	---help---
		Sets the minor number for the FLASH MTD /dev entry

config XX3803_FLASH_PART
	bool "Enable partition support on FLASH"
	default y
	depends on XX3803_FLASH
	select MTD_PARTITION
	---help---
		Enables creation of partitions on the FLASH

config XX3803_FLASH_CONFIG_PART
	bool "Create application config data partition on FLASH"
	default n
	depends on XX3803_FLASH_PART
	depends on PLATFORM_CONFIGDATA
	---help---
		Enables creation of a /dev/config partition on the FLASH

config XX3803_FLASH_CONFIG_PART_NUMBER
	int "Index number of config partition (in list below)"
	default 0
	depends on XX3803_FLASH_CONFIG_PART
	---help---
		Specifies the index number of the config data partition
		from the partition list.

config XX3803_FLASH_PART_LIST
	string "Flash partition size list"
	default "1024,1024,1024,1024"
	depends on XX3803_FLASH_PART
	---help---
		Comma separated list of partition sizes in KB.

config XX3803_FLASH_PART_NAMES
	string "Flash partition name list"
	default "first,second,third,forth"
	depends on XX3803_FLASH_PART
	depends on MTD_PARTITION_NAMES
	---help---
		Comma separated list of partition names.

endif
```

## boards/sparc/bm3823/xx3823/Kconfig
```kconfig
#
# For a description of the syntax of this configuration file,
# see the file kconfig-language.txt in the NuttX tools repository.
#

if ARCH_BOARD_XX3823

config XX3823_FLASH
	bool "MTD driver for AM29LV FLASH"
	default n
	select MTD
	select MTD_AM29LV
	select MTD_SMART
	select FS_SMARTFS
	select MTD_BYTE_WRITE
	---help---
		Configures an MTD device for use with the onboard flash

config XX3823_FLASH_MINOR
	int "Minor number for the FLASH /dev/smart entry"
	default 0
	depends on XX3823_FLASH
	---help---
		Sets the minor number for the FLASH MTD /dev entry

config XX3823_FLASH_PART
	bool "Enable partition support on FLASH"
	default y
	depends on XX3823_FLASH
	select MTD_PARTITION
	---help---
		Enables creation of partitions on the FLASH

config XX3823_FLASH_CONFIG_PART
	bool "Create application config data partition on FLASH"
	default n
	depends on XX3823_FLASH_PART
	depends on PLATFORM_CONFIGDATA
	---help---
		Enables creation of a /dev/config partition on the FLASH

config XX3823_FLASH_CONFIG_PART_NUMBER
	int "Index number of config partition (in list below)"
	default 0
	depends on XX3823_FLASH_CONFIG_PART
	---help---
		Specifies the index number of the config data partition
		from the partition list.

config XX3823_FLASH_PART_LIST
	string "Flash partition size list"
	default "1024,1024,1024,1024"
	depends on XX3823_FLASH_PART
	---help---
		Comma separated list of partition sizes in KB.

config XX3823_FLASH_PART_NAMES
	string "Flash partition name list"
	default "first,second,third,forth"
	depends on XX3823_FLASH_PART
	depends on MTD_PARTITION_NAMES
	---help---
		Comma separated list of partition names.

endif
```

## boards/sparc/s698pm/s698pm-dkit/Kconfig
```kconfig
#
# For a description of the syntax of this configuration file,
# see the file kconfig-language.txt in the NuttX tools repository.
#

if ARCH_BOARD_CUSTOM
config S698PM_DKIT_WDG
	bool "s698pm-dkit wdg kicker support"
	depends on S698PM_WDG
	depends on WATCHDOG

config S698PM_DKIT_WDG_TIMEOUT
	int "s698pm-dkit wdg Timeout (ms)"
	default 1000
	depends on S698PM_DKIT_WDG
	---help---
		Watchdog timeout value in milliseconds.

if S698PM_DKIT_WDG
config S698PM_DKIT_WDG_THREAD
	bool "Watchdog Deamon Thread"

if S698PM_DKIT_WDG_THREAD
config S698PM_DKIT_WDG_THREAD_NAME
	string "Watchdog Thread Name"
	default "wdog"

config S698PM_DKIT_WDG_THREAD_INTERVAL
	int "Watchdog Thread Interval (ms)"
	default 500

config S698PM_DKIT_WDG_THREAD_PRIORITY
	int "Watchdog Thread Priority"
	default 200

config S698PM_DKIT_WDG_THREAD_STACKSIZE
	int "Watchdog Thread Stacksize"
	default 2048

endif # S698PM_DKIT_WDG_THREAD
endif # S698PM_DKIT_WDG

endif
```
