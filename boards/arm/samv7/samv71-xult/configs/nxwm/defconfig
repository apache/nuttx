## boards/arm/stm32/b-g431b-esc1/Kconfig
```kconfig
#
# For a description of the syntax of this configuration file,
# see the file kconfig-language.txt in the NuttX tools repository.
#

if ARCH_BOARD_B_G431B_ESC1

choice
	prompt "PLL clock source"
	default BOARD_STM32_BG431BESC1_HSI

config BOARD_STM32_BG431BESC1_USE_HSI
	bool "HSI"

config BOARD_STM32_BG431BESC1_USE_HSE
	bool "HSE"

endchoice

if STM32_FOC

config BOARD_STM32_BG431BESC1_FOC_VBUS
	bool "B-G431B-ESC1 board VBUS sense"
	default n

config BOARD_STM32_BG431BESC1_FOC_POT
	bool "B-G431B-ESC1 board POT support"
	default n

endif # STM32_FOC

config BOARD_STM32_BG431BESC1_CANTERM
	bool "B-G431B-ESC1 use on-board CAN terminator resistor"
	default y

endif # ARCH_BOARD_B_G431B_ESC1
```

## boards/arm/stm32/common/Kconfig
```kconfig
#
# For a description of the syntax of this configuration file,
# see the file kconfig-language.txt in the NuttX tools repository.
#

config BOARD_STM32_COMMON
       bool "Board common logic"
       default n
       ---help---
               Board common logic located in each board/common folder.

if BOARD_STM32_COMMON

if STM32_FOC

menuconfig BOARD_STM32_IHM07M1
       bool "X-NUCLEO-IHM07M1 board support"
       default n
       ---help---
         Board based on the L6230 DMOS driver.

if BOARD_STM32_IHM07M1

config BOARD_STM32_IHM07M1_VBUS
       bool "X-NUCLEO-IHM07M1 board VBUS sense"
       default n

config BOARD_STM32_IHM07M1_POT
       bool "X-NUCLEO-IHM07M1 board POT support"
       default n

endif # BOARD_STM32_IHM07M1

menuconfig BOARD_STM32_IHM08M1
       bool "X-NUCLEO-IHM08M1 board support"
       default n
       select STM32_FOC_HAS_PWM_COMPLEMENTARY
       ---help---
         Board based on the discrete L6398 gate drivers and STL220N6F7 POWER MOSFETs.

if BOARD_STM32_IHM08M1

config BOARD_STM32_IHM08M1_VBUS
       bool "X-NUCLEO-IHM08M1 board VBUS sense"
       default n

config BOARD_STM32_IHM08M1_POT
       bool "X-NUCLEO-IHM08M1 board POT support"
       default n

endif # BOARD_STM32_IHM08M1

endif # STM32_FOC

endif # BOARD_STM32_COMMON
```

## boards/arm/stm32/et-stm32-stamp/Kconfig
```kconfig
#
# For a description of the syntax of this configuration file,
# see the file kconfig-language.txt in the NuttX tools repository.
#

if ARCH_BOARD_ET_STM32_STAMP

choice
	prompt "Select board type"
	default ET_STM32_STAMP if ARCH_CHIP_STM32F103RE
	---help---
		Select the board hosting the architecture.  You must first select the
		exact MCU part number, then the boards supporting that part will
		be available for selection.  Use ARCH_BOARD_CUSTOM to create a new
		board configuration.

config ET_STM32_STAMP
	bool "ET-STM32 Stamp"
	depends on ARCH_CHIP_STM32F103RE
	---help---
		This version is the standard ET-STM32 Stamp board from Futurlec, with
		the STM32F103RET6 microcontroller.

endchoice

endif
```

## boards/arm/stm32/hymini-stm32v/Kconfig
```kconfig
#
# For a description of the syntax of this configuration file,
# see the file kconfig-language.txt in the NuttX tools repository.
#

if ARCH_BOARD_HYMINI_STM32V

config LCD_R61505U
	bool "LCD Based on R61505U LCD Controller"
	default n
	depends on NX_LCDDRIVER && !LCD_SSD1289
	---help---
		Enables HY-Mini STM32v support for any LCD based on the R61505U,
		LCD Controller.

endif
```
