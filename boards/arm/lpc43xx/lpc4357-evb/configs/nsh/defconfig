## boards/arm/lpc54xx/lpcxpresso-lpc54628/Kconfig
```kconfig
#
# For a description of the syntax of this configuration file,
# see the file kconfig-language.txt in the NuttX tools repository.
#

if ARCH_BOARD_LPCXPRESSO_LPC54628

config ARCH_BOARD_LPCXPRESSO_LPC54628_TOUCHSCREEN_SWAPXY
       bool "LPCXPRESSO LPC54628 Touchscreen sway X/Y"
       depends on INPUT_TOUCHSCREEN

endif
```

## boards/arm/mps/mps3-an547/Kconfig
```kconfig
#
# For a description of the syntax of this configuration file,
# see the file kconfig-language.txt in the NuttX tools repository.
#

if ARCH_BOARD_MPS3_AN547


choice
prompt "choice product board"

config MPS3_AN547_NSH
	bool "mps3an547 NSH"

config MPS3_AN547_AP
	bool "mps3an547 AP"

config MPS3_AN547_BL
	bool "mps3an547 BL"

endchoice
endif
```

## boards/arm/mx8mp/verdin-mx8mp/Kconfig
```kconfig
#
# For a description of the syntax of this configuration file,
# see the file kconfig-language.txt in the NuttX tools repository.
#

config MX8MP_RUN_FROM_ITCM
	bool "Run from Instruction Tightly Coupled Memory (ITCM)"
	default n
	---help---
		Run software from ITCM instead of DDR memory
```

## boards/arm/nrf52/arduino-nano-33ble/Kconfig
```kconfig
#
# For a description of the syntax of this configuration file,
# see the file kconfig-language.txt in the NuttX tools repository.
#

if ARCH_BOARD_ARDUINO_NANO_33BLE
config ARDUINONANO33BLE_ARDUINO_BOOTLOADER
	bool "Use Arduino bootloader"
	default y
	---help---
		Use the Arduino bootloader to load the NuttX binary.
endif
```

## boards/arm/nrf52/common/Kconfig
```kconfig
#
# For a description of the syntax of this configuration file,
# see the file kconfig-language.txt in the NuttX tools repository.
#

config NRF52_HAVE_OTA_PARTITION
	bool
	default n

menu "Application Image Configuration"

choice
	prompt "Application Image Format"
	default NRF52_APP_FORMAT_LEGACY

config NRF52_APP_FORMAT_LEGACY
	bool "Legacy format"
	---help---
		This is the legacy application image format.

config NRF52_APP_FORMAT_MCUBOOT
	bool "MCUboot-bootable format"
	select NRF52_HAVE_OTA_PARTITION
	---help---
		The MCUboot support of loading the firmware images.

endchoice # Application Image Format

config NRF52_PROGMEM_OTA_PARTITION
	bool "MTD driver"
	default n
	depends on NRF52_HAVE_OTA_PARTITION
	select BCH
	select MTD
	select MTD_BYTE_WRITE
	select MTD_PARTITION
	select MTD_PROGMEM
	select NRF52_PROGMEM
	---help---
		Initialize an MTD driver for the Flash, which will
		add an entry at /dev for application access from userspace.

if NRF52_PROGMEM_OTA_PARTITION

config NRF52_MCUBOOT_HAVE_SCRACH
	bool "Scratch partition support"
	default n

config NRF52_MCUBOOT_HEADER_SIZE
	hex
	default 0x200
	depends on NRF52_APP_FORMAT_MCUBOOT

config NRF52_OTA_PRIMARY_SLOT_DEVPATH
	string "Application image primary slot device path"
	default "/dev/ota0"

config NRF52_OTA_SECONDARY_SLOT_DEVPATH
	string "Application image secondary slot device path"
	default "/dev/ota1"

config NRF52_OTA_PRIMARY_SLOT_OFFSET
	hex "MCUboot application image primary slot offset"
	default "0x10000"

config NRF52_OTA_SECONDARY_SLOT_OFFSET
	hex "MCUboot application image secondary slot offset"
	default "0x40000"

config NRF52_OTA_SLOT_SIZE
	hex "MCUboot application image slot size (in bytes)"
	default "0x30000"

if NRF52_MCUBOOT_HAVE_SCRACH

config NRF52_OTA_SCRATCH_DEVPATH
	string "Scratch partition device path"
	default "/dev/otascratch"

config NRF52_OTA_SCRATCH_OFFSET
	hex "MCUboot scratch partition offset"
	default "0x70000"

config NRF52_OTA_SCRATCH_SIZE
	hex "MCUboot scratch partition size (in bytes)"
	default "0x10000"

endif # NRF52_MCUBOOT_HAVE_SCRACH

endif # NRF52_PROGMEM_OTA_PARTITION

endmenu # Application Image Configuration
```

## boards/arm/nrf52/nrf52-feather/Kconfig
```kconfig
#
# For a description of the syntax of this configuration file,
# see the file kconfig-language.txt in the NuttX tools repository.
#

if ARCH_BOARD_NRF52_FEATHER

menuconfig NRF52_FEATHER_KB_FEATHERWING
	bool "Keyboard FeatherWing"
    default n
    ---help---
        Enable support for the SolderParty FeatherWing
        https://www.solder.party/docs/keyboard-featherwing/

if NRF52_FEATHER_KB_FEATHERWING
config KB_FEATHERWING_LCD
    bool "LCD"
    select SPI
    select NRF52_SPI0_MASTER
    select LCD
    select LCD_ILI9341
    select LCD_ILI9341_IFACE0
    default n
    ---help---
        Enable the LCD display with ILI9341 controller

config KB_FEATHERWING_LCD_TOUCH
    bool "Touch Controller"
    select INPUT_STMPE811
    default n

config KB_FEATHERWING_NEOPIXEL
    bool "NeoPixel"
    select SPI
    select NRF52_SPI2_MASTER
    select WS2812
    default n
    ---help---
        Enable the single NeoPixel on the top of the display 

config KB_FEATHERWING_KEYBOARD
    bool "QWERTY Keyboard and Buttons"
    default n
    select INPUT
    select INPUT_SPQ10KBD
    select SPQ10KBD_DJOY
    select NRF52_I2C1_MASTER
    ---help---
        Enable support BB QWERTY Keyboard with buttons

config KB_FEATHERWING_SDCARD
    bool "SD Card"
    select SPI
    select NRF52_SPI0_MASTER
    select MMCSD
    select MMCSD_SPI
    default n
    ---help---
        Enable support SD Card slot

endif # NRF52_FEATHER_KB_FEATHERWING

endif # ARCH_BOARD_NRF52_FEATHER
```

## boards/arm/nrf52/nrf52-generic/Kconfig
```kconfig
#
# For a description of the syntax of this configuration file,
# see the file kconfig-language.txt in the NuttX tools repository.
#

if ARCH_BOARD_NRF52_GENERIC

config NRF52_GENERIC_UART0_RX_PIN
	int "Pin select for UART0 TXD"
	default 23
	---help---
		Pin select for UART0 TXD

config NRF52_GENERIC_UART0_TX_PIN
	int "Pin select for UART0 TXD"
	default 24
	---help---
		Pin select for UART0 TXD

config NRF52_GENERIC_NUM_LEDS
	int "Number of LEDs"
	default 4
	---help---
		Number of LEDs

config NRF52_GENERIC_LED_ACTIVELOW
	bool "Board LEDs are 'active low'"
	default y
	---help---
		Board LEDs are 'active low'

config NRF52_GENERIC_LED1_PIN
	int "Pin select for LED 1"
	default 17
	---help---
		Pin select for LED 1

config NRF52_GENERIC_LED2_PIN
	int "Pin select for LED 2"
	default 18
	---help---
		Pin select for LED 2

config NRF52_GENERIC_LED3_PIN
	int "Pin select for LED 3"
	default 19
	---help---
		Pin select for LED 3

config NRF52_GENERIC_LED4_PIN
	int "Pin select for LED 4"
	default 20
	---help---
		Pin select for LED 4

endif
```
