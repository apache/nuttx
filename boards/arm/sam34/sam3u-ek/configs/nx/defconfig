## boards/arm/sam34/sam4l-xplained/Kconfig
```kconfig
#
# For a description of the syntax of this configuration file,
# see the file kconfig-language.txt in the NuttX tools repository.
#

if ARCH_BOARD_SAM4L_XPLAINED

menu "SAM4L Xplained Pro Modules"

config SAM4L_XPLAINED_SLCD1MODULE
	bool "SLCD1 Module"
	default n
	---help---
		The SLCD 1 module is attached.  This module provides a segment LCD
		that connects directly to the "EXT5 SEGMENT LCD" connector.  When
		the SLCD is connected, EXT2 is not available for other modules.

config SAM4L_XPLAINED_IOMODULE
	bool "I/O1 Module"
	default n
	---help---
		The I/O 1 module is attached.  This module provides an MMC/SD card
		slot.

if SAM4L_XPLAINED_IOMODULE

choice
	prompt "I/O1 Module Location"
	default SAM4L_XPLAINED_IOMODULE_EXT1

config SAM4L_XPLAINED_IOMODULE_EXT1
	bool "EXT1"

config SAM4L_XPLAINED_IOMODULE_EXT2
	bool "EXT2"
	depends on !SAM4L_XPLAINED_SLCD1MODULE

endchoice
endif

config SAM4L_XPLAINED_OLED1MODULE
	bool "OLED1 Module"
	default n
	---help---
		The OLED 1 module is attached.  This module provides an OLED plus 3
		additional switches and 3 additional LEDs.

if SAM4L_XPLAINED_OLED1MODULE

choice
	prompt "OLED1 Module Location"
	default SAM4L_XPLAINED_OLED1MODULE_EXT1

config SAM4L_XPLAINED_OLED1MODULE_EXT1
	bool "EXT1"

config SAM4L_XPLAINED_OLED1MODULE_EXT2
	bool "EXT2"
	depends on !SAM4L_XPLAINED_SLCD1MODULE

endchoice
endif

endmenu
endif
```

## boards/arm/sam34/sam4s-xplained-pro/Kconfig
```kconfig
#
# For a description of the syntax of this configuration file,
# see the file kconfig-language.txt in the NuttX tools repository.
#

if ARCH_BOARD_SAM4S_XPLAINED_PRO

config SAM4S_XPLAINED_PRO_CDCACM_DEVMINOR
	int "CDC/ACM Device Minor"
	default 0
	depends on SAM34_UDP && USBDEV && CDCACM

config SAM4S_XPLAINED_PRO_SCHED_TIMER_DEVPATH
	string "Scheduler Timer Device Path"
	default "/dev/rtt0"
	depends on TIMER && SYSTEMTICK_EXTCLK

config SAM4S_XPLAINED_PRO_CPULOAD_TIMER_DEVPATH
	string "CPU Load Timer Device Path"
	default "/dev/tc0"
	depends on TIMER && SCHED_CPULOAD && SCHED_CPULOAD_EXTCLK

config SAM34_NAND_BLOCKMOUNT
	bool "NAND FLASH auto-mount"
	default n
	depends on NSH_ARCHINIT && SAM34_EXTNAND
	---help---
		Automatically initialize the NAND FLASH driver when NSH starts.

choice
	prompt "NAND FLASH configuration"
	default SAM34_NAND_NXFFS
	depends on SAM34_NAND_BLOCKMOUNT

config SAM34_NAND_FTL
	bool "Create NAND FLASH block driver"
	depends on MTD && MTD_NAND
	---help---
		Create the MTD driver for the NAND and "wrap" the NAND as a standard
		block driver that could then, for example, be mounted using FAT or
		any other file system.  Any file system may be used, but there will
		be no wear-leveling.

		NOTE: This options is not currently recommended.  There is not now
		NuttX file system that can handle the NAND back blocks or performs
		wear-leveling other than NXFFS and NXFFS does not use a block driver
		but, rather, operates directly upon the NAND MTD device.

config SAM34_NAND_NXFFS
	bool "Create NAND FLASH NXFFS file system"
	depends on MTD && MTD_NAND && FS_NXFFS && NXFFS_NAND
	---help---
		Create the MTD driver for the NAND and mount the NAND device as
		a wear-leveling, NuttX FLASH file system (NXFFS).  The downside of
		NXFFS is that it can be very slow.

		NOTE: NXFFS is recommended because (1) it can handle the NAND back
		blocks and (1) performs wear-leveling.

endchoice # NAND FLASH configuration

endif
```

## boards/arm/sama5/jti-toucan2/Kconfig
```kconfig
#
# For a description of the syntax of this configuration file,
# see the file kconfig-language.txt in the NuttX tools repository.
#

if ARCH_BOARD_JTI_TOUCAN2

choice
        prompt "CPU Frequency"
        default SAMA5D27_JTI_TOUCAN2_492MHZ

config SAMA5D27_JTI_TOUCAN2_492MHZ
	bool "492 MHz"
  
endchoice # CPU Frequency

 
config SAMA5D27_JTI_TOUCAN2_USBHOST_STACKSIZE
	int "USB host waiter stack size"
	default 1536 if USBHOST_HUB
	default 1024 if !USBHOST_HUB
	depends on USBHOST

config SAMA5D27_JTI_TOUCAN2_USBHOST_PRIO
	int "USB host waiter task priority"
	default 100
	depends on USBHOST


config SAMA5_SYSTEMRESET
	bool "Enable system reset - this will enable the nsh reboot command"
	select BOARDCTL_RESET

config SAMA5D27_M25P_AUTOMOUNT
	bool "M25P serial FLASH auto-mount"
	default n
	depends on NSH_ARCHINIT && SAMA5_SPI0 && MTD_M25P
	---help---
		Automatically initialise the M25P SPI FLASH driver when NSH starts

choice
	prompt "M25P serial FLASH configuration"
	default SAMA5D27_M25P_NXFFS
	depends on SAMA5D27_M25P_AUTOMOUNT

config SAMA5D27_M25P_FTL
	bool "Create M25P Serial FLASH block driver"
	---help---
		Create the MTD driver for the M25P and "wrap" the M25P as a standard
		block driver that could then, for example, be mounted using FAT or
		any other file system.  Any file system may be used, but there will
		be no wear-leveling.

config SAMA5D27_M25P_NXFFS
	bool "Create M25P serial FLASH NXFFS file system"
	depends on FS_NXFFS
	---help---
		Create the MTD driver for the M25P and mount the M25P device as
		a wear-leveling, NuttX FLASH file system (NXFFS).  The downside of
		NXFFS is that it can be very slow.

endchoice # M25P serial FLASH configuration

	
endif # ARCH_BOARD_JTI_TOUCAN2
```

## boards/arm/sama5/sama5d2-xult/Kconfig
```kconfig
#
# For a description of the syntax of this configuration file,
# see the file kconfig-language.txt in the NuttX tools repository.
#

if ARCH_BOARD_SAMA5D2_XULT

choice
	prompt "CPU Frequency"
	default SAMA5D2XULT_396MHZ

config SAMA5D2XULT_384MHZ
	bool "384 MHz"

config SAMA5D2XULT_396MHZ
	bool "396 MHz"

config SAMA5D2XULT_498MHZ
	bool "498 MHz"

config SAMA5D2XULT_528MHZ
	bool "528 MHz"

endchoice # CPU Frequency

config SAMA5D2XULT_USBHOST_STACKSIZE
	int "USB host waiter stack size"
	default 1536 if USBHOST_HUB
	default 1024 if !USBHOST_HUB
	depends on USBHOST

config SAMA5D2XULT_USBHOST_PRIO
	int "USB host waiter task priority"
	default 100
	depends on USBHOST

config SAMA5_SDMMC
	bool "enable SDMMC controller"
	default y if SAMA5_HAVE_SDMMC
	select SDIO_DMA
	select SCHED_WORKQUEUE
	select SCHED_HPWORK
    select MMCSD
    select MMCSD_SDIO
	select SDIO_BLOCKSETUP
	select ARCH_HAVE_SDIO
	select SAMA5_SDMMC_DMA
	---help---
		Enable SD Card interface SDMMC0. Selects SAMA5_SDMMC SAMA5_SDMMC0 SAMA5_SDMMC_DMA SDIO_DMA SCHED_WORKQUEUE SCHED_HPWORK SDIO_BLOCKSETUP

config SAMA5_SDMMC0
    bool "Enable SDMMC0 (built-in eMMC)"
    default n if SAMA5_SDMMC
    depends on SAMA5_SDMMC

config SAMA5_SDMMC0_SIZE
    int "SDMMC0 size in bytes"
    default 4294967296
    depends on SAMA5_SDMMC0
    ---help---
    Size of eMMC flash in bytes. Default: 4GB

config SAMA5D27_SDMMC0_MOUNT
    bool "Mount SDMMC0 at startup"
    default n
    depends on SAMA5_SDMMC0

config SAMA5D27_SDMMC0_MOUNT_BLKDEV
    string "SDMMC0 block device name"
    default "mmc0"
    depends on SAMA5_SDMMC0

config SAMA5D27_SDMMC0_MOUNT_MOUNTPOINT
    string "SDMMC0 mountpoint"
    default "/mnt/sdmmc0"
    depends on SAMA5_SDMMC0

config SAMA5D27_SDMMC0_MOUNT_FSTYPE
    string "SDMMC0 file system type"
    default "vfat"
    depends on SAMA5_SDMMC0

config CONFIG_SAMA5_SDMMC1_WIDTH_D1_D8
    bool "SDMMC0 data bus width 8 bits"
    default y
    depends on SAMA5_SDMMC0

config SAMA5_SDMMC1
    bool "Enable SDMMC1"
	default y if SAMA5_SDMMC
    select SAMA5_SDMMC1_WIDTH_D1_D4
    depends on SAMA5_SDMMC

config SAMA5_SDMMC1_SIZE
	int "SDMMC1 size in bytes"
    default 1073741824
    depends on SAMA5_SDMMC1
	---help---
		Size of SD Card in bytes. Default: 16GB

config SAMA5D27_SDMMC1_MOUNT
    bool "Mount SDMMC1 at startup"
    default n
    depends on SAMA5_SDMMC1

config SAMA5D27_SDMMC1_MOUNT_BLKDEV
    string "SDMMC1 block device name"
    default "mmc1"
    depends on SAMA5_SDMMC1

config SAMA5D27_SDMMC1_MOUNT_MOUNTPOINT
    string "SDMMC1 mountpoint"
    default "/mnt/sdmmc1"
    depends on SAMA5_SDMMC1

config SAMA5D27_SDMMC1_MOUNT_FSTYPE
    string "SDMMC1 file system type"
    default "vfat"
    depends on SAMA5_SDMMC1

config MMCSD_HAVE_CARDDETECT
    bool "SDMMC1 card detect"
    default y
    depends on SAMA5_SDMMC1

config SAMA5_SDMMC1_WIDTH_D1_D4
    bool "SDMMC1 data bus width 4 bits"
    default y
    depends on SAMA5_SDMMC1

config SAMA5_SYSTEMRESET
    bool "Enable system reset - this will enable the nsh reboot command"
    select BOARDCTL_RESET

endif # ARCH_BOARD_SAMA5D2_XULT
```
