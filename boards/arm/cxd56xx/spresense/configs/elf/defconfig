## boards/arm/efm32/efm32-g8xx-stk/Kconfig
```kconfig
#
# For a description of the syntax of this configuration file,
# see the file kconfig-language.txt in the NuttX tools repository.
#

if ARCH_BOARD_EFM32G8XXSTK

comment "EFM32 G8XX STK Hardware Configuration"

config EFM32G8STK_BCEN
	bool "Enable BC_EN"
	default n
	---help---
		The control MCU acts as a board controller (BC). There is a UART
		connection between the EFM and the BC. The connection is made by
		setting the EFM_BC_EN (PD13) line high. The EFM can then use the
		BSP to send commands to the BC. When EFM_BC_EN is low, EFM_BC_TX
		and EFM_BC_RX can be used by other applications.

endif # ARCH_BOARD_EFM32G8XXSTK
```

## boards/arm/efm32/efm32gg-stk3700/Kconfig
```kconfig
#
# For a description of the syntax of this configuration file,
# see the file kconfig-language.txt in the NuttX tools repository.
#

if ARCH_BOARD_EFM32GG_STK3700

comment "EFM32GG-STK3700 Hardware Configuration"

config EFM32GG_STK3700_BCEN
	bool "Enable BC_EN"
	default n
	---help---
		The kit contains a board controller that is responsible for
		performing various board level tasks, such as handling the debugger
		and the Advanced Energy Monitor. An interface is provided between
		the EFM32 and the board controller in the form of a UART connection.
		The connection is enabled by setting the EFM_BC_EN (PF7) line high,
		and using the lines EFM_BC_TX (PE0) and EFM_BC_RX (PE1) for
		communicating.

endif # ARCH_BOARD_EFM32GG_STK3700
```

## boards/arm/gd32f4/gd32f450zk-aiotbox/Kconfig
```kconfig
#
# For a description of the syntax of this configuration file,
# see the file kconfig-language.txt in the NuttX tools repository.
#

if ARCH_BOARD_GD32F450ZK_AIOTBOX

choice
	prompt "Select Console wiring."
	default GD32F450ZK_AIOTBOX_CONSOLE_BOARD
	---help---
		Select where you will connect the console.

		Virtual COM Port:

		Advantage: Use the ST-Link as a console. No Extra wiring
		needed.

		Disadvantage: Not the best choice for initial bring up.

		BOARD USART Connector:

		Advantage: You have a shield so it is easy.

		Disadvantage: You loose the use of the
		other functions on PA9, PA10

				GD32F450ZK_AIOTBOX
			USART0 GPIO
			-- ----- --------- ----
			RX    USART0_RX PB7
			TX    USART0_TX PB6
			-- ----- --------- ---

config GD32F450ZK_AIOTBOX_CONSOLE_BOARD
	bool "Aiotbox Com Connector"
	select GD32_USART0
	select USART0_SERIALDRIVER

config GD32F450ZK_AIOTBOX_CONSOLE_VIRTUAL
	bool "Aiotbox Virtual ComPort"
	select GD32_USART3
	select USART3_SERIALDRIVER

config GD32F450ZK_AIOTBOX_CONSOLE_NONE
	bool "No Serial Console"

endchoice # "Select Console wiring"


choice
	prompt "GD32F4 MCU Crystal Selected"
	default GD32F4_BOARD_USE_HXTAL_AIOTBOX

config GD32F4_BOARD_USE_HXTAL_AIOTBOX
	bool "Aiotbox Use Hxtal as clock source"
	# select GD32F4_BOARD_HXTAL_VALUE

config GD32F4_BOARD_USE_IRC16_AIOTBOX
	bool "Aiotbox Use IRC16M as clock source"

endchoice # CPU Frequency

config GD32F4_BOARD_HXTAL_VALUE
	int "GD32F450Z Aiotbox Board Hxtal Value"
	default 25000000
	depends on GD32F4_BOARD_USE_HXTAL_AIOTBOX
	---help---
		GD32F450Z Aiotbox Board Hxtal Value, default is 25MHz.

choice
	prompt "GD32F4 MCU System Frequency"
	default GD32F4_200MHZ_AIOTBOX

config GD32F4_200MHZ_AIOTBOX
	bool "200 MHz"

config GD32F4_168MHZ_AIOTBOX
	bool "168 MHz"

config GD32F4_120MHZ_AIOTBOX
	bool "120 MHz"

endchoice # CPU Frequency


endif # ARCH_BOARD_GD32F450ZK_AIOTBOX
```

## boards/arm/gd32f4/gd32f450zk-eval/Kconfig
```kconfig
#
# For a description of the syntax of this configuration file,
# see the file kconfig-language.txt in the NuttX tools repository.
#

if ARCH_BOARD_GD32F450ZK_EVAL

choice
	prompt "Select Console wiring."
	default GD32F450ZK_EVAL_CONSOLE_BOARD
	---help---
		Select where you will connect the console.

		Virtual COM Port:

		Advantage: Use the ST-Link as a console. No Extra wiring
		needed.

		Disadvantage: Not the best choice for initial bring up.

		BOARD USART Connector:

		Advantage: You have a shield so it is easy.

		Disadvantage: You loose the use of the
		other functions on PA9, PA10

				GD32F450ZK_EVAL
			USART0 GPIO
			-- ----- --------- ----
			RX    USART0_RX PA10
			TX    USART0_TX PA9
			-- ----- --------- ---

config GD32F450ZK_EVAL_CONSOLE_BOARD
	bool "Eval Com Connector"
	select GD32_USART0
	select USART0_SERIALDRIVER
	select USART0_SERIAL_CONSOLE
	select GD32F4_FLASH_CONFIG_K

config GD32F450ZK_EVAL_CONSOLE_VIRTUAL
	bool "Virtual Comport"
	select GD32_USART3
	select USART3_SERIALDRIVER
	select USART3_SERIAL_CONSOLE

config GD32F450ZK_EVAL_CONSOLE_NONE
	bool "No Console"

endchoice # "Select Console wiring"


choice
	prompt "GD32F4 MCU Crystal Selected"
	default GD32F4_BOARD_USE_HXTAL

config GD32F4_BOARD_USE_HXTAL
	bool "Use Hxtal as clock source"
	# select GD32F4_BOARD_HXTAL_VALUE

config GD32F4_BOARD_USE_IRC16
	bool "Use IRC16M as clock source"

endchoice # CPU Frequency

config GD32F4_BOARD_HXTAL_VALUE
	int "GD32F450Z Eval Board Hxtal Value"
	default 25000000
	depends on GD32F4_BOARD_USE_HXTAL
	---help---
		GD32F450Z Eval Board Hxtal Value, default is 25MHz.

choice
	prompt "GD32F4 MCU System Frequency"
	default GD32F4_200MHZ

config GD32F4_200MHZ
	bool "200 MHz"

config GD32F4_168MHZ
	bool "168 MHz"

config GD32F4_120MHZ
	bool "120 MHz"

endchoice # CPU Frequency


config GD32F450ZK_EVAL_GD25_BLOCKMOUNT
	bool "GD25 serial FLASH auto-mount"
	default n
	depends on GD32F4_SPI5 && MTD_GD25
	---help---
		Automatically initialize the GD25 SPI FLASH driver when NSH starts.

choice
	prompt "GD25 SPI FLASH configuration"
	default GD32F450ZK_EVAL_GD25_NXFFS
	depends on GD32F450ZK_EVAL_GD25_BLOCKMOUNT

config GD32F450ZK_EVAL_GD25_FTL
	bool "Create GD25 SPI FLASH block driver"
	---help---
		Create the MTD driver for the GD25 and "wrap" the GD25 as a standard
		block driver that could then, for example, be mounted using FAT or
		any other file system. Any file system may be used, but there will
		be no wear-leveling.

config GD32F450ZK_EVAL_GD25_NXFFS
	bool "Create GD25 serial FLASH NXFFS file system"
	depends on FS_NXFFS
	---help---
		Create the MTD driver for the GD25 and mount the GD25 device as
		a wear-leveling, NuttX FLASH file system (NXFFS).  The downside of
		NXFFS is that it can be very slow.

endchoice # GD25 serial FLASH configuration

config GD32F450ZK_EVAL_AT24_TEST
	bool "I2C0 EEPROM AT2402 write and read test"
	default n
	depends on NSH_ARCHINIT && GD32F4_I2C0 && MTD_AT24XX
	---help---
		Automatically initialize and test the AT24 I2C EEPROM driver when
		NSH starts. After test the I2C0 will be released.

config AT24XX_MTD_BLOCKSIZE
	int "AT24xx MTD block size"
	default 8
	depends on GD32F450ZK_EVAL_AT24_TEST
	---help---
		The block size must be an even multiple of the pages.
		The page size of AT2402 on the board is 8 Byte.

endif # ARCH_BOARD_GD32F450ZK_EVAL
```
