## boards/arm/tiva/tm4c123g-launchpad/Kconfig
```kconfig
#
# For a description of the syntax of this configuration file,
# see the file kconfig-language.txt in the NuttX tools repository.
#

if ARCH_BOARD_TM4C123G_LAUNCHPAD

config TM4C123G_LAUNCHPAD_AT24_BLOCKMOUNT
	bool "AT24 Serial EEPROM auto-mount"
	default n
	depends on NSH_ARCHINIT && TIVA_I2C0 && MTD_AT24XX
	---help---
		Automatically initialize the AT24 SPI EEPROM driver when NSH starts.

		The Serial EEPROM was mounted on an external adaptor board and
		connected to the LaunchPad thusly:

		- VCC -- VCC
		- GND -- GND
		- PB2 -- SCL
		- PB3  -- SDA

choice
	prompt "AT24 serial EPPROM configuration"
	default TM4C123G_LAUNCHPAD_AT24_FTL
	depends on TM4C123G_LAUNCHPAD_AT24_BLOCKMOUNT

config TM4C123G_LAUNCHPAD_AT24_FTL
	bool "Create AT24 block driver"
	---help---
		Create the MTD driver for the AT24 and "wrap" the AT24 as a standard
		block driver that could then, for example, be mounted using FAT or
		any other file system.  Any file system may be used, but there will
		be no wear-leveling.

config TM4C123G_LAUNCHPAD_AT24_NXFFS
	bool "Create AT24 NXFFS file system"
	depends on FS_NXFFS
	---help---
		Create the MTD driver for the AT24 and mount the AT24 device as
		a wear-leveling, NuttX FLASH file system (NXFFS).  The downside of
		NXFFS is that it can be very slow.

endchoice # AT24 serial EPPROM configuration

choice
	prompt "CAN0 RX pin selection"
	default TM4C123G_LAUNCHPAD_CAN0RX_PE4
	depends on TIVA_CAN0

config TM4C123G_LAUNCHPAD_CAN0RX_PF0
	bool "Use pin 0 on GPIO port F"

config TM4C123G_LAUNCHPAD_CAN0RX_PB4
	bool "Use pin 4 on GPIO port B"

config TM4C123G_LAUNCHPAD_CAN0RX_PE4
	bool "Use pin 4 on GPIO port E"

endchoice # CAN0 RX pin selection

choice
	prompt "CAN0 TX pin selection"
	default TM4C123G_LAUNCHPAD_CAN0TX_PE5
	depends on TIVA_CAN0

config TM4C123G_LAUNCHPAD_CAN0TX_PF3
	bool "Use pin 3 on GPIO port F"

config TM4C123G_LAUNCHPAD_CAN0TX_PB5
	bool "Use pin 5 on GPIO port B"

config TM4C123G_LAUNCHPAD_CAN0TX_PE5
	bool "Use pin 5 on GPIO port E"

endchoice # CAN0 TX pin selection

endif
```

## boards/arm/tiva/tm4c1294-launchpad/Kconfig
```kconfig
#
# For a description of the syntax of this configuration file,
# see the file kconfig-language.txt in the NuttX tools repository.
#

if ARCH_BOARD_TM4C1294_LAUNCHPAD
if TIMER && TIVA_TIMER32_PERIODIC

config TM4C1294_LAUNCHPAD_TIMER
	bool
	default n

choice
	prompt "Timer driver selection"
	default TM4C1294_LAUNCHPAD_TIMER_NONE

config TM4C1294_LAUNCHPAD_TIMER_NONE
	bool "None"

config TM4C1294_LAUNCHPAD_TIMER0
	bool "Timer 0"
	depends on TIVA_TIMER0
	select TM4C1294_LAUNCHPAD_TIMER

config TM4C1294_LAUNCHPAD_TIMER1
	bool "Timer 1"
	depends on TIVA_TIMER1
	select TM4C1294_LAUNCHPAD_TIMER

config TM4C1294_LAUNCHPAD_TIMER2
	bool "Timer 2"
	depends on TIVA_TIMER2
	select TM4C1294_LAUNCHPAD_TIMER

config TM4C1294_LAUNCHPAD_TIMER3
	bool "Timer 3"
	depends on TIVA_TIMER3
	select TM4C1294_LAUNCHPAD_TIMER

config TM4C1294_LAUNCHPAD_TIMER4
	bool "Timer 4"
	depends on TIVA_TIMER4
	select TM4C1294_LAUNCHPAD_TIMER

config TM4C1294_LAUNCHPAD_TIMER5
	bool "Timer 5"
	depends on TIVA_TIMER5
	select TM4C1294_LAUNCHPAD_TIMER

config TM4C1294_LAUNCHPAD_TIMER6
	bool "Timer 6"
	depends on TIVA_TIMER6
	select TM4C1294_LAUNCHPAD_TIMER

config TM4C1294_LAUNCHPAD_TIMER7
	bool "Timer 7"
	depends on TIVA_TIMER7
	select TM4C1294_LAUNCHPAD_TIMER

endchoice # Timer driver selection

if TM4C1294_LAUNCHPAD_TIMER

config TM4C1294_LAUNCHPAD_TIMER_DEVNAME
	string "Timer device name"
	default "/dev/timer0"

config TM4C1294_LAUNCHPAD_TIMER_ALTCLK
	bool "Use alternate clock source"
	default n
	depends on EXPERIMENTAL

endif # TM4C1294_LAUNCHPAD_TIMER
endif # TIVA_TIMER32_PERIODIC
config TM4C1294_LAUNCHPAD_JUMPERS_CAN
	bool "Use CAN jumpers configuration"
	default n
	depends on TIVA_UART2
	---help---
		If set, NuttX will assume the jumpers JP4 and JP5 are set in CAN configuration.
		This means UART2 will be connected to the ICDI serial port.

choice
	prompt "UART2 Rx pin selection"
	depends on TIVA_UART2
	default TM4C1294_LAUNCHPAD_UART2_RX_A6

config TM4C1294_LAUNCHPAD_UART2_RX_A6
	bool "Use A6 as UART Rx pin"
	depends on TIVA_UART2 && !TM4C1294_LAUNCHPAD_JUMPERS_CAN

config TM4C1294_LAUNCHPAD_UART2_RX_D4
	bool "Use D4 as UART Rx pin"
	depends on TIVA_UART2

endchoice # UART2 Rx pin selection

choice
	prompt "UART2 Tx pin selection"
	default TM4C1294_LAUNCHPAD_UART2_TX_A7
	depends on TIVA_UART2

config TM4C1294_LAUNCHPAD_UART2_TX_A7
	bool "Use A7 as UART Tx pin"
	depends on TIVA_UART2 && !TM4C1294_LAUNCHPAD_JUMPERS_CAN

config TM4C1294_LAUNCHPAD_UART2_TX_D5
	bool "Use D5 as UART Tx pin"
	depends on TIVA_UART2

endchoice # UART2 Tx pin selection

choice
	prompt "Sensors selection"
	depends on TIVA_I2C
	default BOOSTXL_SENSORS_NONE

config BOOSTXL_SENSORS_NONE
	bool "None"

config BOOSTXL_SENSORS_1
	bool "BOOSTXL-SENSORS on BOOSTERPACK1"
	depends on TIVA_I2C0

config BOOSTXL_SENSORS_2
	bool "BOOSTXL-SENSORS on BOOSTERPACK2"
	depends on TIVA_I2C2
endchoice
endif # ARCH_BOARD_TM4C1294_LAUNCHPAD
```

## boards/arm/tlsr82/tlsr8278adk80d/Kconfig
```kconfig
#
# For a description of the syntax of this configuration file,
# see misc/tools/kconfig-language.txt.
#

if ARCH_BOARD_TLSR8278ADK80D

menu "Telink TLSR8278ADK80D board"

choice
	prompt "Default pin interrupt type"
	default PIN_INTERRUPT_DEFAULT_RISING
	depends on DEV_GPIO

config PIN_INTERRUPT_DEFAULT_RISING
	bool "Rising"

config PIN_INTERRUPT_DEFAULT_FALLING
	bool "Falling"

config PIN_INTERRUPT_DEFAULT_HIGH
	bool "High level"

config PIN_INTERRUPT_DEFAULT_LOW
	bool "Low level"

endchoice

endmenu

endif
```

## boards/arm/xmc4/xmc4800-relax/Kconfig
```kconfig
#
# For a description of the syntax of this configuration file,
# see the file kconfig-language.txt in the NuttX tools repository.
#

if ARCH_BOARD_XMC4800RELAX

config ECAT
	bool "Enable EtherCAT interface"
	default y
	---help---
		Enable start up of the EtherCAT interface and configure ports.

endif
```

## boards/arm64/a64/pinephone/Kconfig
```kconfig
#
# For a description of the syntax of this configuration file,
# see the file kconfig-language.txt in the NuttX tools repository.
#

if ARCH_BOARD_PINEPHONE

config PINEPHONE_LCD
	bool "LCD Display"
	default n
	select A64_DE
	select A64_RSB
	select DRIVERS_VIDEO
	select VIDEO_FB
	select FB_OVERLAY
	select FB_UPDATE
	---help---
		Select to enable support for LCD Display.

config PINEPHONE_MODEM
	bool "LTE Modem"
	default n
	---help---
		Select to enable support for Quectel EG25-G LTE Modem.

endif # ARCH_BOARD_PINEPHONE
```

## boards/arm64/bcm2711/raspberrypi-4b/Kconfig
```kconfig
#
# For a description of the syntax of this configuration file,
# see the file kconfig-language.txt in the NuttX tools repository.
#

if ARCH_BOARD_RASPBERRYPI_4B

choice
	prompt "Raspberry Pi 4B RAM size"
	default RPI4B_RAM_4GB

config RPI4B_RAM_1GB
	bool "1GB RAM"
	---help---
		Support for the 1GB variant of the Raspberry Pi 4B.

config RPI4B_RAM_2GB
	bool "2GB RAM"
	---help---
		Support for the 2GB variant of the Raspberry Pi 4B.

config RPI4B_RAM_4GB
	bool "4GB RAM"
	---help---
		Support for the 4GB variant of the Raspberry Pi 4B.

config RPI4B_RAM_8GB
	bool "8GB RAM"
	---help---
		Support for the 8GB variant of the Raspberry Pi 4B.

endchoice # Raspberry Pi 4B RAM size

config RPI4B_DEBUG_BOOT
	bool "Raspberry Pi 4B bootloader debug output"
	default n
	---help---
		Enables the debug output of the Raspberry Pi 4B bootloader.

config RPI4B_SDMMC
	bool "Mount uSD as MMCSD device"
	depends on BCM2711_EMMC2
	default n
	---help---
		Mounts the uSD card as an MMCSD device.

config RPI4B_MOUNT_BOOT
	bool "Mount boot partition"
	depends on RPI4B_SDMMC
	depends on FS_FAT
	default n
	---help---
		Mounts the boot partition of the micro SD card to NuttX as a read/write
		file system.

config RPI4B_FRAMEBUFFER
	bool "Register frame buffer driver"
	depends on BCM2711_FRAMEBUFFER
	default BCM2711_FRAMEBUFFER
	---help---
		Registers a frame buffer character driver for graphical output.

endif # ARCH_BOARD_RASPBERRYPI_4B
```
