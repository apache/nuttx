## boards/arm/s32k1xx/rddrone-bms772/Kconfig
```kconfig
############################################################################
# boards/arm/s32k1xx/rddrone-bms772/Kconfig
#
# SPDX-License-Identifier: Apache-2.0
#
# Licensed to the Apache Software Foundation (ASF) under one or more
# contributor license agreements.  See the NOTICE file distributed with
# this work for additional information regarding copyright ownership.  The
# ASF licenses this file to you under the Apache License, Version 2.0 (the
# "License"); you may not use this file except in compliance with the
# License.  You may obtain a copy of the License at
#
#   http://www.apache.org/licenses/LICENSE-2.0
#
# Unless required by applicable law or agreed to in writing, software
# distributed under the License is distributed on an "AS IS" BASIS, WITHOUT
# WARRANTIES OR CONDITIONS OF ANY KIND, either express or implied.  See the
# License for the specific language governing permissions and limitations
# under the License.
#
############################################################################
#
# For a description of the syntax of this configuration file,
# see the file kconfig-language.txt in the NuttX tools repository.
#

if ARCH_BOARD_RDDRONE_BMS772

config S32K1XX_NRSTCHECK_PROCFS
	bool "RDDRONE-BMS772 nRST Check PROCFS entry"
	default n
	depends on FS_PROCFS
	select FS_PROCFS_REGISTER
	---help---
		Self-test to check that the MCU reset pin is connected to an
		external pull-up resistor (or an IC that pulls the pin high).
		The input logic level is registered as a PROCFS entry.

config SMBUS_SBD
	bool "SMBus Smart Battery Data slave"
	default n
	depends on I2C_SLAVE
	---help---
		Simple SMBus/I2C slave providing battery management data,
		specifically implementing a subset of the Smart Battery Data
		Specification, Revision 1.1

menu "RDDRONE-BMS772 PM configuration"
depends on PM

menu "PM configuration for PM_STANDBY mode"

choice
	prompt "MCU power mode during PM_STANDBY"
	default VLPR_STANDBY

config RUN_STANDBY
	bool "MCU in RUN mode during PM_STANDBY"
	---help---
		The MCU should remain in RUN mode during PM_STANDBY

config VLPR_STANDBY
	bool "MCU in VLPR mode during PM_STANDBY"
	---help---
		The MCU should enter VLPR (very low power run) mode during PM_STANDBY

endchoice # MCU power mode

menuconfig PM_SPI_STANDBY
	bool "Enable SPI in PM_STANDBY mode"
	default n
	depends on SPI
	---help---
		Enable PM configuration for SPI

if PM_SPI_STANDBY

config PM_SPI0_STANDBY
	bool "Enable LPSPI0 in PM_STANDBY mode"
	default n
	depends on S32K1XX_LPSPI0

config PM_SPI1_STANDBY
	bool "Enable LPSPI1 in PM_STANDBY mode"
	default n
	depends on S32K1XX_LPSPI1

endif # PM_SPI_STANDBY

menuconfig PM_SERIAL_STANDBY
	bool "Enable serial in PM_STANDBY mode"
	default n
	depends on SERIAL
	---help---
		Enable PM configuration for SERIAL

if PM_SERIAL_STANDBY

config PM_CONSOLE_STANDBY
	bool "Enable serial console in PM_STANDBY"
	default n
	depends on SERIAL_CONSOLE
	select PM_SERIAL0_STANDBY if LPUART0_SERIAL_CONSOLE
	select PM_SERIAL1_STANDBY if LPUART1_SERIAL_CONSOLE
	select PM_SERIAL2_STANDBY if LPUART2_SERIAL_CONSOLE

config PM_SERIAL0_STANDBY
	bool "Enable LPUART0 in PM_STANDBY mode"
	default n
	depends on S32K1XX_LPUART0

config PM_SERIAL1_STANDBY
	bool "Enable LPUART1 in PM_STANDBY mode"
	default n
	depends on S32K1XX_LPUART1

config PM_SERIAL2_STANDBY
	bool "Enable LPUART2 in PM_STANDBY mode"
	default n
	depends on S32K1XX_LPUART2

endif # PM_SERIAL_STANDBY

endmenu # PM configuration for PM_STANDBY mode

menu "PM configuration for PM_SLEEP mode"

choice
	prompt "MCU power mode during PM_SLEEP"
	default VLPR_SLEEP

config RUN_SLEEP
	bool "MCU in RUN mode during PM_SLEEP"
	---help---
		The MCU should remain in RUN mode during PM_SLEEP

config VLPR_SLEEP
	bool "MCU in VLPR mode during PM_STANDBY"
	---help---
		The MCU should enter VLPR (very low power run) mode during PM_SLEEP

endchoice # MCU power mode

menuconfig PM_SPI_SLEEP
	bool "Enable SPI in PM_SLEEP mode"
	default n
	depends on SPI
	---help---
		Enable PM configuration for SPI

if PM_SPI_SLEEP

menuconfig PM_SPI0_SLEEP
	bool "Enable LPSPI0 in PM_SLEEP"
	default n
	depends on S32K1XX_LPSPI0

menuconfig PM_SPI1_SLEEP
	bool "Enable LPSPI1 in PM_SLEEP"
	default n
	depends on S32K1XX_LPSPI1

endif # PM_SPI_SLEEP

menuconfig PM_SERIAL_SLEEP
	bool "Enable serial in PM_SLEEP mode"
	default n
	depends on SERIAL
	---help---
		Enable PM configuration for SERIAL

if PM_SERIAL_SLEEP

config PM_CONSOLE_SLEEP
	bool "Enable serial console in PM_SLEEP"
	default n
	depends on SERIAL_CONSOLE
	select PM_SERIAL0_SLEEP if LPUART0_SERIAL_CONSOLE
	select PM_SERIAL1_SLEEP if LPUART1_SERIAL_CONSOLE
	select PM_SERIAL2_SLEEP if LPUART2_SERIAL_CONSOLE

config PM_SERIAL0_SLEEP
	bool "Enable LPUART0 in PM_SLEEP mode"
	default n
	depends on S32K1XX_LPUART0

config PM_SERIAL1_SLEEP
	bool "Enable LPUART1 in PM_SLEEP mode"
	default n
	depends on S32K1XX_LPUART1

config PM_SERIAL2_SLEEP
	bool "Enable LPUART2 in PM_SLEEP mode"
	default n
	depends on S32K1XX_LPUART2

endif # PM_SERIAL_SLEEP

endmenu # PM configuration for PM_SLEEP mode

endmenu # RDDRONE-BMS772 PM configuration

endif # ARCH_BOARD_RDDRONE_BMS772
```

## boards/arm/stm32f1/stm3210e-eval/Kconfig
```kconfig
############################################################################
# boards/arm/stm32f1/stm3210e-eval/Kconfig
#
# SPDX-License-Identifier: Apache-2.0
#
# Licensed to the Apache Software Foundation (ASF) under one or more
# contributor license agreements.  See the NOTICE file distributed with
# this work for additional information regarding copyright ownership.  The
# ASF licenses this file to you under the Apache License, Version 2.0 (the
# "License"); you may not use this file except in compliance with the
# License.  You may obtain a copy of the License at
#
#   http://www.apache.org/licenses/LICENSE-2.0
#
# Unless required by applicable law or agreed to in writing, software
# distributed under the License is distributed on an "AS IS" BASIS, WITHOUT
# WARRANTIES OR CONDITIONS OF ANY KIND, either express or implied.  See the
# License for the specific language governing permissions and limitations
# under the License.
#
############################################################################
#
# For a description of the syntax of this configuration file,
# see the file kconfig-language.txt in the NuttX tools repository.
#

if ARCH_BOARD_STM3210E_EVAL
comment "STM3210E-EVAL LCD Hardware Configuration"

config STM3210E_LCD
	bool "Select support for the STM3210E-EVAL LCD"
	default n
	depends on STM32_FSMC
	select LCD
	---help---
		Enable support for the LCD on the STM3210E-EVAL board.  See additional,
		LCD-common settings in the drivers/lcd Kconfig file.

config STM3210E_LCD_BACKLIGHT
	bool "LCD backlight support"
	depends on STM3210E_LCD
	default n
	---help---
		Define to support a backlight.

config STM3210E_LCD_PWM
	bool "LCD backlight PWM control"
	default n
	depends on STM3210E_LCD_BACKLIGHT && STM32_TIM1
	---help---
		If STM32_TIM1 is also defined, then an adjustable backlight will be
		provided using timer 1 to generate various pulse widths.  The
		granularity of the settings is determined by LCD_MAXPOWER.  If STM3210E_LCD_PWM
		(or STM32_TIM1) is not defined, then a simple on/off backlight is
		provided.

config STM3210E_LCD_RDSHIFT
	int "LCD data shift"
	default 5
	depends on STM3210E_LCD
	---help---
		When reading 16-bit gram data, there appears to be a shift in the returned
		data.  This value fixes the offset.  Default 5.

config STM3210E_AM240320_DISABLE
	bool "Disable AM240320 support"
	default n
	depends on STM3210E_LCD
	---help---
		The LCD driver dynamically selects the LCD based on the reported LCD
		ID value.  However, code size can be reduced by suppressing support for
		individual LCDs using this option

config STM3210E_SPFD5408B_DISABLE
	bool "Disable SPFD5408B support"
	default n
	depends on STM3210E_LCD
	---help---
		The LCD driver dynamically selects the LCD based on the reported LCD
		ID value.  However, code size can be reduced by suppressing support for
		individual LCDs using this option

config STM3210E_R61580_DISABLE
	bool "Disable R61580 support"
	default n
	depends on STM3210E_LCD
	---help---
		The LCD driver dynamically selects the LCD based on the reported LCD
		ID value.  However, code size can be reduced by suppressing support for
		individual LCDs using this option

endif

config PM_BUTTONS
	bool "PM Button support"
	default n
	depends on PM && ARCH_IRQBUTTONS
	---help---
		Enable PM button EXTI interrupts to support PM testing

config PM_BUTTONS_MIN
	int "Minimum button number"
	default 0
	depends on PM_BUTTONS
	---help---
		The lowest button code to use for PM testing (see board.h)

config PM_BUTTONS_MAX
	int "Maximum button number"
	default 7
	depends on PM_BUTTONS
	---help---
		The highest button code to use for PM testing (see board.h)

config PM_IRQBUTTONS_MIN
	int "Minimum interrupting button number"
	default 0
	depends on PM_BUTTONS
	---help---
		The lowest interrupting button code to use for PM testing (see board.h)

config PM_IRQBUTTONS_MAX
	int "Maximum interrupting button number"
	default 7
	depends on PM_BUTTONS
	---help---
		The highest interrupting button code to use for PM testing (see board.h)

config PM_BUTTON_ACTIVITY
	int "Button PM activity weight"
	default 10
	depends on PM_BUTTONS
	---help---
		The activity weight to report to the power management subsystem when a button is pressed.

config PM_ALARM_SEC
	int "PM_STANDBY delay (seconds)"
	default 15
	depends on PM && RTC_ALARM
	---help---
		Number of seconds to wait in PM_STANDBY before going to PM_STANDBY mode.

config PM_ALARM_NSEC
	int "PM_STANDBY delay (nanoseconds)"
	default 0
	depends on PM && RTC_ALARM
	---help---
		Number of additional nanoseconds to wait in PM_STANDBY before going to PM_STANDBY mode.

config PM_SLEEP_WAKEUP
	bool "PM_SLEEP wake-up alarm"
	default n
	depends on PM && RTC_ALARM
	---help---
		Wake-up of PM_SLEEP mode after a delay and resume normal operation.

config PM_SLEEP_WAKEUP_SEC
	int "PM_SLEEP delay (seconds)"
	default 10
	depends on PM && RTC_ALARM
	---help---
		Number of seconds to wait in PM_SLEEP before going to PM_STANDBY mode.

config PM_SLEEP_WAKEUP_NSEC
	int "PM_SLEEP delay (nanoseconds)"
	default 0
	depends on PM && RTC_ALARM
	---help---
		Number of additional nanoseconds to wait in PM_SLEEP before going to PM_STANDBY mode.
```
