## boards/arm/imxrt/teensy-4.x/Kconfig
```kconfig
#
# For a description of the syntax of this configuration file,
# see the file kconfig-language.txt in the NuttX tools repository.
#

if ARCH_BOARD_TEENSY_4X
choice
	prompt "Boot Flash"
	default TEENSY4_QSPI_FLASH

config TEENSY4_QSPI_FLASH
	bool "QSPI Flash"

endchoice # Boot Flash

choice
	prompt "Board configuration"

config TEENSY_40
	bool "Teensy 4.0"

config TEENSY_41
	bool "Teensy 4.1"

endchoice # Board configuration

config IMXRT_FLEXCAN3_AS_CAN0
	bool "Initialize CAN3 bus as can0"
	---help---
		This configuration option ensures that if more that one CAN bus is set on
		that CAN 3 (with FD capability) will be initialized as can0.

config NET_USE_OTP_ETHERNET_MAC
	bool "Use Ethernet MAC address stored in OCOTP_MAC0 and OCOTP_MAC1"
	---help---
		The teensy 4.1 board has an "offical" unique MAC address stored in OCOTP (One-Time-Programmable) memory.
		When enabling this option, it is read and used when the ethernet peripheral is initialized.
		If so, the 'ifconfig  eth0' HWaddr should start with 04:e9:e5:...
		(the vendor ID of 'PJRC.COM, LLC') when this feature is enabled.
		It may also be used with other boards that have the OCOTP programmed with a valid MAC.

endif
```

## boards/arm/kinetis/freedom-k28f/Kconfig
```kconfig
#
# For a description of the syntax of this configuration file,
# see the file kconfig-language.txt in the NuttX tools repository.
#

if ARCH_BOARD_FREEDOM_K28F

config FRDMK28F_SDHC_AUTOMOUNT
	bool "SDHC automounter"
	default n
	depends on FS_AUTOMOUNTER && KINETIS_SDHC

if FRDMK28F_SDHC_AUTOMOUNT

config FRDMK28F_SDHC_AUTOMOUNT_FSTYPE
	string "SDHC file system type"
	default "vfat"

config FRDMK28F_SDHC_AUTOMOUNT_BLKDEV
	string "SDHC block device"
	default "/dev/mmcsd0"

config FRDMK28F_SDHC_AUTOMOUNT_MOUNTPOINT
	string "SDHC mount point"
	default "/mnt/sdcard"

config FRDMK28F_SDHC_AUTOMOUNT_DDELAY
	int "SDHC debounce delay (milliseconds)"
	default 1000

config FRDMK28F_SDHC_AUTOMOUNT_UDELAY
	int "SDHC unmount retry delay (milliseconds)"
	default 2000

endif # FRDMK28F_SDHC_AUTOMOUNT

config FRDMK28F_USB_AUTOMOUNT
	bool "USB Mass Storage automounter"
	default n
	depends on USBHOST_MSC && USBHOST_MSC_NOTIFIER

if FRDMK28F_USB_AUTOMOUNT

config FRDMK28F_USB_AUTOMOUNT_FSTYPE
	string "USB file system type"
	default "vfat"

config FRDMK28F_USB_AUTOMOUNT_BLKDEV
	string "USB block device prefix"
	default "/dev/sd"

config FRDMK28F_USB_AUTOMOUNT_MOUNTPOINT
	string "USB mount point prefix"
	default "/mnt/usb"

config FRDMK28F_USB_AUTOMOUNT_NUM_BLKDEV
	int "Number of block devices to monitor."
	range 1 26
	default 4

config FRDMK28F_USB_AUTOMOUNT_UDELAY
	int "USB unmount retry delay (milliseconds)"
	default 2000
	
endif # FRDMK28F_USB_AUTOMOUNT
endif # ARCH_BOARD_FREEDOM_K28F
```

## boards/arm/kinetis/freedom-k66f/Kconfig
```kconfig
#
# For a description of the syntax of this configuration file,
# see the file kconfig-language.txt in the NuttX tools repository.
#

if ARCH_BOARD_FREEDOM_K66F

config FRDMK66F_SDHC_AUTOMOUNT
	bool "SDHC automounter"
	default n
	depends on FS_AUTOMOUNTER && KINETIS_SDHC

if FRDMK66F_SDHC_AUTOMOUNT

config FRDMK66F_SDHC_AUTOMOUNT_FSTYPE
	string "SDHC file system type"
	default "vfat"

config FRDMK66F_SDHC_AUTOMOUNT_BLKDEV
	string "SDHC block device"
	default "/dev/mmcsd0"

config FRDMK66F_SDHC_AUTOMOUNT_MOUNTPOINT
	string "SDHC mount point"
	default "/mnt/sdcard"

config FRDMK66F_SDHC_AUTOMOUNT_DDELAY
	int "SDHC debounce delay (milliseconds)"
	default 1000

config FRDMK66F_SDHC_AUTOMOUNT_UDELAY
	int "SDHC unmount retry delay (milliseconds)"
	default 2000

endif # FRDMK66F_SDHC_AUTOMOUNT
endif # ARCH_BOARD_FREEDOM_K66F
```

## boards/arm/kinetis/twr-k64f120m/Kconfig
```kconfig
#
# For a description of the syntax of this configuration file,
# see the file kconfig-language.txt in the NuttX tools repository.
#

if ARCH_BOARD_TWR_K64F120M

config TWR_K64F120M_SDHC_AUTOMOUNT
	bool "SDHC automounter"
	default n
	depends on FS_AUTOMOUNTER && KINETIS_SDHC

if TWR_K64F120M_SDHC_AUTOMOUNT

config TWR_K64F120M_SDHC_AUTOMOUNT_FSTYPE
	string "SDHC file system type"
	default "vfat"

config TWR_K64F120M_SDHC_AUTOMOUNT_BLKDEV
	string "SDHC block device"
	default "/dev/mmcsd0"

config TWR_K64F120M_SDHC_AUTOMOUNT_MOUNTPOINT
	string "SDHC mount point"
	default "/mnt/sdcard"

config TWR_K64F120M_SDHC_AUTOMOUNT_DDELAY
	int "SDHC debounce delay (milliseconds)"
	default 1000

config TWR_K64F120M_SDHC_AUTOMOUNT_UDELAY
	int "SDHC unmount retry delay (milliseconds)"
	default 2000

endif # TWR_K64F120M_SDHC_AUTOMOUNT
endif # ARCH_BOARD_TWR_K64F120M
```
