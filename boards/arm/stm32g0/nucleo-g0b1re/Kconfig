## boards/arm/stm32h5/nucleo-h563zi/Kconfig
```kconfig
#
# For a description of the syntax of this configuration file,
# see the file kconfig-language.txt in the NuttX tools repository.
#

if ARCH_BOARD_NUCLEO_H563ZI

config STM32H5_USE_HSE
	bool "Use on-board HSE"
	default n
	---help---
		Use the supplied on-board 25 MHz HSE. If selected, board.h must supply
		appropriate clock setup. Requires board modification: 
			- SB3 and SB4 ON
			- SB49 OFF
			- SB48 and SB50 OFF (Default)
			- C69 and C70 ON, 5.6 pF (Default)
		
endif
```

## boards/arm/stm32h7/h747ai/Kconfig
```kconfig
#
# For a description of the syntax of this configuration file,
# see the file kconfig-language.txt in the NuttX tools repository.
#

if ARCH_BOARD_H747AI

choice
	prompt "Nucleo H747AI SMPS/LDO configuration"
	default H747AI_SMPS

config H747AI_SMPS
	bool "Internal SMPS only (default)"
	select STM32H7_PWR_DIRECT_SMPS_SUPPLY

config H747AI_LDO
	bool "Internal LDO only"

config H747AI_SMPS_LDO
	bool "Internal SMPS and LDO cascaded (not supported)"

config H747AI_BYPASS
	bool "Bypass (not supported)"

endchoice

endif # ARCH_BOARD_H747AI
```

## boards/arm/stm32h7/nucleo-h743zi/Kconfig
```kconfig
#
# For a description of the syntax of this configuration file,
# see the file kconfig-language.txt in the NuttX tools repository.
#

if ARCH_BOARD_NUCLEO_H743ZI

config STM32_ROMFS
	bool "Automount baked-in ROMFS image"
	default n
	depends on FS_ROMFS
	---help---
		Select STM32_ROMFS_IMAGEFILE, STM32_ROMFS_DEV_MINOR, STM32_ROMFS_MOUNTPOINT

config STM32_ROMFS_DEV_MINOR
	int "Minor for the block device backing the data"
	depends on STM32_ROMFS
	default 64

config STM32_ROMFS_MOUNTPOINT
	string "Mountpoint of the custom romfs image"
	depends on STM32_ROMFS
	default "/rom"

config STM32_ROMFS_IMAGEFILE
	string "ROMFS image file to include into build"
	depends on STM32_ROMFS
	default "../../../rom.img"

endif # ARCH_BOARD_NUCLEO_H743ZI
```

## boards/arm/stm32h7/nucleo-h743zi2/Kconfig
```kconfig
#
# For a description of the syntax of this configuration file,
# see the file kconfig-language.txt in the NuttX tools repository.
#

if ARCH_BOARD_NUCLEO_H743ZI2

config H743ZI2_WDG
	bool

config H743ZI2_IWDG
	bool "IWDG kicker support"
	depends on STM32H7_IWDG
	depends on WATCHDOG
	select H743ZI2_WDG

config H743ZI2_IWDG_TIMEOUT
	int "IWDG Timeout (ms)"
	default 32000
	depends on H743ZI2_IWDG
	---help---
		Watchdog timeout value in milliseconds.

if H743ZI2_WDG
config H743ZI2_WDG_THREAD
	bool "Watchdog Daemon Thread"

if H743ZI2_WDG_THREAD
config H743ZI2_WDG_THREAD_NAME
	string "Watchdog Thread Name"
	default "wdog"

config H743ZI2_WDG_DEVPATH
	string "Watchdog Thread Name"
	default "/dev/watchdog0"

config H743ZI2_WDG_THREAD_INTERVAL
	int "Watchdog Thread Interval (ms)"
	default 2500

config H743ZI2_WDG_THREAD_PRIORITY
	int "Watchdog Thread Priority"
	default 200

config H743ZI2_WDG_THREAD_STACKSIZE
	int "Watchdog Thread Stacksize"
	default 1024

endif # H743ZI2_WDG_THREAD
endif # H743ZI2_WDG

endif # ARCH_BOARD_NUCLEO_H743ZI2
```

## boards/arm/stm32h7/nucleo-h745zi/Kconfig
```kconfig
#
# For a description of the syntax of this configuration file,
# see the file kconfig-language.txt in the NuttX tools repository.
#

if ARCH_BOARD_NUCLEO_H745ZI

choice
	prompt "Nucleo H745ZI SMPS/LDO configuration"
	default NUCLEOH745ZI_SMPS

config NUCLEOH745ZI_SMPS
	bool "Internal SMPS only (default)"
	select STM32H7_PWR_DIRECT_SMPS_SUPPLY

config NUCLEOH745ZI_LDO
	bool "Internal LDO only"

config NUCLEOH745ZI_SMPS_LDO
	bool "Internal SMPS and LDO cascaded (not supported)"

config NUCLEOH745ZI_BYPASS
	bool "Bypass (not supported)"

endchoice

endif # ARCH_BOARD_NUCLEO_H745ZI
```
