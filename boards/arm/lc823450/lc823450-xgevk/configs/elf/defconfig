## boards/arm/lpc17xx_40xx/lpc4088-devkit/Kconfig
```kconfig
#
# For a description of the syntax of this configuration file,
# see the file kconfig-language.txt in the NuttX tools repository.
#

if ARCH_BOARD_LPC4088_DEVKIT

config LPC4088_DEVKIT_DJOYSTICK
	bool "Discrete Joystick Support"
	default n
	depends on !ARCH_BUTTONS && INPUT_DJOYSTICK

config LPC4088_DEVKIT_DJOYDEV
	string "Joystick Device"
	default "/dev/djoy0"
	depends on LPC4088_DEVKIT_DJOYSTICK

endif
```

## boards/arm/lpc17xx_40xx/lx_cpu/Kconfig
```kconfig
#
# For a description of the syntax of this configuration file,
# see the file kconfig-language.txt in the NuttX tools repository.
#

if ARCH_BOARD_LX_CPU

choice
	prompt "LX_CPU ode and boot memory selection"
	default LX_CPU_BOOT_APP
	depends on ARCH_BOARD_LX_CPU
	---help---
		Select where NuttX code/text is stored and how it is started.
		Select "Code in internal FLASH - no loader used" (LX_CPU_BOOT_FLASH_BOOT)
		if the code should be placed directly in start of the internal
		FLASH memory and start directly after MCU reset. If there is
		bool loader then NuttX can be placed into internal FLASH after
		the loader - "Code in internal FLASH - loader used" (LX_CPU_BOOT_FLASH_APP)
		or it can be loaded into external SDRAM and start from there.

config LX_CPU_BOOT_FLASH_APP
	bool "Code in internal FLASH - loader used"

config LX_CPU_BOOT_FLASH_BOOT
	bool "Code in internal FLASH - no loader used"

config LX_CPU_BOOT_SDRAM
	bool "Code in external SDRAM"

endchoice # LX_CPU ode and boot memory selection

endif
```

## boards/arm/lpc17xx_40xx/olimex-lpc1766stk/Kconfig
```kconfig
#
# For a description of the syntax of this configuration file,
# see the file kconfig-language.txt in the NuttX tools repository.
#

if ARCH_BOARD_LPC1766STK

config LPC1766STK_USBHOST_STACKSIZE
	int "USB host waiter stack size"
	default DEFAULT_TASK_STACKSIZE
	depends on USBHOST

config LPC1766STK_USBHOST_PRIO
	int "USB host waiter task priority"
	default 100
	depends on USBHOST

endif
```

## boards/arm/lpc17xx_40xx/open1788/Kconfig
```kconfig
#
# For a description of the syntax of this configuration file,
# see the file kconfig-language.txt in the NuttX tools repository.
#

if ARCH_BOARD_OPEN1788

config OPEN1788_DJOYSTICK
	bool "Discrete Joystick Support"
	default n
	depends on !ARCH_BUTTONS && DJOYSTICK

config OPEN1788_DJOYDEV
	string "Joystick Device"
	default "/dev/djoy0"
	depends on OPEN1788_DJOYSTICK

endif
```
