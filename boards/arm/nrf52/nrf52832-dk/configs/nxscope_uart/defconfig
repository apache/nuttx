## boards/arm/nrf52/nrf52840-dk/Kconfig
```kconfig
#
# For a description of the syntax of this configuration file,
# see the file kconfig-language.txt in the NuttX tools repository.
#

if ARCH_BOARD_NRF52840_DK

config NRF52840DK_HIGHPRI
	bool "High priority interrupt test"
	default n

config NRF52840DK_BTNLEDS_GPIO
	bool "Export board LEDS and BUTTONS as GPIO"
	default n
	depends on !ARCH_LEDS && !ARCH_BUTTONS && GPIO_LOWER_HALF && DEV_GPIO
	---help---
		Export board LEDS and buttons as GPIOs.

endif
```

## boards/arm/nrf53/common/Kconfig
```kconfig
#
# For a description of the syntax of this configuration file,
# see the file kconfig-language.txt in the NuttX tools repository.
#

config NRF53_HAVE_OTA_PARTITION
	bool
	default n

menu "Application Image Configuration"

choice
	prompt "Application Image Format"
	default NRF53_APP_FORMAT_LEGACY

config NRF53_APP_FORMAT_LEGACY
	bool "Legacy format"
	---help---
		This is the legacy application image format.

config NRF53_APP_FORMAT_MCUBOOT
	bool "MCUboot-bootable format"
	select NRF53_HAVE_OTA_PARTITION
	---help---
		The MCUboot support of loading the firmware images.

endchoice # Application Image Format

config NRF53_PROGMEM_OTA_PARTITION
	bool "MTD driver"
	default n
	depends on NRF53_HAVE_OTA_PARTITION
	select BCH
	select MTD
	select MTD_BYTE_WRITE
	select MTD_PARTITION
	select MTD_PROGMEM
	select NRF53_PROGMEM
	---help---
		Initialize an MTD driver for the Flash, which will
		add an entry at /dev for application access from userspace.

if NRF53_PROGMEM_OTA_PARTITION

config NRF53_MCUBOOT_HAVE_SCRACH
	bool "Scratch partition support"
	default n

config NRF53_MCUBOOT_HEADER_SIZE
	hex
	default 0x200
	depends on NRF53_APP_FORMAT_MCUBOOT

config NRF53_OTA_PRIMARY_SLOT_DEVPATH
	string "Application image primary slot device path"
	default "/dev/ota0"

config NRF53_OTA_SECONDARY_SLOT_DEVPATH
	string "Application image secondary slot device path"
	default "/dev/ota1"

config NRF53_OTA_PRIMARY_SLOT_OFFSET
	hex "MCUboot application image primary slot offset"
	default "0x10000"

config NRF53_OTA_SECONDARY_SLOT_OFFSET
	hex "MCUboot application image secondary slot offset"
	default "0x80000"

config NRF53_OTA_SLOT_SIZE
	hex "MCUboot application image slot size (in bytes)"
	default "0x70000"

if NRF53_MCUBOOT_HAVE_SCRACH

config NRF53_OTA_SCRATCH_DEVPATH
	string "Scratch partition device path"
	default "/dev/otascratch"

config NRF53_OTA_SCRATCH_OFFSET
	hex "MCUboot scratch partition offset"
	default "0xf0000"

config NRF53_OTA_SCRATCH_SIZE
	hex "MCUboot scratch partition size (in bytes)"
	default "0x10000"

endif # NRF53_MCUBOOT_HAVE_SCRACH

endif # NRF53_PROGMEM_OTA_PARTITION

endmenu # Application Image Configuration
```

## boards/arm/nrf91/common/Kconfig
```kconfig
#
# For a description of the syntax of this configuration file,
# see the file kconfig-language.txt in the NuttX tools repository.
#

config NRF91_HAVE_OTA_PARTITION
	bool
	default n

menu "Application Image Configuration"

choice
	prompt "Application Image Format"
	default NRF91_APP_FORMAT_LEGACY

config NRF91_APP_FORMAT_LEGACY
	bool "Legacy format"
	---help---
		This is the legacy application image format.

config NRF91_APP_FORMAT_MCUBOOT
	bool "MCUboot-bootable format"
	select NRF91_HAVE_OTA_PARTITION
	---help---
		The MCUboot support of loading the firmware images.

endchoice # Application Image Format

config NRF91_NONSECURE_BOOT
	bool "Non-secure image boot"
	default n
	---help---
		Boot the application as non-secure code.

config NRF91_PROGMEM_OTA_PARTITION
	bool "MTD driver"
	default n
	depends on NRF91_HAVE_OTA_PARTITION
	select BCH
	select MTD
	select MTD_BYTE_WRITE
	select MTD_PARTITION
	select MTD_PROGMEM
	select NRF91_PROGMEM
	---help---
		Initialize an MTD driver for the Flash, which will
		add an entry at /dev for application access from userspace.

if NRF91_PROGMEM_OTA_PARTITION

config NRF91_MCUBOOT_HAVE_SCRACH
	bool "Scratch partition support"
	default n

config NRF91_MCUBOOT_HEADER_SIZE
	hex
	default 0x200
	depends on NRF91_APP_FORMAT_MCUBOOT

config NRF91_OTA_PRIMARY_SLOT_DEVPATH
	string "Application image primary slot device path"
	default "/dev/ota0"

config NRF91_OTA_SECONDARY_SLOT_DEVPATH
	string "Application image secondary slot device path"
	default "/dev/ota1"

config NRF91_OTA_PRIMARY_SLOT_OFFSET
	hex "MCUboot application image primary slot offset"
	default "0x10000"

config NRF91_OTA_SECONDARY_SLOT_OFFSET
	hex "MCUboot application image secondary slot offset"
	default "0x80000"

config NRF91_OTA_SLOT_SIZE
	hex "MCUboot application image slot size (in bytes)"
	default "0x70000"

if NRF91_MCUBOOT_HAVE_SCRACH

config NRF91_OTA_SCRATCH_DEVPATH
	string "Scratch partition device path"
	default "/dev/otascratch"

config NRF91_OTA_SCRATCH_OFFSET
	hex "MCUboot scratch partition offset"
	default "0xf0000"

config NRF91_OTA_SCRATCH_SIZE
	hex "MCUboot scratch partition size (in bytes)"
	default "0x10000"

endif # NRF91_MCUBOOT_HAVE_SCRACH

endif # NRF91_PROGMEM_OTA_PARTITION

endmenu # Application Image Configuration
```
