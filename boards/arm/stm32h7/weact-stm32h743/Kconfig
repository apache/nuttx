## boards/avr/avrdx/breadxavr/Kconfig
```kconfig
#
# For a description of the syntax of this configuration file,
# see the file kconfig-language.txt in the NuttX tools repository.
#

if ARCH_BOARD_AVRDX_BREADXAVR

config BREADXAVR_BUTTONS_DRIVER
	bool "Enable button input driver for GPIO pins"
	depends on INPUT_BUTTONS && INPUT_BUTTONS_LOWER && BOARD_EARLY_INITIALIZE && AVR_AVRDX_GPIO_ISR_MUX
	default n
	---help---
		If set, button driver registered as /dev/buttons
		for PORT A and PORT C (pins 2 and 3 for both ports.)

config BREADXAVR_WS2812_DRIVER
	bool "Register default names for WS2812 LEDs"
	depends on AVR_AVRDX_DRIVER_WS2812
	default n
	---help---
		If set, all WS2812 lower-half drivers that use builtin
		peripherals will have their LED device(s) enabled automatically.

		For USART drivers, LED chains will be registered as /dev/ledUSARTx
		with "x" replaced by the index of the peripheral.

endif
```
