## boards/arm/stm32f1/stm32f103-minimum/Kconfig
```kconfig
#
# For a description of the syntax of this configuration file,
# see the file kconfig-language.txt in the NuttX tools repository.
#

if ARCH_BOARD_STM32F103_MINIMUM

choice
	prompt "Board type"
	default STM32F103MINIMUM_BLUEPILL

config STM32F103MINIMUM_BLUEPILL
	bool "Blue Pill/Red Pill/RoboDyn Black Pill"

config STM32F103MINIMUM_BLACKPILL
	bool "Black Pill"

endchoice

config STM32F103MINIMUM_AT24_BLOCKMOUNT
	bool "AT24 Serial EEPROM auto-mount"
	default n
	depends on BOARD_LATE_INITIALIZE && STM32_I2C1 && MTD_AT24XX
	---help---
		Automatically initialize the AT24 I2C EEPROM driver when NSH starts.

choice
	prompt "AT24 serial EPPROM configuration"
	default STM32F103MINIMUM_AT24_FTL
	depends on STM32F103MINIMUM_AT24_BLOCKMOUNT

config STM32F103MINIMUM_AT24_FTL
	bool "Create AT24 block driver"
	---help---
		Create the MTD driver for the AT24 and "wrap" the AT24 as a standard
		block driver that could then, for example, be mounted using FAT or
		any other file system.  Any file system may be used, but there will
		be no wear-leveling.

config STM32F103MINIMUM_AT24_NXFFS
	bool "Create AT24 NXFFS file system"
	depends on FS_NXFFS
	---help---
		Create the MTD driver for the AT24 and mount the AT24 device as
		a wear-leveling, NuttX FLASH file system (NXFFS).  The downside of
		NXFFS is that it can be very slow.

endchoice # AT24 serial EPPROM configuration

config STM32F103MINIMUM_FLASH
	bool "MTD driver for external 4Mbyte W25Q32FV FLASH on SPI1"
	default n
	select MTD
	select MTD_W25
	select MTD_SMART
	select FS_SMARTFS
	select STM32_SPI1
	select MTD_BYTE_WRITE
	---help---
		Configures an MTD device for use with the onboard flash

config STM32F103MINIMUM_FLASH_MINOR
	int "Minor number for the FLASH /dev/smart entry"
	default 0
	depends on STM32F103MINIMUM_FLASH
	---help---
		Sets the minor number for the FLASH MTD /dev entry

config STM32F103MINIMUM_FLASH_PART
	bool "Enable partition support on FLASH"
	default y
	depends on STM32F103MINIMUM_FLASH
	select MTD_PARTITION
	---help---
		Enables creation of partitions on the FLASH

config STM32F103MINIMUM_FLASH_CONFIG_PART
	bool "Create application config data partition on FLASH"
	default n
	depends on STM32F103MINIMUM_FLASH_PART
	depends on PLATFORM_CONFIGDATA
	---help---
		Enables creation of a /dev/config partition on the FLASH

config STM32F103MINIMUM_FLASH_CONFIG_PART_NUMBER
	int "Index number of config partition (in list below)"
	default 0
	depends on STM32F103MINIMUM_FLASH_CONFIG_PART
	---help---
		Specifies the index number of the config data partition
		from the partition list.

config STM32F103MINIMUM_FLASH_PART_LIST
	string "Flash partition size list"
	default "1024,1024,1024,1024"
	depends on STM32F103MINIMUM_FLASH_PART
	---help---
		Comma separated list of partition sizes in KB.

config STM32F103MINIMUM_FLASH_PART_NAMES
	string "Flash partition name list"
	default "first,second,third,forth"
	depends on STM32F103MINIMUM_FLASH_PART
	depends on MTD_PARTITION_NAMES
	---help---
		Comma separated list of partition names.

config STM32F103MINIMUM_QETIMER
	int "Timer to use with QE encoder"
	default 4
	depends on SENSORS_QENCODER

if USBHOST_MAX3421E

config STM32F103MINIMUM_MAX3421E_FREQUENCY
	int "MAX3421E SPI frequency"
	default 4500000
	range 400000 26000000
	---help---
		SPI1 clock used to talk to the MAX3421E.  The STM32 SPI1 divides
		PCLK2 (72MHz) by a power of two, so the real clock is the nearest
		lower value (e.g. 4.5MHz, 9MHz, 18MHz).

config STM32F103MINIMUM_MAX3421E_RST
	bool "MAX3421E reset pin driven by PB9"
	default y
	---help---
		Drive the MAX3421E RES# pin from PB9.  Disable this if RES# is tied
		to 3.3V; PB9 is then left untouched.

config STM32F103MINIMUM_MAX3421E_CONNMON_STACKSIZE
	int "MAX3421E USB connection monitor stack size"
	default DEFAULT_TASK_STACKSIZE

config STM32F103MINIMUM_MAX3421E_CONNMON_PRIORITY
	int "MAX3421E USB connection monitor priority"
	default 100
	range 1 255

endif # USBHOST_MAX3421E

endif
```

## boards/arm/stm32h7/nucleo-h7s3l8/Kconfig
```kconfig
#
# For a description of the syntax of this configuration file,
# see the file kconfig-language.txt in the NuttX tools repository.
#

if ARCH_BOARD_NUCLEO_H7S3L8

config NUCLEO_H7S3L8_USE_HSE
	bool "Use the HSE clock source"
	default n
	help
		Use the 24 MHz external clock supplied to the HSE input.

config NUCLEO_H7S3L8_XIP
	bool "Run from external XSPI2 flash"
	default n
	select STM32_BYPASS_CLOCKCONFIG
	help
		Link NuttX for execution from the board's MX25UW25645G flash at
		0x70000000.  The internal flash must contain a loader which
		initializes XSPI2 before transferring control to NuttX.

config NUCLEO_H7S3L8_XIP_BOOTLOADER
	bool "Boot an external XIP image"
	default n
	depends on STM32_XSPI && MTD_MX25UW25645G
	help
		Build a NuttX bootloader in internal flash.  It initializes the
		MX25UW25645G flash in memory-mapped mode and starts a raw Arm image
		linked at 0x70000000.  Image selection, update and integrity checking
		are not provided.

endif # ARCH_BOARD_NUCLEO_H7S3L8
```

## boards/arm/stm32h7/stm32h7s8-dk/Kconfig
```kconfig
#
# For a description of the syntax of this configuration file,
# see the file kconfig-language.txt in the NuttX tools repository.
#

if ARCH_BOARD_STM32H7S8_DK

config STM32H7S8_DK_USE_HSE
	bool "Use the HSE clock source"
	default n
	help
		Use the 24 MHz external clock supplied to the HSE input.

config STM32H7S8_DK_XIP
	bool "Run from external XSPI2 flash"
	default n
	select STM32_BYPASS_CLOCKCONFIG
	help
		Link NuttX for execution from the board's MX66UW1G45G flash at
		0x70000000.  The internal flash must contain a loader which
		initializes XSPI2 before transferring control to NuttX.

config STM32H7S8_DK_XIP_BOOTLOADER
	bool "Boot an external XIP image"
	default n
	depends on STM32_XSPI && MTD_MX66UW1G45G
	help
		Build a NuttX bootloader in internal flash.  It initializes the
		MX66UW1G45G flash in memory-mapped mode and starts a raw Arm image
		linked at 0x70000000.  Image selection, update and integrity checking
		are not provided.

config STM32H7S8_DK_XIP_BOOTLOADER_BANNER
	default n
	bool "Display identifying banner during bootloader startup"
	depends on STM32H7S8_DK_XIP_BOOTLOADER
	help
		If enabled display UTS name information during bootloader
		startup including release, version, machine and board name.

endif # ARCH_BOARD_STM32H7S8_DK
```
