## boards/arm/stm32f3/nucleo-f302r8/Kconfig
```kconfig
#
# For a description of the syntax of this configuration file,
# see the file kconfig-language.txt in the NuttX tools repository.
#

if ARCH_BOARD_NUCLEO_F302R8

config NUCLEOF302R8_HIGHPRI
	bool "High priority interrupt test"
	default n

config NUCLEOF302R8_RS485_WAVESHARE
	bool "Map USART1 pins to match RS485 CAN Waveshare shield"
	default n

if SENSORS_QENCODER

config NUCLEO_F302R8_QETIMER
	int "Timer to use with QE encoder"
	default 2

endif # SENSORS_QENCODER

endif
```

## boards/arm/stm32f3/nucleo-f334r8/Kconfig
```kconfig
#
# For a description of the syntax of this configuration file,
# see the file kconfig-language.txt in the NuttX tools repository.
#

if ARCH_BOARD_NUCLEO_F334R8

config NUCLEOF334R8_HIGHPRI
	bool "High priority interrupt test"
	default n

menuconfig NUCLEOF334R8_SPWM
	bool "Sinusoidal PWM generator example"
	default n

if NUCLEOF334R8_SPWM

choice
	prompt "Sinusoidal PWM source"
	default NUCLEOF334R8_SPWM_USE_TIM1

config NUCLEOF334R8_SPWM_USE_TIM1
	bool "Use TIM1 as PWM source"

config NUCLEOF334R8_SPWM_USE_HRTIM1
	bool "Use HRTIM as PWM source"

endchoice

config NUCLEOF334R8_SPWM_PWM_FREQ
	int "PWM frequency in Hz"
	default 100000

config NUCLEOF334R8_SPWM_SAMPLES
	int "Sine samples"
	default 100

config NUCLEOF334R8_SPWM_FREQ
	int "Waveform frequency in Hz"
	default 60

config NUCLEOF334R8_SPWM_PHASE_NUM
	int "Number of phases"
	default 1
	range 1 5 if NUCLEOF334R8_SPWM_USE_HRTIM1
	range 1 4 if NUCLEOF334R8_SPWM_USE_TIM1

endif

endif
```

## boards/arm/stm32f4/clicker2-stm32/Kconfig
```kconfig
#
# For a description of the syntax of this configuration file,
# see the file kconfig-language.txt in the NuttX tools repository.
#

if ARCH_BOARD_CLICKER2_STM32

config CLICKER2_STM32_MB1_SPI
	bool "mikroBUS1 SPI"
	default n
	select STM32_SPI3
	---help---
		Enable SPI support on mikroBUS1 (STM32 SPI3)

config CLICKER2_STM32_MB2_SPI
	bool "mikroBUS2 SPI"
	default n
	select STM32_SPI2
	---help---
		Enable SPI support on mikroBUS1 (STM32 SPI2)

config CLICKER2_STM32_MB1_BEE
	bool "mikroBUS1 MRF24J40 BEE"
	default y
	depends on IEEE802154_MRF24J40
	select CLICKER2_STM32_MB1_SPI
	---help---
		Enable support for MRF24J40 BEE on mikroBUS1

config CLICKER2_STM32_MB2_BEE
	bool "mikroBUS2 MRF24J40 BEE"
	default n
	depends on IEEE802154_MRF24J40
	select CLICKER2_STM32_MB2_SPI
	---help---
		Enable support for MRF24J40 BEE on mikroBUS2

config CLICKER2_STM32_MRF24J40LH_VERBOSE
	bool "Verbose MRF24J40 lowerhalf"
	default n
	depends on IEEE802154_MRF24J40 && DEBUG_WIRELESS_INFO
	---help---
		Enable verbose syslog for MRF24J40 lowerhalf

config CLICKER2_STM32_MB1_XBEE
	bool "mikroBUS1 XBee radio"
	default n
	depends on IEEE802154_XBEE
	select CLICKER2_STM32_MB1_SPI
	---help---
		Enable support for XBee radio on mikroBUS1

config CLICKER2_STM32_MB2_XBEE
	bool "mikroBUS2 XBee radio"
	default n
	depends on IEEE802154_XBEE
	select CLICKER2_STM32_MB2_SPI
	---help---
		Enable support for XBee on mikroBUS2

config CLICKER2_STM32_XBEELH_VERBOSE
	bool "Verbose XBee lowerhalf"
	default n
	depends on IEEE802154_XBEE && DEBUG_WIRELESS_INFO
	---help---
		Enable verbose syslog for XBee lowerhalf

config CLICKER2_STM32_MB1_MMCSD
	bool "mikroBUS1 uSD Card Click board"
	default n
	select CLICKER2_STM32_MB1_SPI
	---help---
		Enable support for uSD click on mikroBUS1

config CLICKER2_STM32_MB2_MMCSD
	bool "mikroBUS2 uSD Card Click board"
	default n
	select CLICKER2_STM32_MB2_SPI
	---help---
		Enable support for uSD click on mikroBUS2

if FS_AUTOMOUNTER
if CLICKER2_STM32_MB1_MMCSD

config CLICKER2_STM32_MB1_MMCSD_AUTOMOUNT
	bool "MB1 MMCSD automounter"
	default n

if CLICKER2_STM32_MB1_MMCSD_AUTOMOUNT

config CLICKER2_STM32_MB1_MMCSD_AUTOMOUNT_FSTYPE
	string "MB1 MMCSD file system type"
	default "vfat"

config CLICKER2_STM32_MB1_MMCSD_AUTOMOUNT_BLKDEV
	string "MB1 MMCSD block device"
	default "/dev/mmcsd0"

config CLICKER2_STM32_MB1_MMCSD_AUTOMOUNT_MOUNTPOINT
	string "MB1 MMCSD mount point"
	default "/mnt/sdcard0"

config CLICKER2_STM32_MB1_MMCSD_AUTOMOUNT_DDELAY
	int "MB1 MMCSD debounce delay (milliseconds)"
	default 1000

config CLICKER2_STM32_MB1_MMCSD_AUTOMOUNT_UDELAY
	int "MB1 MMCSD unmount retry delay (milliseconds)"
	default 2000

endif # CLICKER2_STM32_MB1_MMCSD_AUTOMOUNT
endif # CLICKER2_STM32_MB1_MMCSD

if CLICKER2_STM32_MB2_MMCSD

config CLICKER2_STM32_MB2_MMCSD_AUTOMOUNT
	bool "MB2 MMCSD automounter"
	default n

if CLICKER2_STM32_MB2_MMCSD_AUTOMOUNT

config CLICKER2_STM32_MB2_MMCSD_AUTOMOUNT_FSTYPE
	string "MB2 MMCSD file system type"
	default "vfat"

config CLICKER2_STM32_MB2_MMCSD_AUTOMOUNT_BLKDEV
	string "MB2 MMCSD block device"
	default "/dev/mmcsd0"

config CLICKER2_STM32_MB2_MMCSD_AUTOMOUNT_MOUNTPOINT
	string "MB2 MMCSD mount point"
	default "/mnt/sdcard0"

config CLICKER2_STM32_MB2_MMCSD_AUTOMOUNT_DDELAY
	int "MB2 MMCSD debounce delay (milliseconds)"
	default 1000

config CLICKER2_STM32_MB2_MMCSD_AUTOMOUNT_UDELAY
	int "MB2 MMCSD unmount retry delay (milliseconds)"
	default 2000

endif # CLICKER2_STM32_MB2_MMCSD_AUTOMOUNT
endif # CLICKER2_STM32_MB2_MMCSD

endif # FS_AUTOMOUNTER

config CLICKER2_STM32_SYSLOG_FILE
	bool "Enable file syslog"
	default n
	depends on SYSLOG_FILE

if CLICKER2_STM32_SYSLOG_FILE

config CLICKER2_STM32_SYSLOG_FILE_PATH
	string "Path to syslog file"
	default "/mnt/sdcard0/nuttx.log"

config CLICKER2_STM32_SYSLOG_FILE_DELAY
	int "Delay time(ms) for syslog file"
	default 2500
	---help---
		If the file used for syslog is on an SD card, the device may need time
		to finish mounting the file system. This option selects the amount of
		time in milliseconds for the system to wait before attempting to setup
		the syslog file

endif # CLICKER2_STM32_SYSLOG_FILE

config CLICKER2_STM32_RNDIS_MACADDR
	hex "RNDIS MAC address"
	default 0xfadedeadbeef
	depends on RNDIS
	---help---
		If the hardware has no built-in MAC address then the fixed,
		software-assigned MAC address MAC address must provided
		with this selection.

endif # ARCH_BOARD_CLICKER2_STM32
```

## boards/arm/stm32f4/nucleo-f411re/Kconfig
```kconfig
#
# For a description of the syntax of this configuration file,
# see the file kconfig-language.txt in the NuttX tools repository.
#

if ARCH_BOARD_NUCLEO_F411RE

config NUCLEO_F411RE_QETIMER
	int "Timer to use with QE encoder"
	default 3
	depends on SENSORS_QENCODER

config NUCLEO_F411RE_AJOY_MINBUTTONS
	bool "Minimal Joystick Buttons"
	default STM32_USART1
	depends on INPUT_AJOYSTICK
	---help---
		The Itead Joystick shield supports analog X/Y position and up to 5
		buttons.  Some of these buttons may conflict with other resources
		(Button F, for example, conflicts with the default USART1 pin usage).
		Selecting this option will return the number of buttons to the
		minimal set:  SELECT (joystick down), FIRE (BUTTON B), and JUMP
		(BUTTON A).

endif # ARCH_BOARD_NUCLEO_F411RE
```

## boards/arm/stm32f7/common/Kconfig
```kconfig
#
# For a description of the syntax of this configuration file,
# see the file kconfig-language.txt in the NuttX tools repository.
#

config STM32F7_ROMFS
	bool "Automount baked-in ROMFS image"
	default n
	depends on FS_ROMFS
	---help---
		Select STM32F7_ROMFS_IMAGEFILE, STM32F7_ROMFS_DEV_MINOR, STM32F7_ROMFS_MOUNTPOINT

config STM32F7_ROMFS_DEV_MINOR
	int "Minor for the block device backing the data"
	depends on STM32F7_ROMFS
	default 64

config STM32F7_ROMFS_MOUNTPOINT
	string "Mountpoint of the custom romfs image"
	depends on STM32F7_ROMFS
	default "/rom"

config STM32F7_ROMFS_IMAGEFILE
	string "ROMFS image file to include into build"
	depends on STM32F7_ROMFS
	default "../../../rom.img"

config STM32F7_SPI_TEST
	bool "Enable SPI test"
	default n
	---help---
		Enable Spi test - initialize and configure SPI to send
		STM32F7_SPI_TEST_MESSAGE text. The text is sent on the
		selected SPI Buses with the configured parameters.
		Note the CS lines will not be asserted.

if STM32F7_SPI_TEST

config STM32F7_SPI_TEST_MESSAGE
	string "Text to Send on SPI Bus(es)"
	default "Hello World"
	depends on STM32F7_SPI_TEST
	---help---
		Text to sent on SPI bus(es)

config STM32F7_SPI1_TEST
	bool "Test SPI bus 1"
	default n
	depends on STM32F7_SPI_TEST
	---help---
		Enable Spi test - on SPI BUS 1

if STM32F7_SPI1_TEST

config STM32F7_SPI1_TEST_FREQ
	int "SPI 1 Clock Freq in Hz"
	default 1000000
	depends on STM32F7_SPI1_TEST
	---help---
		Sets SPI 1 Clock Freq

config STM32F7_SPI1_TEST_BITS
	int "SPI 1 number of bits"
	default 8
	depends on STM32F7_SPI1_TEST
	---help---
		Sets SPI 1 bit length

choice
	prompt "SPI BUS 1 Clock Mode"
	default STM32F7_SPI1_TEST_MODE3
	---help---
		Sets SPI 1 clock mode

config STM32F7_SPI1_TEST_MODE0
	bool "CPOL=0 CPHA=0"

config STM32F7_SPI1_TEST_MODE1
	bool "CPOL=0 CPHA=1"

config STM32F7_SPI1_TEST_MODE2
	bool "CPOL=1 CPHA=0"

config STM32F7_SPI1_TEST_MODE3
	bool "CPOL=1 CPHA=1"

endchoice # "SPI BUS 1 Clock Mode"

endif # STM32F7_SPI1_TEST

config STM32F7_SPI2_TEST
	bool "Test SPI bus 2"
	default n
	depends on STM32F7_SPI_TEST
	---help---
		Enable Spi test - on SPI BUS 2

if STM32F7_SPI2_TEST

config STM32F7_SPI2_TEST_FREQ
	int "SPI 2 Clock Freq in Hz"
	default 12000000
	depends on STM32F7_SPI2_TEST
	---help---
		Sets SPI 2 Clock Freq

config STM32F7_SPI2_TEST_BITS
	int "SPI 2 number of bits"
	default 8
	depends on STM32F7_SPI2_TEST
	---help---
		Sets SPI 2 bit length

choice
	prompt "SPI BUS 2 Clock Mode"
	default STM32F7_SPI2_TEST_MODE3
	---help---
		Sets SPI 2 clock mode

config STM32F7_SPI2_TEST_MODE0
	bool "CPOL=0 CPHA=0"

config STM32F7_SPI2_TEST_MODE1
	bool "CPOL=0 CPHA=1"

config STM32F7_SPI2_TEST_MODE2
	bool "CPOL=1 CPHA=0"

config STM32F7_SPI2_TEST_MODE3
	bool "CPOL=1 CPHA=1"

endchoice # "SPI BUS 2 Clock Mode"

endif # STM32F7_SPI2_TEST

config STM32F7_SPI3_TEST
	bool "Test SPI bus 3"
	default n
	depends on STM32F7_SPI_TEST
	---help---
		Enable Spi test - on SPI BUS 3

if STM32F7_SPI3_TEST

config STM32F7_SPI3_TEST_FREQ
	int "SPI 3 Clock Freq in Hz"
	default 40000000
	depends on STM32F7_SPI3_TEST
	---help---
		Sets SPI 3 Clock Freq

config STM32F7_SPI3_TEST_BITS
	int "SPI 3 number of bits"
	default 8
	depends on STM32F7_SPI3_TEST
	---help---
		Sets SPI 3 bit length

choice
	prompt "SPI BUS 3 Clock Mode"
	default STM32F7_SPI3_TEST_MODE3
	---help---
		Sets SPI 3 clock mode

config STM32F7_SPI3_TEST_MODE0
	bool "CPOL=0 CPHA=0"

config STM32F7_SPI3_TEST_MODE1
	bool "CPOL=0 CPHA=1"

config STM32F7_SPI3_TEST_MODE2
	bool "CPOL=1 CPHA=0"

config STM32F7_SPI3_TEST_MODE3
	bool "CPOL=1 CPHA=1"

endchoice # "SPI BUS 3 Clock Mode"

endif # STM32F7_SPI3_TEST
endif # STM32F7_SPI_TEST
```
