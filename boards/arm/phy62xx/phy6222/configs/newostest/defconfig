## boards/arm/ra4/arduino-r4-minima/Kconfig
```kconfig
#
# For a description of the syntax of this configuration file,
# see the file kconfig-language.txt in the NuttX tools repository.
#

if ARCH_BOARD_ARDUINO_R4_MINIMA

config ARDUINO_R4_MINIMA_PWM_CHANNEL
	int "PWM channel number"
	default 0 if RA_GPT0_PWM
	default 1 if RA_GPT1_PWM
	default 2 if RA_GPT2_PWM
	default 3 if RA_GPT3_PWM
	default 4 if RA_GPT4_PWM
	default 5 if RA_GPT5_PWM
	default 6 if RA_GPT6_PWM
	default 7 if RA_GPT7_PWM
	range 0 7
	depends on PWM && RA_PWM
	---help---
		Selects the PWM channel number that will be used to perform the PWM
		test.  See apps/examples/pwm.

endif
```

## boards/arm/rp2040/adafruit-feather-rp2040/Kconfig
```kconfig
#
# For a description of the syntax of this configuration file,
# see the file kconfig-language.txt in the NuttX tools repository.
#

if ARCH_BOARD_ADAFRUIT_FEATHER_RP2040

config RP2040_LCD_SPI_CH
	int "RP2040 LCD SPI channel number"
	default 0
	range 0 1
	depends on LCD
	---help---
		Select SPI channel number to use LCD display.

config RP2040_ENC28J60_SPI_CH
	int "ENC28J60 SPI channel number"
	default 1
	range 0 1
	depends on ENC28J60
	---help---
		Select SPI channel number to use ENC28J60 ethernet.

config RP2040_ENC28J60_INTR_GPIO
	int "ENC28J60 interrupt GPIO pin assign"
	default -1
	range -1 29
	depends on ENC28J60

config RP2040_ENC28J60_RESET_GPIO
	int "ENC28J60 reset GPIO pin assign (optional)"
	default -1
	range -1 29
	depends on ENC28J60

endif
```

## boards/arm/rp2040/adafruit-kb2040/Kconfig
```kconfig
#
# For a description of the syntax of this configuration file,
# see the file kconfig-language.txt in the NuttX tools repository.
#

if ARCH_BOARD_ADAFRUIT_KB2040

config RP2040_FLASH_BOOT
	bool "flash boot"
	default y
	---help---
		If y, the built binary can be used for flash boot.
		If not, the binary is for SRAM boot.

config RP2040_FLASH_CHIP
	string "Second stage boot loader"
	default "w25q080"
	---help---
		This is the name of the Pico-SDK second stage boot loader
		to use for this board.  This board using a Q64 flash chip
		which is compatible with the w25q080 boot loader.
		Basically this option should not be changed.

config RP2040_UF2_BINARY
	bool "uf2 binary format"
	default y
	---help---
		Create nuttx.uf2 binary format used on RP2040 based arch.

config RP2040_LCD_SPI_CH
	int "RP2040 LCD SPI channel number"
	default 0
	range 0 1
	depends on LCD
	---help---
		Select SPI channel number to use LCD display.

config RP2040_ENC28J60_SPI_CH
	int "ENC28J60 SPI channel number"
	default 1
	range 0 1
	depends on ENC28J60
	---help---
		Select SPI channel number to use ENC28J60 ethernet.

config RP2040_ENC28J60_INTR_GPIO
	int "ENC28J60 interrupt GPIO pin assign"
	default -1
	range -1 29
	depends on ENC28J60

config RP2040_ENC28J60_RESET_GPIO
	int "ENC28J60 reset GPIO pin assign (optional)"
	default -1
	range -1 29
	depends on ENC28J60

endif
```

## boards/arm/rp2040/adafruit-qt-py-rp2040/Kconfig
```kconfig
#
# For a description of the syntax of this configuration file,
# see the file kconfig-language.txt in the NuttX tools repository.
#

if ARCH_BOARD_ADAFRUIT_QT_PY_RP2040

config RP2040_FLASH_BOOT
	bool "flash boot"
	default y
	---help---
		If y, the built binary can be used for flash boot.
		If not, the binary is for SRAM boot.

config RP2040_FLASH_CHIP
	string "Second stage boot loader"
	default "w25q080"
	---help---
		This is the name of the Pico-SDK second stage boot loader
		to use for this board.  This board using a Q64 flash chip
		which is compatible with the w25q080 boot loader.
		Basically this option should not be changed.

config RP2040_UF2_BINARY
	bool "uf2 binary format"
	default y
	---help---
		Create nuttx.uf2 binary format used on RP2040 based arch.

endif
```

## boards/arm/rp2040/common/Kconfig
```kconfig
#
# For a description of the syntax of this configuration file,
# see the file kconfig-language.txt in the NuttX tools repository.
#

if ARCH_BOARD_RASPBERRYPI_PICO

config RP2040_ADC
	bool "Enable ADC Support"
	default n
	---help---
		If y, the RP2040 ADC code will be built.  For ADC device driver 
		support you must also select "Analog-to-Digital Conversion"
		under the "Device Driver/Analog Device Support" menu.

		If the ADC device driver is not built, basic functions
		to programatically access the ADC ports will be added.

if RP2040_ADC && ADC

	config RPC2040_ADC_CHANNEL0
		bool "Read ADC channel 0"
		default n
		---help---
			If y, then ADC0 will be read.

	config RPC2040_ADC_CHANNEL1
		bool "Read ADC channel 1"
		default n
		---help---
			If y, then ADC1 will be read.

	config RPC2040_ADC_CHANNEL2
		bool "Read ADC channel 2"
		default n
		---help---
			If y, then ADC2 will be read.

		config RPC2040_ADC_CHANNEL3
		bool "Read ADC channel 3"
		default n
		---help---
			If y, then ADC3 will be read.

		config RPC2040_ADC_TEMPERATURE
		bool "Read ADC chip temperature channel"
		default n
		---help---
			If y, then the ADC chip temperature
			will be read.
	
	endif

endif
```

## boards/arm/rp2040/raspberrypi-pico-w/Kconfig
```kconfig
#
# For a description of the syntax of this configuration file,
# see the file kconfig-language.txt in the NuttX tools repository.
#

if ARCH_BOARD_RASPBERRYPI_PICO_W

config RP2040_FLASH_BOOT
	bool "flash boot"
	default y
	---help---
		If y, the built binary can be used for flash boot.
		If not, the binary is for SRAM boot.

config RP2040_FLASH_CHIP
	string "Second stage boot loader"
	default "w25q080"
	---help---
		This is the name of the Pico-SDK second stage boot loader
		to use for this board.  This board using a Q16 flash chip
		which is compatible with the w25q080 boot loader.
		Basically this option should not be changed.

config RP2040_UF2_BINARY
	bool "uf2 binary format"
	default y
	---help---
		Create nuttx.uf2 binary format used on RP2040 based arch.

config RP2040_LCD_SPI_CH
	int "RP2040 LCD SPI channel number"
	default 0
	range 0 1
	depends on LCD
	---help---
		Select SPI channel number to use LCD display.

config RP2040_ENC28J60_SPI_CH
	int "ENC28J60 SPI channel number"
	default 1
	range 0 1
	depends on ENC28J60
	---help---
		Select SPI channel number to use ENC28J60 ethernet.

config RP2040_ENC28J60_INTR_GPIO
	int "ENC28J60 interrupt GPIO pin assign"
	default -1
	range -1 29
	depends on ENC28J60

config RP2040_ENC28J60_RESET_GPIO
	int "ENC28J60 reset GPIO pin assign (optional)"
	default -1
	range -1 29
	depends on ENC28J60

menuconfig RP2040_INFINEON_CYW43439
	bool "Has Infineon cyw43439 WiFi chip"
	depends on IEEE80211_INFINEON_CYW43439
  default y
endif

if RP2040_INFINEON_CYW43439

	config CYW43439_FIRMWARE_BIN_PATH
		string "Path to Infineon 43439 firmware file"
		default "${PICO_SDK_PATH}/lib/cyw43-driver/firmware/43439A0-7.95.49.00.combined"
		---help---
			This should be a path to a file containing both the cyw43439 firmware and
			the CLB blob.   The firmware should be padded to a 256 byte boundary and
			then the CLM blob should be appended.

			If this file is updated, check the CYW43439_FIRMWARE_LEN below to make sure
			it reflects the un-padded length of the firmware part.

	config CYW43439_FIRMWARE_LEN
		int "Infineon 43439 firmware length (bytes)"
		default 224190
		---help---
			This is the length of just the base firmware in the firmware file specified
			by the "Path to Infineon 43439 firmware file" configuration option.  
			
			This length does not include the length of any padding nor the length of
			the appended clm_blob. If a clm_blob is present in the firmware file, this 
			length will be less than the length of the whole file.


endif
```

## boards/arm/rp2040/raspberrypi-pico/Kconfig
```kconfig
#
# For a description of the syntax of this configuration file,
# see the file kconfig-language.txt in the NuttX tools repository.
#

if ARCH_BOARD_RASPBERRYPI_PICO

config RP2040_FLASH_BOOT
	bool "flash boot"
	default y
	---help---
		If y, the built binary can be used for flash boot.
		If not, the binary is for SRAM boot.

config RP2040_FLASH_CHIP
	string "flash chip name"
	default "w25q080"
	---help---
		Name of NOR flash device connected to RP2040 SoC.
		(Used to choose the secondary boot loader.)
		Basically this option should not be changed.

config RP2040_UF2_BINARY
	bool "uf2 binary format"
	default y
	---help---
		Create nuttx.uf2 binary format used on RP2040 based arch.

config RP2040_UART0_GPIO
	int "UART0 GPIO pin assign (0,12,16,28 or -1:no assign)"
	default 0
	range -1 29
	depends on RP2040_UART0

config RP2040_UART1_GPIO
	int "UART1 GPIO pin assign (4,8,20,24 or -1:no assign)"
	default -1
	range -1 29
	depends on RP2040_UART1

config RP2040_I2C0_GPIO
	int "I2C0 GPIO pin assign (0,4,8,12,16,20,24,28 or -1:no assign)"
	default -1
	range -1 29
	depends on RP2040_I2C0

config RP2040_I2C1_GPIO
	int "I2C1 GPIO pin assign (2,6,10,14,18,22,26 or -1:no assign)"
	default -1
	range -1 29
	depends on RP2040_I2C1

config RP2040_PWM0A_GPIO
	int "PWM0 channel 1 GPIO pin assign (0, 16 or -1:no assign)"
	default -1
	range -1 29
	depends on RP2040_PWM0

if PWM_MULTICHAN && PWM_NCHANNELS > 1
	config RP2040_PWM0B_GPIO
		int "PWM0 channel 2 GPIO pin assign (1, 17 or -1:no assign)"
		default -1
		range -1 29
	depends on RP2040_PWM0
endif

config RP2040_PWM1A_GPIO
	int "PWM1 channel 1 GPIO pin assign (2, 18 or -1:no assign)"
	default -1
	range -1 29
	depends on RP2040_PWM1

if PWM_MULTICHAN && PWM_NCHANNELS > 1
	config RP2040_PWM1B_GPIO
		int "PWM1 channel 2 GPIO pin assign (3, 19 or -1:no assign)"
		default -1
		range -1 29
		depends on RP2040_PWM1
endif

config RP2040_PWM2A_GPIO
	int "PWM2 channel 1 GPIO pin assign (4, 20 or -1:no assign)"
	default -1
	range -1 29
	depends on RP2040_PWM2

if PWM_MULTICHAN && PWM_NCHANNELS > 1
	config RP2040_PWM2B_GPIO
		int "PWM2 channel 2 GPIO pin assign (5, 21 or -1:no assign)"
		default -1
		range -1 29
		depends on RP2040_PWM2
endif

config RP2040_PWM3A_GPIO
	int "PWM3 channel 1 GPIO pin assign (6, 22 or -1:no assign)"
	default -1
	range -1 29
	depends on RP2040_PWM3

if PWM_MULTICHAN && PWM_NCHANNELS > 1
	config RP2040_PWM3B_GPIO
		int "PWM3 channel 2 GPIO pin assign (7, 23 or -1:no assign)"
		default -1
		range -1 29
		depends on RP2040_PWM3
endif

config RP2040_PWM4A_GPIO
	int "PWM4 channel 1 GPIO pin assign (8, 24 or -1:no assign)"
	default -1
	range -1 29
	depends on RP2040_PWM4

if PWM_MULTICHAN && PWM_NCHANNELS > 1
	config RP2040_PWM4B_GPIO
		int "PWM4 channel 2 GPIO pin assign (9, 25 or -1:no assign)"
		default -1
		range -1 29
		depends on RP2040_PWM4
endif

config RP2040_PWM5A_GPIO
	int "PWM5 channel 1 GPIO pin assign (10, 26 or -1:no assign)"
	default -1
	range -1 29
	depends on RP2040_PWM5

if PWM_MULTICHAN && PWM_NCHANNELS > 1
	config RP2040_PWM5B_GPIO
		int "PWM5 channel 2 GPIO pin assign (11, 27 or -1:no assign)"
		default -1
		range -1 29
		depends on RP2040_PWM5
endif

config RP2040_PWM6A_GPIO
	int "PWM6 channel 1 GPIO pin assign (12, 28 or -1:no assign)"
	default -1
	range -1 29
	depends on RP2040_PWM6

if PWM_MULTICHAN && PWM_NCHANNELS > 1
	config RP2040_PWM6B_GPIO
		int "PWM6 channel 2 GPIO pin assign (13, 29 or -1:no assign)"
		default -1
		range -1 29
		depends on RP2040_PWM6
endif

config RP2040_PWM7A_GPIO
	int "PWM7 channel 1 GPIO pin assign (14 or -1:no assign)"
	default -1
	range -1 29
	depends on RP2040_PWM7

if PWM_MULTICHAN && PWM_NCHANNELS > 1
	config RP2040_PWM7B_GPIO
		int "PWM7 channel 2 GPIO pin assign (15 or -1:no assign)"
		default -1
		range -1 29
		depends on RP2040_PWM7
endif

config RP2040_SPI0_GPIO
	int "SPI0 GPIO pin assign (0,4,16,20 or -1:no assign)"
	default -1
	range -1 29
	depends on RP2040_SPI0

config RP2040_SPI1_GPIO
	int "SPI1 GPIO pin assign (8,12,24,28 or -1:no assign)"
	default -1
	range -1 29
	depends on RP2040_SPI1

config RP2040_LCD_SPI_CH
	int "RP2040 LCD SPI channel number"
	default 0
	range 0 1
	depends on LCD
	---help---
		Select SPI channel number to use LCD display.

config RP2040_ENC28J60_SPI_CH
	int "ENC28J60 SPI channel number"
	default 1
	range 0 1
	depends on ENC28J60
	---help---
		Select SPI channel number to use ENC28J60 ethernet.

config RP2040_ENC28J60_INTR_GPIO
	int "ENC28J60 interrupt GPIO pin assign"
	default -1
	range -1 29
	depends on ENC28J60

config RP2040_ENC28J60_RESET_GPIO
	int "ENC28J60 reset GPIO pin assign (optional)"
	default -1
	range -1 29
	depends on ENC28J60

endif
```
