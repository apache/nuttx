## boards/arm/imx9/imx93-qsb/Kconfig
```kconfig
#
# For a description of the syntax of this configuration file,
# see the file kconfig-language.txt in the NuttX tools repository.
#

choice IMX93_CODE_LOCATION
	prompt "Code location"

config IMX93_RUN_FROM_ITCM
	bool "Run from Tightly Coupled Memory (128kB) (ITCM)"
	depends on BOOT_RUNFROMISRAM

config IMX93_RUN_FROM_DDR
	bool "Run from SDRAM (DDR)"
	depends on BOOT_RUNFROMSDRAM

endchoice

config IMX93_START_NSH_ON_RPMSG
	bool "Start NSH session on /dev/tty-nsh"
	default y
	depends on RPMSG_UART_RAW && NSH_LIBRARY
```

## boards/arm/imxrt/imxrt1020-evk/Kconfig
```kconfig
#
# For a description of the syntax of this configuration file,
# see the file kconfig-language.txt in the NuttX tools repository.
#

if ARCH_BOARD_IMXRT1020_EVK
choice
        prompt "Boot Flash"
        default IMXRT1020_EVK_HYPER_FLASH

config IMXRT1020_EVK_HYPER_FLASH
        bool "HYPER Flash"

config IMXRT1020_EVK_QSPI_FLASH
        bool "QSPI Flash"

endchoice # Boot Flash

config IMXRT1020_EVK_SDRAM
        bool "Enable SDRAM"
        default n
        select IMXRT_SEMC_INIT_DONE
        ---help---
                Activate DCD configuration of SDRAM

config HAVE_LEDS
       bool "Have user leds"
       default y
       select ARCH_HAVE_LEDS
endif
```

## boards/arm/imxrt/imxrt1064-evk/Kconfig
```kconfig
#
# For a description of the syntax of this configuration file,
# see the file kconfig-language.txt in the NuttX tools repository.
#

if ARCH_BOARD_IMXRT1064_EVK

choice
	prompt "Boot Flash"
	default IMXRT1064_EVK_QSPI_FLASH

config IMXRT1064_EVK_HYPER_FLASH
	bool "HYPER Flash"

config IMXRT1064_EVK_QSPI_FLASH
	bool "QSPI Flash"

endchoice # Boot Flash

config IMXRT1064_EVK_SDRAM
	bool "Enable SDRAM"
	default n
	select IMXRT_SEMC_INIT_DONE
	---help---
		Activate DCD configuration of SDRAM

endif
```

## boards/arm/imxrt/imxrt1170-evk/Kconfig
```kconfig
#
# For a description of the syntax of this configuration file,
# see the file kconfig-language.txt in the NuttX tools repository.
#

if ARCH_BOARD_IMXRT1170_EVK

choice
	prompt "Boot Flash"
	default IMXRT1170_EVK_QSPI_FLASH

config IMXRT1170_EVK_HYPER_FLASH
	bool "HYPER Flash"

config IMXRT1170_EVK_QSPI_FLASH
	bool "QSPI Flash"

endchoice # Boot Flash

config IMXRT1170_EVK_SDRAM
	bool "Enable SDRAM"
	default n
	select IMXRT_SEMC_INIT_DONE
	---help---
		Activate DCD configuration of SDRAM

config IMXRT1170_FLEXSPI_NOR
	bool "Enable FlexSPI NOR Storage"
	default n
	depends on IMXRT_FLEXSPI

config IMXRT1170_FLEXSPI_FRAM
	bool "Enable FlexSPI FRAM Storage"
	default n
	depends on IMXRT_FLEXSPI
	select MTD

endif
```
