## boards/arm/samv7/samv71-xult/Kconfig
```kconfig
#
# For a description of the syntax of this configuration file,
# see the file kconfig-language.txt in the NuttX tools repository.
#

if ARCH_BOARD_SAMV71_XULT

config SAMV71XULT_MXTXPLND
	bool "MaXTouch Xplained connected"
	default n

config SAMV71XULT_CLICKSHIELD
	bool "Mikroe Click Shield"
	default n
	---help---
		In the mrf24j40-starhub configuration, a click shield from
		MikroElectronika was used along with a Click "Bee" module.  The
		click shield supports two click shields.

config SAMV71XULT_MB1_SPI
	bool
	default n

config SAMV71XULT_MB2_SPI
	bool
	default n

choice
	prompt "Bee mikroBUS"
	depends on SAMV71XULT_CLICKSHIELD && IEEE802154_MRF24J40
	default SAMV71XULT_MB1_BEE

config SAMV71XULT_MB1_BEE
	bool "MRF24J40 Bee in mikroBUS1"
	select SAMV71XULT_MB1_SPI

config SAMV71XULT_MB2_BEE
	bool "MRF24J40 Bee in mikroBUS2"
	select SAMV71XULT_MB2_SPI

endchoice # Bee mikroBUS

if SAMV71XULT_MXTXPLND

choice
	prompt "MaXTouch Xplained connection"
	default SAMV71XULT_MXTXPLND_EXT1

config SAMV71XULT_MXTXPLND_EXT1
	bool "Connected on EXT1 (2x10 pin)"
	depends on EXPERIMENTAL

config SAMV71XULT_MXTXPLND_EXT2
	bool "Connected on EXT2 (2x10 pin)"
	depends on EXPERIMENTAL

config SAMV71XULT_MXTXPLND_LCD
	bool "Connected on LCD (50-pin)"

endchoice # MaXTouch Xplained connection

if INPUT_MXT

config SAMV71XULT_MXT_SWAPXY
	bool "Swap X/Y coordinates"
	default n
	---help---
		If you are working in a landscape orientation, it should be
		necessary to swap X/Y coordinates.  But you will probably want
		to do this in any portrait orientation.

config SAMV71XULT_MXT_I2CFREQUENCY
	int "maXTouch I2C frequency"
	default 400000

config SAMV71XULT_MXT_DEVMINOR
	int "/dev/input minor number"
	default 0

endif # INPUT_MXT

if LCD

config SAMV71XULT_LCD_BGCOLOR
	hex "Initial background color"
	default 0x00

endif # LCD

endif # SAMV71XULT_MXTXPLND

if AUDIO_WM8904

config SAMV71XULT_WM8904_I2CFREQUENCY
	int "WM8904 I2C Frequency"
	default 400000
	range 1 400000
	---help---
		This option selects the I2C frequency to use when communicating with
		the WM8904 device.  The default, 400KHz, is the maximum supported by
		the WM8904.  If you have problems communicating with the WM8904,
		then you might want to try lowering this rate.

choice
	prompt "WM8904 MCLK source"
	default SAMV71XULT_WM8904_SRCMAIN

config SAMV71XULT_WM8904_SRCMAIN
	bool "Main Clock (12MHz)"

config SAMV71XULT_WM8904_SRCSCK
	bool "Slow XTAL (32.768KHz)"
	select SAMV71XULT_SLOWCLOCK

endchoice # WM8904 MCLK source
endif # AUDIO_WM8904

endif # ARCH_BOARD_SAMV71_XULT
```
