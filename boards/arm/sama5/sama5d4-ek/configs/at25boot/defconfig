## boards/arm/samd2l2/samd21-xplained/Kconfig
```kconfig
#
# For a description of the syntax of this configuration file,
# see the file kconfig-language.txt in the NuttX tools repository.
#

if ARCH_BOARD_SAMD21_XPLAINED

menu "SAMD21 Xplained Pro Modules"

config SAMD21_XPLAINED_IOMODULE
	bool "I/O1 Module"
	default n
	---help---
		The I/O 1 module is attached.  This module provides an MMC/SD card
		slot.

if SAMD21_XPLAINED_IOMODULE

choice
	prompt "I/O1 Module Location"
	default SAMD21_XPLAINED_IOMODULE_EXT1

config SAMD21_XPLAINED_IOMODULE_EXT1
	bool "EXT1"

config SAMD21_XPLAINED_IOMODULE_EXT2
	bool "EXT2"

endchoice
endif

config SAMD21_XPLAINED_OLED1MODULE
	bool "OLED1 Module"
	default n
	---help---
		The OLED 1 module is attached.  This module provides an OLED plus 3
		additional switches and 3 additional LEDs.

if SAMD21_XPLAINED_OLED1MODULE

choice
	prompt "OLED1 Module Location"
	default SAMD21_XPLAINED_OLED1MODULE_EXT1

config SAMD21_XPLAINED_OLED1MODULE_EXT1
	bool "EXT1"

config SAMD21_XPLAINED_OLED1MODULE_EXT2
	bool "EXT2"

endchoice
endif
endmenu

if USART4_SERIAL_CONSOLE
choice
	prompt "USART 4 Connection"
	default SAMD21_XPLAINED_USART4_EXT3

config SAMD21_XPLAINED_USART4_EXT1
	bool "EXT1"
	depends on !SAMD21_XPLAINED_OLED1MODULE_EXT1 && !SAMD21_XPLAINED_IOMODULE_EXT1
	---help---
		Select this option if the serial console is on SERCOM4 connected via
		EXT1.  The RX will be on PB9 and TX signal will be on PB8.

config SAMD21_XPLAINED_USART4_EXT2
	bool "EXT2"
	depends on !SAMD21_XPLAINED_OLED1MODULE_EXT2 && !SAMD21_XPLAINED_IOMODULE_EXT2
	---help---
		Select this option if the serial console is on SERCOM4 connected via
		EXT2.  The RX will be on PB13 and TX signal will be on PB12.

config SAMD21_XPLAINED_USART4_EXT3
	bool "EXT3"
	---help---
		Select this option if the serial console is on SERCOM4 connect via
		EXT3.  The RX will be on PB11 and TX signal will be on PB10.

endchoice
endif
endif
```

## boards/arm/samd5e5/metro-m4/Kconfig
```kconfig
#
# For a description of the syntax of this configuration file,
# see the file kconfig-language.txt in the NuttX tools repository.
#

if ARCH_BOARD_METRO_M4

choice
	prompt "Execution memory"
	default METRO_M4_RUNFROMFLASH

config METRO_M4_RUNFROMFLASH
	bool "Run from FLASH"
	select BOOT_RUNFROMFLASH
	---help---
		This is the normal configuration for building METRO M4 code.

config METRO_M4_RUNFROMSRAM
	bool "Run from SRAM"
	select BOOT_RUNFROMISRAM
	---help---
		During early bring-up, it is safer to execute entirely from
		SRAM until you are confident in the initialization logic.
		Then you can safely switch to FLASH.

		REVISIT:  This auto-selects CONFIG_BOOT_RUNFROMISRAM but I have
		found, with some difficulty, that that choice still defaults to
		CONFIG_BOOT_RUNFROMFLASH, causing link-time failures when running
		from SRAM.

endchoice # Execution memory

config METRO_M4_32KHZXTAL
	bool "32.768 KHz XTAL"
	default n
	---help---
		According to the schematic, a 32.768 KHz crystal is installed  on
		board.  However, I have been unable to use this crystal and thought
		perhaps it is missing or defective on my board (there is a metal
		package that could be a crystal on board, but I am not certain).
		Another, more likely option is that there is a coding error on my
		part that prevents the 32.768 KHz crystal from usable(?)

		The configuration defaults to using the always-on OSCULP32 as the
		slow clock source.  This option will select instead XOSC32 as the
		slow clock source.

config METRO_M4_AT24_BLOCKMOUNT
	bool "AT24 Serial EEPROM auto-mount"
	default n
	depends on MTD_AT24XX
	---help---
		Automatically initialize the AT24 I2C EEPROM driver when NSH starts.

choice
	prompt "AT24 serial EPPROM configuration"
	default METRO_M4_AT24_FTL
	depends on METRO_M4_AT24_BLOCKMOUNT

config METRO_M4_AT24_FTL
	bool "Create AT24 block driver"
	---help---
		Create the MTD driver for the AT24 and "wrap" the AT24 as a standard
		block driver that could then, for example, be mounted using FAT or
		any other file system.  Any file system may be used, but there will
		be no wear-leveling.

config METRO_M4_AT24_NXFFS
	bool "Create AT24 NXFFS file system"
	depends on FS_NXFFS
	---help---
		Create the MTD driver for the AT24 and mount the AT24 device as
		a wear-leveling, NuttX FLASH file system (NXFFS).  The downside of
		NXFFS is that it can be very slow.

endchoice # AT24 serial EPPROM configuration

if FS_AUTOMOUNTER
config METRO_M4_USB_AUTOMOUNT
	bool "USB automounter"
	default n

if METRO_M4_USB_AUTOMOUNT

config METRO_M4_USB_AUTOMOUNT_FSTYPE
	string "USB file system type"
	default "vfat"

config METRO_M4_USB_AUTOMOUNT_BLKDEV
	string "USB block device"
	default "/dev/sda"

config METRO_M4_USB_AUTOMOUNT_MOUNTPOINT
	string "USB mount point"
	default "/mnt/usb"

config METRO_M4_USB_AUTOMOUNT_DDELAY
	int "USB debounce delay (milliseconds)"
	default 1000

config METRO_M4_USB_AUTOMOUNT_UDELAY
	int "USB unmount retry delay (milliseconds)"
	default 2000

endif # METRO_M4_USB_AUTOMOUNT
endif # FS_AUTOMOUNTER

endif # ARCH_BOARD_METRO_M4
```

## boards/arm/samd5e5/same54-xplained-pro/Kconfig
```kconfig
#
# For a description of the syntax of this configuration file,
# see the file kconfig-language.txt in the NuttX tools repository.
#

if ARCH_BOARD_SAME54_XPLAINED_PRO

choice
	prompt "Execution memory"
	default SAME54_XPLAINED_PRO_RUNFROMFLASH

config SAME54_XPLAINED_PRO_RUNFROMFLASH
	bool "Run from FLASH"
	depends on BOOT_RUNFROMFLASH
	---help---
		This is the normal configuration for building SAM E54 Xplained
		Pro code.

config SAME54_XPLAINED_PRO_RUNFROMSRAM
	bool "Run from SRAM"
	depends on BOOT_RUNFROMISRAM
	---help---
		During early bring-up, it is safer to execute entirely from
		SRAM until you are confident in the initialization logic.
		Then you can safely switch to FLASH.

		REVISIT:  This auto-selects CONFIG_BOOT_RUNFROMISRAM but I have
		found, with some difficulty, that that choice still defaults to
		CONFIG_BOOT_RUNFROMFLASH, causing link-time failures when running
		from SRAM.

endchoice # Execution memory

config SAME54_XPLAINED_PRO_32KHZXTAL
	bool "32.768 KHz XTAL"
	default n
	---help---
		According to the schematic, a 32.768 KHz crystal is installed  on
		board.  However, I have been unable to use this crystal and thought
		perhaps it is missing or defective on my board (there is a metal
		package that could be a crystal on board, but I am not certain).
		Another, more likely option is that there is a coding error on my
		part that prevents the 32.768 KHz crystal from usable(?)

		The configuration defaults to using the always-on OSCULP32 as the
		slow clock source.  This option will select instead XOSC32 as the
		slow clock source.

endif # ARCH_BOARD_SAME54_XPLAINED_PRO
```

## boards/arm/samv7/common/Kconfig
```kconfig
#
# For a description of the syntax of this configuration file,
# see the file kconfiglanguage.txt in the NuttX tools repository.
#

config SAMV7_GPIO_ENC
	bool "GPIO driver based encoder"
	default n
	depends on SENSORS_QENCODER
	---help---
		This options allows the usage of an encoder based on a GPIO driver.
		The encoder is initialized by sam_gpio_enc_init() function call
		from board specific bringup code.

config SAMV7_HSMCI0_AUTOMOUNT
	bool "HSMCI0 automounter"
	default n
	depends on FS_AUTOMOUNTER && SAMV7_HSMCI0

if SAMV7_HSMCI0_AUTOMOUNT

config SAMV7_HSMCI0_AUTOMOUNT_FSTYPE
	string "HSMCI0 file system type"
	default "vfat"

config SAMV7_HSMCI0_AUTOMOUNT_BLKDEV
	string "HSMCI0 block device"
	default "/dev/mmcsd0"

config SAMV7_HSMCI0_AUTOMOUNT_MOUNTPOINT
	string "HSMCI0 mount point"
	default "/mnt/sdcard0"

config SAMV7_HSMCI0_AUTOMOUNT_DDELAY
	int "HSMCI0 debounce delay (milliseconds)"
	default 1000

config SAMV7_HSMCI0_AUTOMOUNT_UDELAY
	int "HSMCI0 unmount retry delay (milliseconds)"
	default 2000

endif # SAMV7_HSMCI0_AUTOMOUNT

config SAMV7_HSMCI0_MOUNT
       bool "HSMCI0 boot mount"
       default n
       depends on !DISABLE_MOUNTPOINT && SAMV7_HSMCI0 && !SAMV7_HSMCI0_AUTOMOUNT

if SAMV7_HSMCI0_MOUNT

config SAMV7_HSMCI0_MOUNT_FSTYPE
       string "HSMCI0 file system type"
       default "vfat"

config SAMV7_HSMCI0_MOUNT_BLKDEV
       string "HSMCI0 block device"
       default "/dev/mmcsd0"

config SAMV7_HSMCI0_MOUNT_MOUNTPOINT
       string "HSMCI0 mount point"
       default "/bin"

endif # SAMV7_HSMCI0_MOUNT

config SAMV7_PROGMEM_OTA_PARTITION
	bool
	default n
	select ARCH_RAMFUNCS
	select BCH
	select MTD
	select MTD_BYTE_WRITE
	select MTD_PARTITION
	select MTD_PROGMEM
	select SAMV7_PROGMEM

config SAMV7_MCUBOOT_HEADER_SIZE
	hex
	default 0x200
	depends on SAMV7_FORMAT_MCUBOOT

menuconfig SAMV7_FORMAT_MCUBOOT
	bool "MCUboot bootable format"
	default n
	select SAMV7_PROGMEM_OTA_PARTITION
	---help---
		 The MCUboot support of loading the firmware images.

if SAMV7_FORMAT_MCUBOOT

comment "MCUboot Application Image OTA Update support"

config SAMV7_OTA_PRIMARY_SLOT_OFFSET
	hex "MCUboot application image primary slot offset"
	default 0x20000

config SAMV7_OTA_PRIMARY_SLOT_DEVPATH
	string "Application image primary slot device path"
	default "/dev/ota0"

config SAMV7_OTA_SECONDARY_SLOT_OFFSET
	hex "MCUboot application image secondary slot offset"
	default 0x48000  if SAMV7_MEM_FLASH_512
	default 0x80000  if SAMV7_MEM_FLASH_1024
	default 0x100000 if SAMV7_MEM_FLASH_2048

config SAMV7_OTA_SECONDARY_SLOT_DEVPATH
	string "Application image secondary slot device path"
	default "/dev/ota1"

config SAMV7_OTA_SLOT_SIZE
	hex "MCUboot application image slot size (in bytes)"
	default 0x28000  if SAMV7_MEM_FLASH_512
	default 0x60000  if SAMV7_MEM_FLASH_1024
	default 0xe0000  if SAMV7_MEM_FLASH_2048

config SAMV7_OTA_SCRATCH_OFFSET
	hex "MCUboot scratch partition offset"
	default 0x70000  if SAMV7_MEM_FLASH_512
	default 0xe0000  if SAMV7_MEM_FLASH_1024
	default 0x1e0000 if SAMV7_MEM_FLASH_2048

config SAMV7_OTA_SCRATCH_DEVPATH
	string "Scratch partition device path"
	default "/dev/otascratch"

config SAMV7_OTA_SCRATCH_SIZE
	hex "MCUboot scratch partition size (in bytes)"
	default 0x10000  if SAMV7_MEM_FLASH_512
	default 0x20000

endif # SAMV7_FORMAT_MCUBOOT
```

## boards/arm/samv7/same70-qmtech/Kconfig
```kconfig
#
# For a description of the syntax of this configuration file,
# see the file kconfig-language.txt in the NuttX tools repository.
#

if ARCH_BOARD_SAME70_QMTECH

config SAME70QMTECH_HSMCI0_AUTOMOUNT
	bool "HSMCI0 automounter"
	default n
	depends on FS_AUTOMOUNTER && SAMV7_HSMCI0

if SAME70QMTECH_HSMCI0_AUTOMOUNT

config SAME70QMTECH_HSMCI0_AUTOMOUNT_FSTYPE
	string "HSMCI0 file system type"
	default "vfat"

config SAME70QMTECH_HSMCI0_AUTOMOUNT_BLKDEV
	string "HSMCI0 block device"
	default "/dev/mmcsd0"

config SAME70QMTECH_HSMCI0_AUTOMOUNT_MOUNTPOINT
	string "HSMCI0 mount point"
	default "/mnt/sdcard0"

config SAME70QMTECH_HSMCI0_AUTOMOUNT_DDELAY
	int "HSMCI0 debounce delay (milliseconds)"
	default 1000

config SAME70QMTECH_HSMCI0_AUTOMOUNT_UDELAY
	int "HSMCI0 unmount retry delay (milliseconds)"
	default 2000

endif # SAME70QMTECH_HSMCI0_AUTOMOUNT

config SAME70QMTECH_PROGMEM_OTA_PARTITION
	bool
	default n
	select MTD
	select MTD_BYTE_WRITE
	select MTD_PARTITION
	select MTD_PROGMEM
	select MTD_PROGMEM_ERASESTATE

menuconfig SAME70QMTECH_FORMAT_MCUBOOT
	bool "MCUboot-bootable format"
	default n
	select SAME70QMTECH_PROGMEM_OTA_PARTITION
	---help---
		The MCUboot support of loading the firmware images.

if SAME70QMTECH_FORMAT_MCUBOOT

config SAME70QMTECH_MCUBOOT_BOOTLOADER
	bool "MCUboot bootloader application"
	default n
	---help---
		This switch between linker scripts to allow an application be
		built to another entry point address.

comment "MCUboot Application Image OTA Update support"

config SAME70QMTECH_OTA_PRIMARY_SLOT_OFFSET
	hex "MCUboot application image primary slot offset"
	default "0x20000"

config SAME70QMTECH_OTA_PRIMARY_SLOT_DEVPATH
	string "Application image primary slot device path"
	default "/dev/ota0"

config SAME70QMTECH_OTA_SECONDARY_SLOT_OFFSET
	hex "MCUboot application image secondary slot offset"
	default "0x48000"

config SAME70QMTECH_OTA_SECONDARY_SLOT_DEVPATH
	string "Application image secondary slot device path"
	default "/dev/ota1"

config SAME70QMTECH_OTA_SLOT_SIZE
	hex "MCUboot application image slot size (in bytes)"
	default "0x28000"

config SAME70QMTECH_OTA_SCRATCH_OFFSET
	hex "MCUboot scratch partition offset"
	default "0x70000"

config SAME70QMTECH_OTA_SCRATCH_DEVPATH
	string "Scratch partition device path"
	default "/dev/otascratch"

config SAME70QMTECH_OTA_SCRATCH_SIZE
	hex "MCUboot scratch partition size (in bytes)"
	default "0x10000"

endif # SAME70QMTECH_FORMAT_MCUBOOT

endif # ARCH_BOARD_SAME70_QMTECH
```

## boards/arm/samv7/same70-xplained/Kconfig
```kconfig
#
# For a description of the syntax of this configuration file,
# see the file kconfig-language.txt in the NuttX tools repository.
#

if ARCH_BOARD_SAME70_XPLAINED

config SAME70XPLAINED_CLICKSHIELD
	bool "Mikroe Click Shield"
	default n
	---help---
		In the mrf24j40-starhub configuration, a click shield from
		MikroElectronika was used along with a Click "Bee" module.  The
		click shield supports two click shields.

config SAME70XPLAINED_MB1_SPI
	bool
	default n

config SAME70XPLAINED_MB2_SPI
	bool
	default n

choice
	prompt "mikroBUS1 Click"
	depends on SAME70XPLAINED_CLICKSHIELD
	default SAME70XPLAINED_MB1_NONE

config SAME70XPLAINED_MB1_NONE
	bool "None"

config SAME70XPLAINED_MB1_BEE
	bool "MRF24J40 Bee in mikroBUS1"
	depends on IEEE802154_MRF24J40
	select SAME70XPLAINED_MB1_SPI

config SAME70XPLAINED_MB1_XBEE
	bool "XBee in mikroBUS1"
	depends on IEEE802154_XBEE
	select SAME70XPLAINED_MB1_SPI

endchoice # mikroBUS1 Click

choice
	prompt "mikroBUS2 Click"
	depends on SAME70XPLAINED_CLICKSHIELD
	default SAME70XPLAINED_MB2_NONE

config SAME70XPLAINED_MB2_NONE
	bool "None"

config SAME70XPLAINED_MB2_BEE
	bool "MRF24J40 Bee in mikroBUS2"
	depends on IEEE802154_MRF24J40
	select SAME70XPLAINED_MB2_SPI

config SAME70XPLAINED_MB2_XBEE
	bool "XBee in mikroBUS2"
	depends on IEEE802154_XBEE
	select SAME70XPLAINED_MB2_SPI

endchoice # mikroBUS2 Click

endif # ARCH_BOARD_SAME70_XPLAINED
```
