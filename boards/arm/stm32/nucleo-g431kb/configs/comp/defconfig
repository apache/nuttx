## boards/arm/stm32/nucleo-g431rb/Kconfig
```kconfig
#
# For a description of the syntax of this configuration file,
# see the file kconfig-language.txt in the NuttX tools repository.
#

if ARCH_BOARD_NUCLEO_G431RB

choice
	prompt "PLL Clock source"
	default BOARD_NUCLEO_G431RB_HSI

config BOARD_NUCLEO_G431RB_USE_HSI
	bool "HSI"

config BOARD_NUCLEO_G431RB_USE_HSE
	bool "HSE"

endchoice

if SENSORS_QENCODER

config NUCLEO_G431RB_QETIMER
	int "Timer to use with QE encoder"
	default 2

endif # SENSORS_QENCODER

endif # ARCH_BOARD_NUCLEO_G431RB
```

## boards/arm/stm32/odrive36/Kconfig
```kconfig
#
# For a description of the syntax of this configuration file,
# see the file kconfig-language.txt in the NuttX tools repository.
#

if ARCH_BOARD_ODRIVE36

choice
	prompt "ODrive voltage version"
	default ODRIVE_HW_VOLTAGE_56

config ODRIVE_HW_VOLTAGE_56
	bool "ODrive 56V version"

config ODRIVE_HW_VOLTAGE_24
	bool "ODrive 24V version"

endchoice # ODrive voltage version

if MOTOR_FOC

config ODRIVE_FOC_FOC0
	bool "ODrive enable support for FOC device 0"
	default y

if ODRIVE_FOC_FOC0

endif # ODRIVE_FOC_FOC0

config ODRIVE_FOC_FOC1
	bool "ODrive enable support for FOC device 1"
	default y

if ODRIVE_FOC_FOC1

endif # ODRIVE_FOC_FOC1

config ODRIVE_FOC_VBUS
	bool "ODrive VBUS ADC support"
	default n

config ODRIVE_FOC_TEMP
	bool "ODrive Temperature ADC support"
	default n

endif # MOTOR_FOC

endif # ARCH_BOARD_ODRIVE
```

## boards/arm/stm32/olimex-stm32-p407/Kconfig
```kconfig
#
# For a description of the syntax of this configuration file,
# see the file kconfig-language.txt in the NuttX tools repository.
#

if ARCH_BOARD_OLIMEX_STM32P407

config STM32_OLIMEXP407_STACKSIZE
	int "USB host waiter stack size"
	default 1024
	depends on USBHOST

config STM32_OLIMEXP407_PRIO
	int "USB host waiter task priority"
	default 100
	depends on USBHOST

config STM32_OLIMEXP407_UEXT_USART3
	bool "Enable UEXT USART3"
	default n

endif
```
