## boards/arm/stm32/nucleo-f302r8/Kconfig
```kconfig
#
# For a description of the syntax of this configuration file,
# see the file kconfig-language.txt in the NuttX tools repository.
#

if ARCH_BOARD_NUCLEO_F302R8

config NUCLEOF302R8_HIGHPRI
	bool "High priority interrupt test"
	default n

if SENSORS_QENCODER

config NUCLEO_F302R8_QETIMER
	int "Timer to use with QE encoder"
	default 2

endif # SENSORS_QENCODER

endif
```

## boards/arm/stm32/nucleo-f429zi/Kconfig
```kconfig
#
# For a description of the syntax of this configuration file,
# see the file kconfig-language.txt in the NuttX tools repository.
#

if ARCH_BOARD_NUCLEO_F429ZI

choice
	prompt "Select Console wiring."
	default NUCLEO_F429ZI_CONSOLE_ARDUINO
	---help---
		Select where you will connect the console.

		Virtual COM Port:

		Advantage: Use the ST-Link as a console. No Extra wiring
		needed.

		Disadvantage: Not the best choice for initial bring up.

		ARDUINO Connector:

		Advantage: You have a shield so it is easy.

		Disadvantage: You loose the use of the
		other functions on PC6, PC7

				STM32F4
			ARDUIONO FUNCTION  GPIO
			-- ----- --------- ----
			DO RX    USART6_RX PG9
			D1 TX    USART6_TX PG14
			-- ----- --------- ---

config NUCLEO_F429ZI_CONSOLE_ARDUINO
	bool "Arduino Connector"
	select STM32_USART6
	select USART6_SERIALDRIVER
	select USART6_SERIAL_CONSOLE

config NUCLEO_F429ZI_CONSOLE_VIRTUAL
	bool "Virtual Comport"
	select STM32_USART3
	select USART3_SERIALDRIVER
	select USART3_SERIAL_CONSOLE

config NUCLEO_F429ZI_CONSOLE_NONE
	bool "No Console"

endchoice # "Select Console wiring"

endif # ARCH_BOARD_NUCLEO_144
```

## boards/arm/stm32/nucleo-f446re/Kconfig
```kconfig
#
# For a description of the syntax of this configuration file,
# see the file kconfig-language.txt in the NuttX tools repository.
#

if ARCH_BOARD_NUCLEO_F446RE

if SENSORS_QENCODER

config NUCLEO_F446RE_QETIMER
	int "Timer to use with QE encoder"
	default 3

config NUCLEO_F446RE_QETIMER_TIM2_IHM08M1_MAP
	bool "Use TIM2 QE pins to match IHM08M1 board pins"
	default n
	depends on STM32_TIM2_QE

endif # SENSORS_QENCODER

config NUCLEO_F446RE_AJOY_MINBUTTONS
	bool "Minimal Joystick Buttons"
	default n if !STM32_USART1
	default y if STM32_USART1
	depends on INPUT_AJOYSTICK
	---help---
		The Itead Joystick shield supports analog X/Y position and up to 5
		buttons.  Some of these buttons may conflict with other resources
		(Button F, for example, conflicts with the default USART1 pin usage).
		Selecting this option will return the number of buttons to the
		minimal set:  SELECT (joystick down), FIRE (BUTTON B), and JUMP
		(BUTTON A).

config STM32_ROMFS
	bool "Automount baked-in ROMFS image"
	default n
	depends on FS_ROMFS
	---help---
		Select STM32_ROMFS_IMAGEFILE, STM32_ROMFS_DEV_MINOR, STM32_ROMFS_MOUNTPOINT

config STM32_ROMFS_DEV_MINOR
	int "Minor for the block device backing the data"
	depends on STM32_ROMFS
	default 64

config STM32_ROMFS_MOUNTPOINT
	string "Mountpoint of the custom romfs image"
	depends on STM32_ROMFS
	default "/rom"

config STM32_ROMFS_IMAGEFILE
	string "ROMFS image file to include into build"
	depends on STM32_ROMFS
	default "../../../rom.img"

endif # ARCH_BOARD_NUCLEO_F446RE
```
