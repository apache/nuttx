## boards/arm/stm32/stm32ldiscovery/Kconfig
```kconfig
#
# For a description of the syntax of this configuration file,
# see the file kconfig-language.txt in the NuttX tools repository.
#

if ARCH_BOARD_STM32FL_DISCOVERY

config STM32LDISCO_QETIMER
	int "Timer to use with QE encoder"
	default 3
	depends on SENSORS_QENCODER

endif
```

## boards/arm/stm32f0l0g0/common/Kconfig
```kconfig
#
# For a description of the syntax of this configuration file,
# see the file kconfig-language.txt in the NuttX tools repository.
#

source "boards/arm/common/stm32/Kconfig"
```

## boards/arm/stm32f1/nucleo-f103rb/Kconfig
```kconfig
#
# For a description of the syntax of this configuration file,
# see the file kconfig-language.txt in the NuttX tools repository.
#

if ARCH_BOARD_NUCLEO_F103RB

if SENSORS_QENCODER

config NUCLEO_F103RB_QETIMER
	int "Timer to use with QE encoder"
	default 2

endif # SENSORS_QENCODER

endif
```

## boards/arm/stm32f1/viewtool-stm32f107/Kconfig
```kconfig
#
# For a description of the syntax of this configuration file,
# see the file kconfig-language.txt in the NuttX tools repository.
#

if ARCH_BOARD_VIEWTOOL_STM32F107

config VIEWTOOL_HIGHPRI
	bool "High priority interrupt test"
	default n
	depends on ARCH_CHIP_STM32F103VC && ARCH_HIPRI_INTERRUPT
	---help---
		This selection enables building of the custom test for the Cortex-M
		high priority, nested interrupts.  ARCH_HIPRI_INTERRUPT must first
		be enabled.  This test is only implemented on the STM32F103VCT6
		(ARCH_CHIP_STM32F103VC) but should be easily ported to other STM32
		architectures.

if VIEWTOOL_HIGHPRI

config VIEWTOOL_TIM6_FREQUENCY
	int "TIM6 Frequency"
	default 36000000
	---help---
		TIM6 is used to drive the high priority, nested interrupt in the
		test enabled with VIEWTOOL_HIGHPRI.  This setting specifies the
		frequency of the TIM6 input clock.

config VIEWTOOL_TIM6_PERIOD
	int "TIM6 Period"
	default 36000
	---help---
		TIM6 is used to drive the high priority, nested interrupt in the
		test enabled with VIEWTOOL_HIGHPRI.  This setting specifies
		period of the TIM6 interrupt in units of VIEWTOOL_TIM6_FREQUENCY.

endif # VIEWTOOL_HIGHPRI

if LCD_FT80X_SPI && ((STM32_SPI1 && !STM32_SPI1_REMAP) || STM32_SPI2)

choice
	prompt "FT80x SPI Selection"
	default VIEWTOOL_FT80X_SPI1 if STM32_SPI1 && !STM32_SPI1_REMAP
	default VIEWTOOL_FT80X_SPI2 if STM32_SPI2 && (!STM32_SPI1 || STM32_SPI1_REMAP)

config VIEWTOOL_FT80X_SPI1
	bool "FT80x on SPI1"
	depends on STM32_SPI1 && !STM32_SPI1_REMAP

config VIEWTOOL_FT80X_SPI2
	bool "FT80x on SPI2"
	depends on STM32_SPI2

endchoice # FT80x SPI Selection

config VIEWTOOL_FT80X_INITFREQUENCY
	int "FT80x initialization frequency"
	default 400000
	range 400000 11000000

config VIEWTOOL_FT80X_OPFREQUENCY
	int "FT80x operational frequency"
	default 20000000
	range 400000 30000000

endif # LCD_FT80X_SPI && ((STM32_SPI1 && !STM32_SPI1_REMAP) || STM32_SPI2)

if USBHOST_MAX3421E && ((STM32_SPI1 && !STM32_SPI1_REMAP) || STM32_SPI2)

choice
	prompt "MAX3421E SPI Selection"
	default VIEWTOOL_MAX3421E_SPI1 if STM32_SPI1 && !STM32_SPI1_REMAP && !VIEWTOOL_FT80X_SPI1
	default VIEWTOOL_MAX3421E_SPI2 if STM32_SPI2 && (!STM32_SPI1 || STM32_SPI1_REMAP) && !VIEWTOOL_FT80X_SPI2

config VIEWTOOL_MAX3421E_SPI1
	bool "MAX3421E on SPI1"
	depends on STM32_SPI1 && !STM32_SPI1_REMAP && !VIEWTOOL_FT80X_SPI1

config VIEWTOOL_MAX3421E_SPI2
	bool "MAX3421E on SPI2"
	depends on STM32_SPI2 && !VIEWTOOL_FT80X_SPI2

endchoice # MAX3421E SPI Selection

config VIEWTOOL_MAX3421E_FREQUENCY
	int "MAX3421E operational frequency"
	default 20000000
	range 400000 26000000

config VIEWTOOL_MAX3421E_RST
	bool "MAX3421E reset pin"
	default y

config VIEWTOOL_MAX3421E_PWR
	bool "USB Host power control"
	default n

config VIEWTOOL_MAX3421E_CONNMON_STACKSIZE
	int "MAX3421E USB connection monitor stack size"
	default DEFAULT_TASK_STACKSIZE

config VIEWTOOL_MAX3421E_CONNMON_PRIORITY
	int "MAX3421E USB connection monitor priority"
	default 100
	range 1 255

endif # USBHOST_MAX3421E && ((STM32_SPI1 && !STM32_SPI1_REMAP) || STM32_SPI2)
endif # ARCH_BOARD_VIEWTOOL_STM32F107
```

## boards/arm/stm32f103-minimum/Kconfig
```kconfig
#
# For a description of the syntax of this configuration file,
# see the file kconfig-language.txt in the NuttX tools repository.
#

if ARCH_BOARD_STM32F103_MINIMUM

choice
        prompt "Board type"
        default STM32F103MINIMUM_BLUEPILL

config STM32F103MINIMUM_BLUEPILL
        bool "Blue Pill/Red Pill/RoboDyn Black Pill"

config STM32F103MINIMUM_BLACKPILL
        bool "Black Pill"

endchoice

config STM32F103MINIMUM_AT24_BLOCKMOUNT
	bool "AT24 Serial EEPROM auto-mount"
	default n
	depends on NSH_ARCHINIT && STM32_I2C1 && MTD_AT24XX
	---help---
		Automatically initialize the AT24 I2C EEPROM driver when NSH starts.

choice
	prompt "AT24 serial EPPROM configuration"
	default STM32F103MINIMUM_AT24_FTL
	depends on STM32F103MINIMUM_AT24_BLOCKMOUNT

config STM32F103MINIMUM_AT24_FTL
	bool "Create AT24 block driver"
	---help---
		Create the MTD driver for the AT24 and "wrap" the AT24 as a standard
		block driver that could then, for example, be mounted using FAT or
		any other file system.  Any file system may be used, but there will
		be no wear-leveling.

config STM32F103MINIMUM_AT24_NXFFS
	bool "Create AT24 NXFFS file system"
	depends on FS_NXFFS
	---help---
		Create the MTD driver for the AT24 and mount the AT24 device as
		a wear-leveling, NuttX FLASH file system (NXFFS).  The downside of
		NXFFS is that it can be very slow.

endchoice # AT24 serial EPPROM configuration

config STM32F103MINIMUM_FLASH
	bool "MTD driver for external 4Mbyte W25Q32FV FLASH on SPI1"
	default n
	select MTD
	select MTD_W25
	select MTD_SMART
	select FS_SMARTFS
	select STM32_SPI1
	select MTD_BYTE_WRITE
	---help---
		Configures an MTD device for use with the onboard flash

config STM32F103MINIMUM_FLASH_MINOR
	int "Minor number for the FLASH /dev/smart entry"
	default 0
	depends on STM32F103MINIMUM_FLASH
	---help---
		Sets the minor number for the FLASH MTD /dev entry

config STM32F103MINIMUM_FLASH_PART
	bool "Enable partition support on FLASH"
	default y
	depends on STM32F103MINIMUM_FLASH
	select MTD_PARTITION
	---help---
		Enables creation of partitions on the FLASH

config STM32F103MINIMUM_FLASH_CONFIG_PART
	bool "Create application config data partition on FLASH"
	default n
	depends on STM32F103MINIMUM_FLASH_PART
	depends on PLATFORM_CONFIGDATA
	---help---
		Enables creation of a /dev/config partition on the FLASH

config STM32F103MINIMUM_FLASH_CONFIG_PART_NUMBER
	int "Index number of config partition (in list below)"
	default 0
	depends on STM32F103MINIMUM_FLASH_CONFIG_PART
	---help---
		Specifies the index number of the config data partition
		from the partition list.

config STM32F103MINIMUM_FLASH_PART_LIST
	string "Flash partition size list"
	default "1024,1024,1024,1024"
	depends on STM32F103MINIMUM_FLASH_PART
	---help---
		Comma separated list of partition sizes in KB.

config STM32F103MINIMUM_FLASH_PART_NAMES
	string "Flash partition name list"
	default "first,second,third,forth"
	depends on STM32F103MINIMUM_FLASH_PART
	depends on MTD_PARTITION_NAMES
	---help---
		Comma separated list of partition names.

config STM32F103MINIMUM_QETIMER
	int "Timer to use with QE encoder"
	default 4
	depends on SENSORS_QENCODER

endif
```

## boards/arm/stm32f2/emw3162/Kconfig
```kconfig
#
# For a description of the syntax of this configuration file,
# see the file kconfig-language.txt in the NuttX tools repository.
#

if ARCH_BOARD_EMW3162

config EMW3162_WLAN
	bool "Enable WLAN chip support"
	depends on IEEE80211_BROADCOM_FULLMAC_SDIO

endif
```

## boards/arm/stm32f2/photon/Kconfig
```kconfig
#
# For a description of the syntax of this configuration file,
# see the file kconfig-language.txt in the NuttX tools repository.
#

if ARCH_BOARD_PHOTON

config PHOTON_DFU_BOOTLOADER
	bool "Stock photon bootloader support"
	select STM32_DFU
	---help---
		Build image that can be uploaded using stock DFU bootloader.

config PHOTON_WDG
	bool

config PHOTON_IWDG
	bool "Photon iwdg kicker support"
	depends on STM32_IWDG
	depends on WATCHDOG
	select PHOTON_WDG

config PHOTON_IWDG_TIMEOUT
	int "Photon iwdg Timeout (ms)"
	default 32000
	depends on PHOTON_IWDG
	---help---
		Watchdog timeout value in milliseconds.

if PHOTON_WDG
config PHOTON_WDG_THREAD
	bool "Watchdog Daemon Thread"

if PHOTON_WDG_THREAD
config PHOTON_WDG_THREAD_NAME
	string "Watchdog Thread Name"
	default "wdog"

config PHOTON_WDG_THREAD_INTERVAL
	int "Watchdog Thread Interval (ms)"
	default 2500

config PHOTON_WDG_THREAD_PRIORITY
	int "Watchdog Thread Priority"
	default 200

config PHOTON_WDG_THREAD_STACKSIZE
	int "Watchdog Thread Stacksize"
	default 1024

endif # PHOTON_WDG_THREAD
endif # PHOTON_WDG

config PHOTON_WLAN
	bool "Enable WLAN chip support"
	depends on IEEE80211_BROADCOM_FULLMAC_SDIO

endif
```
