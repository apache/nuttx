## boards/risc-v/esp32c3-legacy/esp32c3-devkit-rust-1/Kconfig
```kconfig
#
# For a description of the syntax of this configuration file,
# see the file kconfig-language.txt in the NuttX tools repository.
#

if ARCH_BOARD_ESP32C3_DEVKIT_RUST1

config ESP32C3_DEVKIT_RUST1_RUN_IRAM
	bool "Run from IRAM"
	default n

endif # ARCH_BOARD_ESP32C3_DEVKIT_RUST1
```

## boards/risc-v/esp32c3-legacy/esp32c3-devkit/Kconfig
```kconfig
#
# For a description of the syntax of this configuration file,
# see the file kconfig-language.txt in the NuttX tools repository.
#

if ARCH_BOARD_ESP32C3_DEVKIT

if PM

config PM_ALARM_SEC
	int "PM_STANDBY delay (seconds)"
	default 15
	depends on PM
	---help---
		Number of seconds to wait in PM_STANDBY before going to PM_STANDBY mode.

config PM_ALARM_NSEC
	int "PM_STANDBY delay (nanoseconds)"
	default 0
	depends on PM
	---help---
		Number of additional nanoseconds to wait in PM_STANDBY before going to PM_STANDBY mode.

config PM_SLEEP_WAKEUP_SEC
	int "PM_SLEEP delay (seconds)"
	default 20
	depends on PM
	---help---
		Number of seconds to wait in PM_SLEEP.

config PM_SLEEP_WAKEUP_NSEC
	int "PM_SLEEP delay (nanoseconds)"
	default 0
	depends on PM
	---help---
		Number of additional nanoseconds to wait in PM_SLEEP.

endif # PM

config ESP32C3_DEVKIT_RUN_IRAM
	bool "Run from IRAM"
	default n

config ESP32C3_STORAGE_MTD_ENCRYPT
	bool "Encrypt Storage MTD partition"
	default y
	depends on ESP32C3_SECURE_FLASH_ENC_ENABLED

config ESP32C3_STORAGE_MTD_OFFSET
	hex "Storage MTD base address in SPI Flash"
	default 0x180000 if !ESP32C3_HAVE_OTA_PARTITION
	default 0x250000 if ESP32C3_HAVE_OTA_PARTITION
	depends on ESP32C3_MTD
	---help---
		MTD base address in SPI Flash.

config ESP32C3_STORAGE_MTD_SIZE
	hex "Storage MTD size in SPI Flash"
	default 0x100000
	depends on ESP32C3_MTD
	---help---
		MTD size in SPI Flash.

endif # ARCH_BOARD_ESP32C3_DEVKIT
```

## boards/risc-v/esp32c3/common/Kconfig
```kconfig
#
# For a description of the syntax of this configuration file,
# see the file kconfig-language.txt in the NuttX tools repository.
#

config ESPRESSIF_MERGE_BINS
	bool "Merge raw binary files into a single file"
	default n
	---help---
		Merge the raw binary files into a single file for flashing to the
		device.
		This is only useful when the path to binary files (e.g. bootloader)
		is provided via the ESPTOOL_BINDIR variable.

choice ESPRESSIF_SPIFLASH_FS
	prompt "Mount SPI Flash MTD on bring-up"
	default ESPRESSIF_SPIFLASH_SMARTFS
	depends on ESPRESSIF_MTD
	optional
	---help---
		Mount the SPI Flash MTD with the selected File System format on board
		bring-up.
		If not selected, the MTD will be registered as a device node on /dev.

config ESPRESSIF_SPIFLASH_SMARTFS
	bool "SmartFS"
	select FS_SMARTFS
	select MTD_SMART

config ESPRESSIF_SPIFLASH_NXFFS
	bool "NXFFS"
	select FS_NXFFS

config ESPRESSIF_SPIFLASH_SPIFFS
	bool "SPIFFS"
	select FS_SPIFFS

config ESPRESSIF_SPIFLASH_LITTLEFS
	bool "LittleFS"
	select FS_LITTLEFS

config ESPRESSIF_SPIFLASH_MTD_CONFIG
	bool "Non-volatile storage"

endchoice # ESPRESSIF_SPIFLASH_FS

config ESPRESSIF_SPIFLASH_FS_MOUNT_PT
	string "File-system Mount Point"
	depends on ESPRESSIF_SPIFLASH_LITTLEFS
	default "/data"
```

## boards/risc-v/esp32c3/esp32c3-devkit/Kconfig
```kconfig
#
# For a description of the syntax of this configuration file,
# see the file kconfig-language.txt in the NuttX tools repository.
#

if ARCH_BOARD_ESP32C3_DEVKIT

if PM

config PM_ALARM_SEC
	int "PM_STANDBY delay (seconds)"
	default 15
	depends on PM
	---help---
		Number of seconds to wait in PM_STANDBY before going to PM_STANDBY mode.

config PM_ALARM_NSEC
	int "PM_STANDBY delay (nanoseconds)"
	default 0
	depends on PM
	---help---
		Number of additional nanoseconds to wait in PM_STANDBY before going to PM_STANDBY mode.

config PM_SLEEP_WAKEUP_SEC
	int "PM_SLEEP delay (seconds)"
	default 20
	depends on PM
	---help---
		Number of seconds to wait in PM_SLEEP.

config PM_SLEEP_WAKEUP_NSEC
	int "PM_SLEEP delay (nanoseconds)"
	default 0
	depends on PM
	---help---
		Number of additional nanoseconds to wait in PM_SLEEP.

endif # PM

config ESP32C3_DEVKIT_RUN_IRAM
	bool "Run from IRAM"
	default n

config ESP32C3_MERGE_BINS
	bool "Merge raw binary files into a single file"
	default n
	---help---
		Merge the raw binary files into a single file for flashing to the
		device.
		This is only useful when the path to binary files (e.g. bootloader)
		is provided via the ESPTOOL_BINDIR variable.

choice ESP32C3_SPIFLASH_FS
	prompt "Mount SPI Flash MTD on bring-up"
	default ESP32C3_SPIFLASH_SMARTFS
	depends on ESP32C3_SPIFLASH
	optional
	---help---
		Mount the SPI Flash MTD with the selected File System format on board
		bring-up.
		If not selected, the MTD will be registered as a device node on /dev.

	config ESP32C3_SPIFLASH_SMARTFS
		bool "SmartFS"
		select FS_SMARTFS
		select MTD_SMART

	config ESP32C3_SPIFLASH_NXFFS
		bool "NXFFS"
		select FS_NXFFS

	config ESP32C3_SPIFLASH_SPIFFS
		bool "SPIFFS"
		select FS_SPIFFS

	config ESP32C3_SPIFLASH_LITTLEFS
		bool "LittleFS"
		select FS_LITTLEFS

endchoice

config ESP32C3_SPIFLASH_FS_MOUNT_PT
	string "File-system Mount Point"
	depends on ESP32C3_SPIFLASH_LITTLEFS
	default "/data"

if LCD_ST7735 || LCD_ST7789 || LCD_GC9A01

config ESP32C3_LCD_RSTPIN
	int "LCD reset pin"
	default 9

config ESP32C3_LCD_BLPIN
	int "LCD backlight pin"
	default 18

endif # LCD_ST7735 || LCD_ST7789 || LCD_GC9A01

endif # ARCH_BOARD_ESP32C3_DEVKIT
```

## boards/risc-v/esp32c6/esp32c6-devkit/Kconfig
```kconfig
#
# For a description of the syntax of this configuration file,
# see the file kconfig-language.txt in the NuttX tools repository.
#

if ARCH_BOARD_ESP32C6_DEVKIT

config ESP32C6_DEVKIT_RUN_IRAM
	bool "Run from IRAM"
	default n
	---help---

endif # ARCH_BOARD_ESP32C6_DEVKIT
```
