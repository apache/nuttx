## boards/risc-v/hpmicro/hpm6750evk2/Kconfig
```kconfig
#
# For a description of the syntax of this configuration file,
# see misc/tools/kconfig-language.txt.
#

if ARCH_BOARD_HPM6750EVK2

choice
	prompt "HPM6750EVK2 Build Type Selection"
	default HPM_BUILD_TYPE_DEBUG

config HPM_BUILD_TYPE_DEBUG
	bool "debug"

config HPM_BUILD_TYPE_FLASH_XIP
	bool "flash_xip"
	select INCLUDE_BOOTHEADER

config HPM_BUILD_TYPE_FLASH_SDRAM_XIP
	bool "flash_sdram_xip"
	select INCLUDE_BOOTHEADER

endchoice

config INCLUDE_BOOTHEADER
	bool
	default y

endif
```

## boards/risc-v/litex/arty_a7/Kconfig
```kconfig
#
# For a description of the syntax of this configuration file,
# see misc/tools/kconfig-language.txt.
#

if ARCH_BOARD_ARTY_A7


config LITEX_SDIO
	bool "SDIO"
	default n
	select SCHED_HPWORK
	select MMCSD
	select MMCSD_SDIO
	select SDIO_BLOCKSETUP
	select ARCH_HAVE_SDIO
	select SDIO_DMA

if LITEX_SDIO

config LITEX_SDIO1
	bool "Enable SDIO1"
	default LITEX_SDIO
	select LITEX_SDIO_DMA

config LITEX_IDMODE_FREQ
	int "ID mode frequency"
	default 400000
	---help---
		Initial, ID mode SD frequency

config LITEX_MMCXFR_FREQ
	int "MMC transfer frequency"
	default 25000000
	---help---
		Frequency to use for transferring data to/from an MMC card

config LITEX_SD4BIT_FREQ
	int "SD 4-bit transfer frequency"
	default 50000000
	---help---
		Frequency to use for transferring data to/from an SD card using all four data lines.

config LITEX_SDIO_MOUNT
	bool "Mount SDIO at startup"
	default n

config LITEX_SDIO_USE_CACHE
	bool "Use block caching"
	default n
	depends on LITEX_SDIO
	depends on BLOCK_CACHE
	---help---
		Use block caching to improvce SD performance.

		Warning: This may result in potential data loss if removable medio is detached
		without flushing the cache, via umount or other mechanisms.

		The total RAM consumed by caching can be calculated using:
			B * W * C
		where B = the underlying device's block size, W = the cache width and C is
		the number of caches.

if LITEX_SDIO_USE_CACHE

config	LITEX_SDIO_CACHE_WIDTH
	int "Block cache width"
	default 64
	---help---
		The width of a single cache window. This translates to the size of a single
		read-ahead buffer, and how many blocks are written to the underlying block
		device in a single transaction.

config	LITEX_SDIO_CACHE_COUNT
	int "Block cache count"
	default 16
	---help---
		The number of cache windows to use. Higher numbers improve performance by
		caching blocks at different offets in the underlying device.

config	LITEX_SDIO_CACHE_MULTIPLIER
	int "Block cache multiplier"
	default 1
	---help---
		Multiplies the underlying device's geometry to expose it in larger blocks.

endif

config LITEX_SDIO_MOUNT_BLKDEV
	string "SDIO block device name"
	default "/dev/mmcsd0"	 if !LITEX_SDIO_USE_CACHE
	default "/dev/bmmcsd0" if LITEX_SDIO_USE_CACHE
	depends on LITEX_SDIO

config LITEX_SDIO_MOUNT_MOUNTPOINT
	string "SDIO mountpoint"
	default "/mnt"

config LITEX_SDIO_MOUNT_FSTYPE
	string "SDIO file system type"
	default "vfat"

endif # LITEX_SDIO

config LITEX_APPLICATION_RAMDISK
	bool "Use application ramdisk"
	depends on BUILD_KERNEL
	---help---
		The application ramdisk is currently only intended only to hold
		application elfs in the romfs format. These applications must loaded
		externally into ram through litex_term, or similar method.

endif # ARCH_BOARD_ARTY_A7
```
