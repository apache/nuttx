## boards/risc-v/esp32p4/esp32p4-tab5/Kconfig
```kconfig
#
# For a description of the syntax of this configuration file,
# see the file kconfig-language.txt in the NuttX tools repository.
#

if ARCH_BOARD_ESP32P4_TAB5

config ESP32P4_TAB5_HMI_POWER
	bool
	default n

config ESP32P4_TAB5_IOEXPANDER
	bool "Enable the Tab5 board IO Expander"
	default n
	select ESPRESSIF_I2C0
	select IOEXPANDER
	select IOEXPANDER_PI4IOE5V6408
	---help---
		Enable support for the Tab5 board IO Expander.
		There are two IO Expanders on the this board.
		The first IO Expander is at address 0x43 (address pin low) and
		the second is at address 0x44 (address pin high).

if ESP32P4_TAB5_IOEXPANDER
	config ESP32P4_TAB5_IOEXPANDER_LOW
		bool "Enable the first IO Expander"
		default y
		---help---
			Enable the first IO Expander.

	config ESP32P4_TAB5_IOEXPANDER_HIGH
		bool "Enable the second IO Expander"
		default n
		---help---
			Enable the second IO Expander.
endif

config ESP32P4_TAB5_LCD_POWER
	bool "LCD / MIPI PHY power and reset path"
	default n
	select ESP32P4_TAB5_IOEXPANDER
	select ESP32P4_TAB5_HMI_POWER
	---help---
		At board bring-up (after I2C0 init), enable on-chip LDO channel 3
		at 2500 mV for VDD_MIPI_DPHY and raise LCD_EN on expander pin P4.

		This does NOT initialize the MIPI-DSI host, the LCD panel, or
		/dev/fb0 by itself.  Enable ESP32P4_TAB5_MIPI_DSI (and
		ESPRESSIF_MIPI_DSI) to register the host after this power path.
		Enable ESP32P4_TAB5_LCD for panel initialization + /dev/fb0.

config ESP32P4_TAB5_MIPI_DSI
	bool "Register MIPI-DSI host at bring-up"
	default n
	depends on ESP32P4_TAB5_LCD_POWER && ESPRESSIF_MIPI_DSI
	---help---
		After the LCD power path succeeds, call
		esp_mipi_dsi_initialize() so the generic MIPI-DSI host is
		registered (LP DCS/generic transfer ready).

		Does NOT run panel initialization or create /dev/fb0 by itself;
		enable ESP32P4_TAB5_LCD for that.

config ESP32P4_TAB5_LCD
	bool "LCD panel and /dev/fb0"
	default n
	depends on ESP32P4_TAB5_MIPI_DSI
	select DRIVERS_VIDEO
	select VIDEO_FB
	select FB_UPDATE
	---help---
		Bring up the selected Tab5 MIPI-DSI panel (M5Stack init table and
		720×1280 RGB565 timings), allocate a PSRAM framebuffer, bind it
		to the DSI bridge via DW-GDMA, and register /dev/fb0.

config ESP32P4_TAB5_LCD_APO_TEST
	bool "All-Pixels-On flash after FB bring-up"
	default y
	depends on ESP32P4_TAB5_LCD
	---help---
		After /dev/fb0 is ready, force All-Pixels-On for ~1 s, then
		All-Pixels-Off and restore the solid red test fill.

choice
	prompt "Tab5 LCD panel controller"
	default ESP32P4_TAB5_LCD_ST7121
	depends on ESP32P4_TAB5_LCD

config ESP32P4_TAB5_LCD_ST7121
	bool "ST7121"
	---help---
		Use the ST7121 initialization table and display timings.

config ESP32P4_TAB5_LCD_ST7123
	bool "ST7123"
	---help---
		Use the ST7123 initialization table and display timings.

config ESP32P4_TAB5_LCD_ILI9881C
	bool "ILI9881C"
	---help---
		Use the ILI9881C initialization table and display timings.  This is
		the panel fitted to the earlier Tab5 units, the ones that also carry
		the GT911 touch controller.

endchoice

config ESP32P4_TAB5_TOUCHSCREEN
	bool "Touch Screen Controller"
	default n
	select INPUT
	select ESP32P4_TAB5_HMI_POWER
	---help---
		Initialize the touch screen controller.

if ESP32P4_TAB5_TOUCHSCREEN

choice
	prompt "Touch screen controller"
	default ESP32P4_TAB5_TOUCH_ST7123

config ESP32P4_TAB5_TOUCH_ST7123
	bool "ST7123"
	select INPUT_ST7123
	---help---
		Sitronix ST7123, fitted to the Tab5 units that ship with the
		ST7121/ST7123 panel.  Answers on I2C address 0x55.

config ESP32P4_TAB5_TOUCH_GT911
	bool "GT911"
	select INPUT_GT9XX
	---help---
		Goodix GT911, fitted to the earlier Tab5 units.

endchoice

config ESP32P4_TAB5_TOUCH_GT911_ADDR
	hex "GT911 I2C address"
	depends on ESP32P4_TAB5_TOUCH_GT911
	default 0x14
	---help---
		The GT911 latches its I2C address from the INT pin while it is
		held in reset: either 0x14 or 0x5d.  Scan the bus with
		"i2c dev -b 0 0x03 0x77" if unsure.

endif # ESP32P4_TAB5_TOUCHSCREEN

endif # ARCH_BOARD_ESP32P4_TAB5
```

## boards/xtensa/esp32s3/esp32s3-r8/Kconfig
```kconfig
#
# For a description of the syntax of this configuration file,
# see the file kconfig-language.txt in the NuttX tools repository.
#

if ARCH_BOARD_ESP32S3_R8

config ESP32S3_STORAGE_MTD_OFFSET
	hex "Storage MTD base address in SPI Flash"
	default 0x180000
	depends on ESP32S3_MTD
	---help---
		MTD base address in SPI Flash.

config ESP32S3_STORAGE_MTD_SIZE
	hex "Storage MTD size in SPI Flash"
	default 0x100000
	range 0x0 0x400000 if ESP32S3_FLASH_4M
	range 0x0 0x800000 if ESP32S3_FLASH_8M
	range 0x0 0x1000000 if ESP32S3_FLASH_16M
	range 0x0 0x2000000 if ESP32S3_FLASH_32M
	depends on ESP32S3_MTD
	---help---
		MTD size in SPI Flash.

choice ESP32S3_SPIFLASH_FS
	prompt "Mount SPI Flash MTD on bring-up"
	default ESP32S3_SPIFLASH_SMARTFS
	depends on ESP32S3_MTD
	optional
	---help---
		Mount the SPI Flash MTD with the selected File System format on board
		bring-up.
		If not selected, the MTD will be registered as a device node on /dev.

config ESP32S3_SPIFLASH_SMARTFS
	bool "SmartFS"
	select FS_SMARTFS
	select MTD_SMART

config ESP32S3_SPIFLASH_NXFFS
	bool "NXFFS"
	select FS_NXFFS

config ESP32S3_SPIFLASH_SPIFFS
	bool "SPIFFS"
	select FS_SPIFFS

config ESP32S3_SPIFLASH_LITTLEFS
	bool "LittleFS"
	select FS_LITTLEFS

config ESP32S3_R8_LCD
	bool "Enable ESP32-S3-R8 LCD"
	default n
	select ESP32S3_SPI2
	select SPI_CMDDATA
	select LCD
	select LCD_DEV
	select LCD_ST7789
	---help---
		Enable board LCD support, IC is LCD_ST7789V.

config ESP32S3_R8_TOUCHSCREEN
	bool "Enable ESP32-S3-R8 touchscreen"
	default n
	select ESP32S3_I2C0
	select INPUT
	select INPUT_FT5X06
	---help---
		Enable the board FT5X06 touchscreen on I2C0.

config ESP32S3_R8_QMI8658
	bool "Enable ESP32-S3-R8 QMI8658 IMU"
	default n
	select ESP32S3_I2C0
	select SENSORS
	select SENSORS_QMI8658
	---help---
		Enable the board QMI8658 accelerometer and gyroscope on I2C0.

config ESP32S3_R8_AUDIO
	bool "Enable ESP32-S3-R8 audio"
	default n
	select DRIVERS_AUDIO
	select AUDIO
	select AUDIO_I2S
	select AUDIO_ES8311
	select AUDIO_ES7210
	select AUDIO_DRIVER_SPECIFIC_BUFFERS
	select ESP32S3_I2C0
	select ESP32S3_I2S
	select ESP32S3_I2S0
	---help---
		Enable board audio playback and capture support using ES8311 and ES7210.

endif # ARCH_BOARD_ESP32S3_R8
```

## drivers/misc/Kconfig
```kconfig
#
# For a description of the syntax of this configuration file,
# see the file kconfig-language.txt in the NuttX tools repository.
#

config DEV_SIMPLE_ADDRENV
	bool "Simple AddrEnv"
	default n

config DEV_NULL
	bool "Enable /dev/null"
	default !DEFAULT_SMALL

config DEV_ZERO
	bool "Enable /dev/zero"
	default !DEFAULT_SMALL

config DEV_MEM
	bool "Enable /dev/mem"
	default n
	---help---
		It is a full image of physical memory and can be used to
		access physical memory.

config DEV_ASCII
	bool "Enable /dev/ascii"
	default n
	---help---
		Enable the /dev/ascii device driver.  This is a character driver
		that will return all characters from 0x21-0x7f.

config DEV_RPMSG
	bool "RPMSG Device Client Support"
	default n
	depends on RPMSG

config DEV_RPMSG_SERVER
	bool "RPMSG Device Server Support"
	default n
	depends on RPMSG

if DEV_RPMSG_SERVER

config DEV_RPMSG_SERVER_WORK_PRIORITY
	int "Rpmsg Device Server Work Priority"
	default 224

config DEV_RPMSG_SERVER_WORK_STACKSIZE
	int "Rpmsg Device Server Work Stack Size"
	default DEFAULT_TASK_STACKSIZE

endif # DEV_RPMSG_SERVER

choice
	prompt "Select OP-TEE dev implementation"
	default DEV_OPTEE_NONE
	---help---
		There are three implementations of optee server,
		one is soft tee server which does not distinguish
		between secure and non-secure states and uses socket communication,
		and the other two is teeos which runs in the secure state of
		the cpu and uses either RPMsg cross-core communication or arm SMCs.
		Warning: SMC implementation has only been tested on arm64.

config DEV_OPTEE_LOCAL
	bool "OPTEE Local Socket Support"
	depends on NET_LOCAL
	depends on FS_ANONMAP
	depends on ALLOW_BSD_COMPONENTS

config DEV_OPTEE_RPMSG
	bool "OP-TEE RPMSG Socket Support"
	depends on NET_RPMSG
	depends on FS_ANONMAP
	depends on ALLOW_BSD_COMPONENTS

config DEV_OPTEE_SMC
	bool "OP-TEE SMC CC Support"
	depends on ARCH_ARM || ARCH_ARM64
	depends on FS_ANONMAP
	depends on ALLOW_BSD_COMPONENTS

config DEV_OPTEE_NONE
	bool "Disable OP-TEE driver"

endchoice

config DEV_OPTEE_SUPPLICANT
	bool "Enables kernel driver for TEE supplicant"
	default n
	depends on DEV_OPTEE_SMC

if DEV_OPTEE_RPMSG

config OPTEE_REMOTE_CPU_NAME
	string "The cpuname on which the OP-TEE server runs"
	default "tee"

endif # DEV_OPTEE_RPMSG

if DEV_OPTEE_SMC

choice
	prompt "Select OP-TEE conduit method"
	default DEV_OPTEE_SMC_CONDUIT_SMC
	---help---
		Select between the 2 supported conduit methods for invoking the secure
		world: SMC (when running at EL1) and HVC (when running at EL2, which is
		not supported by NuttX yet).

config DEV_OPTEE_SMC_CONDUIT_SMC
	bool "Use SMC calls to invoke OP-TEE"

config DEV_OPTEE_SMC_CONDUIT_HVC
	bool "Use HVC calls to invoke OP-TEE"

endchoice

endif # DEV_OPTEE_SMC

config DRVR_MKRD
	bool "RAM disk wrapper (mkrd)"
	default n
	---help---
		Build the mkrd() function which serves as a wrapper to simplify
		creation of RAM disks.  If the boardctrl() interface is enabled,
		the selecting this option will also enable the BOARDIOC_MKRD
		command that will support creation of RAM disks from applications.

config BLK_RPMSG
	bool "RPMSG Block Client Support"
	default n
	depends on RPMSG

config BLK_RPMSG_SERVER
	bool "RPMSG Block Server Support"
	default n
	depends on RPMSG

config GOLDFISH_PIPE
	bool "Goldfish Pipe Support"
	default n

# ARCH needs to support memory access while CPU is running to be able to use
# the LWL CONSOLE

config ARCH_HAVE_RDWR_MEM_CPU_RUN
	bool
	default n

config LWL_CONSOLE
	bool "Lightweight Link Console Support"
	default n
	depends on DEV_CONSOLE && ARCH_HAVE_RDWR_MEM_CPU_RUN && SERIAL
	---help---
		Use the lightweight link console which provides console over a
		debug channel by means of shared memory.  A terminal application
		for openocd as the debugger is available in tools/lwl/ocdconsole.py.
		See Documentation/guides/drivers/lwl.rst.

if LWL_CONSOLE

config LWL_CONSOLE_RXBUFSIZE
	int "Receive buffer size"
	default 64
	---help---
		Size of the buffer that holds the characters received from the
		host until they are read.  While it is full the host is held off,
		so no input is lost.

config LWL_CONSOLE_TXBUFSIZE
	int "Transmit buffer size"
	default 256
	---help---
		Size of the buffer that holds the characters waiting to be
		collected by the host.  While no host is connected the most recent
		output is kept here and shown when the host connects.

config LWL_CONSOLE_RINGSIZE
	int "Output ring buffer size"
	default 256
	---help---
		Size of the ring buffer in the control block from which the host
		collects the output, many bytes per debugger access instead of
		three per word.  This is what makes the output fast.  It must be
		a multiple of 4.  0 disables it: the output then only uses the
		word protocol, as with old host tools.

config LWL_CONSOLE_DOORBELL
	bool "Doorbell interrupt"
	default n
	---help---
		Let the host raise an interrupt every time it updates the link, by
		writing a register of the interrupt controller that makes an
		unused interrupt pending.  The console is then entirely interrupt
		driven: the CPU does no work at all while the console is idle.
		It requires a host that rings the doorbell, such as
		tools/lwl/ocdconsole.py.  Without the doorbell the link is polled,
		see LWL_CONSOLE_POLL_INTERVAL.

if LWL_CONSOLE_DOORBELL

config LWL_CONSOLE_DOORBELL_IRQ
	int "Doorbell IRQ number"
	---help---
		The NuttX IRQ number used as the doorbell.  It must be implemented
		by the chip but not used by any other driver.

config LWL_CONSOLE_DOORBELL_ADDR
	hex "Doorbell register address"
	default 0x0
	---help---
		Address of the register the host writes to make the doorbell IRQ
		pending.  The debugger must be able to write it while the CPU is
		running.  On ARMv6-M/ARMv7-M/ARMv8-M this is the NVIC Interrupt
		Set-Pending Register 0xe000e200 + 4 * ((IRQ - 16) / 32).  The
		interrupt handler writes 0 to it, which must either clear the
		request or have no effect.

config LWL_CONSOLE_DOORBELL_VALUE
	hex "Doorbell register value"
	default 0x0
	---help---
		Value the host writes to LWL_CONSOLE_DOORBELL_ADDR.  On
		ARMv6-M/ARMv7-M/ARMv8-M this is 1 << ((IRQ - 16) % 32).

endif # LWL_CONSOLE_DOORBELL

config LWL_CONSOLE_POLL_INTERVAL
	int "Polling interval (usec)"
	default 10000
	range 1 1000000
	depends on !LWL_CONSOLE_DOORBELL
	---help---
		Interval at which the link is polled while the console is open,
		when the doorbell is not used.  It works with any host, but the
		CPU wakes up at this rate and the output throughput is limited
		by it.

endif # LWL_CONSOLE

menu "Buffering"

config DRVR_WRITEBUFFER
	bool "Enable write buffer support"
	default n
	---help---
		Enable generic write buffering support that can be used by a variety
		of drivers.

if DRVR_WRITEBUFFER

config DRVR_WRDELAY
	int "Write flush delay"
	default 350
	---help---
		If there is no write activity for this configured amount of time,
		then the contents will be automatically flushed to the media.  This
		reduces the likelihood that data will be stuck in the write buffer
		at the time of power down.

endif # DRVR_WRITEBUFFER

config DRVR_READAHEAD
	bool "Enable read-ahead buffer support"
	default n
	---help---
		Enable generic read-ahead buffering support that can be used by a
		variety of drivers.

if DRVR_WRITEBUFFER || DRVR_READAHEAD

config DRVR_READBYTES
	bool "Support byte read method"
	default MTD_BYTE_WRITE

config DRVR_REMOVABLE
	bool "Support removable media"
	default n

config DRVR_INVALIDATE
	bool "Support cache invalidation"
	default n

endif # DRVR_WRITEBUFFER || DRVR_READAHEAD

endmenu # Buffering
```
