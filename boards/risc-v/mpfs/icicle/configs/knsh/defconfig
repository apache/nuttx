## boards/risc-v/rv32m1/rv32m1-vega/Kconfig
```kconfig
#
# For a description of the syntax of this configuration file,
# see misc/tools/kconfig-language.txt.
#

if ARCH_BOARD_RV32M1_VEGA

config RV32M1_OPENISA_TOOLCHAIN
	bool "Utilize OPEN ISA Toolchain"
	default n
	select ARCH_RISCV_INTXCPT_EXTENSIONS
	---help---
		With OPEN ISA Toolchain, RV32M1 RISC-V Core Capability can be exploited.

endif
```

## boards/sim/sim/sim/Kconfig
```kconfig
#
# For a description of the syntax of this configuration file,
# see the file kconfig-language.txt in the NuttX tools repository.
#

if ARCH_BOARD_SIM

config EXAMPLES_TOUCHSCREEN_BGCOLOR
	hex "Background color for apps/examples/touchscreen"
	default 0x007b68ee
	depends on EXAMPLES_TOUCHSCREEN

config SIM_RPTUN_MASTER
	bool "Remote Processor Tunneling Role"
	default n
	depends on RPTUN

if SIM_TOUCHSCREEN

comment "NX Server Options"

config SIM_LISTENER_STACKSIZE
	int "NX Server/Listener Stack Size"
	default DEFAULT_TASK_STACKSIZE
	---help---
		The stacksize to use when creating the NX server.  Default 2048

config SIM_CLIENTPRIO
	int "Client Priority"
	default 100
	---help---
		The client priority.  Default: 100

config SIM_SERVERPRIO
	int "Server Priority"
	default 120
	---help---
		The server priority.  Default: 120

config SIM_LISTENERPRIO
	int "Listener Priority"
	default 80
	---help---
		The priority of the event listener thread. Default 80.

config SIM_NOTIFYSIGNO
	int "Notify Signal Number"
	default 4
	---help---
		The signal number to use with nx_eventnotify().  Default: 4

endif

config SIM_WTGAHRS2_UARTN
	int "Wtgahrs2 sensor serial interface number"
	default -1
	depends on SENSORS_WTGAHRS2 && SIM_UART_NUMBER > 0
	---help---
		We can select the number according to which SIM_UARTX_NAME is used to sensor.
		This range is 0-4.

config SIM_I2CBUS_ID
	int "I2C host bus ID to attach to simulator"
	default 0
	depends on SIM_I2CBUS
	---help---
		This is the bus identifier that should be used by the host implementation to
		attach to the simulator driver.

config SIM_SPIDEV_NAME
	string "the name of SPI host dev to attach to simulator"
	default "/dev/spidev0.0"
	depends on SIM_SPI
	---help---
		This is the name of the SPI device on the host implementation to
		attach to the simulator driver.

endif
```
