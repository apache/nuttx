## drivers/crypto/Kconfig
```kconfig
############################################################################
# drivers/crypto/Kconfig
#
# SPDX-License-Identifier: Apache-2.0
#
# Licensed to the Apache Software Foundation (ASF) under one or more
# contributor license agreements.  See the NOTICE file distributed with
# this work for additional information regarding copyright ownership.  The
# ASF licenses this file to you under the Apache License, Version 2.0 (the
# "License"); you may not use this file except in compliance with the
# License.  You may obtain a copy of the License at
#
#   http://www.apache.org/licenses/LICENSE-2.0
#
# Unless required by applicable law or agreed to in writing, software
# distributed under the License is distributed on an "AS IS" BASIS, WITHOUT
# WARRANTIES OR CONDITIONS OF ANY KIND, either express or implied.  See the
# License for the specific language governing permissions and limitations
# under the License.
#
############################################################################
#
# For a description of the syntax of this configuration file,
# see the file kconfig-language.txt in the NuttX tools repository.
#

config ARCH_HAVE_RNG
	bool

config DEV_RANDOM
	bool "Enable /dev/random"
	default y
	depends on ARCH_HAVE_RNG
	---help---
		Enable support for /dev/random provided by a hardware TRNG.

config DEV_URANDOM
	bool "Enable /dev/urandom"
	default n
	---help---
		Enable support for /dev/urandom provided by either a hardware TRNG or
		by a software PRNG implementation.

		NOTE:  This option may not be cryptographially secure and should not
		be enabled if you are concerned about cyptographically secure
		pseudo-random numbers (CPRNG) and do not know the characteristics
		of the software PRNG implementation!

if DEV_URANDOM

choice
	prompt "/dev/urandom algorithm"
	default DEV_URANDOM_ARCH if ARCH_HAVE_RNG
	default DEV_URANDOM_XORSHIFT128 if !ARCH_HAVE_RNG

config DEV_URANDOM_XORSHIFT128
	bool "xorshift128"
	---help---
		xorshift128 is a pseudorandom number generator that is simple,
		portable, and can also be used on 8-bit and 16-bit MCUs.

		NOTE: Not cyptographically secure

config DEV_URANDOM_CONGRUENTIAL
	bool "Congruential"
	---help---
		Use the same PRNG used with srand()/rand().  Uses the system
		random number generator (xorshift32).

		NOTE: Not cryptographically secure

config DEV_URANDOM_RANDOM_POOL
	bool "Entropy pool"
	depends on CRYPTO_RANDOM_POOL
	---help---
		Use the entropy pool CPRNG output for urandom algorithm.

		NOTE: May or may not be cyptographically secure, depending upon the
		quality entropy available to entropy pool.

config DEV_URANDOM_ARCH
	bool "Architecture-specific"
	depends on ARCH_HAVE_RNG
	---help---
		The implementation of /dev/urandom is provided in archtecture-
		specific logic using hardware TRNG logic.  architecture-specific
		logic must provide the whole implementation in this case, including
		the function devurandom_register().  In this case, /dev/urandom may
		refer to the same driver as /dev/random.

		NOTE: May or may not be cyptographically secure, depending upon the
		implementation.

endchoice # /dev/urandom algorithm

endif # DEV_URANDOM

config CRYPTO_RPMSG
	bool "RPMSG Crypto Driver Client Support"
	default n
	depends on RPMSG
	depends on CRYPTO
	select CRYPTO_BACKENDS
	---help---
		Offload the NuttX crypto API to a remote core over rpmsg. The
		client core registers the transport as a crypto driver and
		forwards session and operation requests to the server core.

config CRYPTO_RPMSG_SERVER
	bool "RPMSG Crypto Driver Server Support"
	default n
	depends on RPMSG
	depends on CRYPTO
	select CRYPTO_BACKENDS
	---help---
		Execute the NuttX crypto API on behalf of a remote client core.
		The server core replays the requests received over the
		"rpmsg-crypto" endpoint against the local crypto backends
		(cryptosoft or hardware drivers).

config CRYPTO_RPMSG_SESSIONS_NUM
	int "Number of pre-allocated rpmsg crypto session slots"
	default 8
	depends on CRYPTO_RPMSG
	---help---
		Number of session slots pre-allocated at registration time for
		the rpmsg crypto client. The slot array has a fixed size and is
		never reallocated, because relocating it would move the embedded
		per-session semaphore and dangle any in-flight waiter and response
		handler cookie (use-after-free). Set this to the maximum number of
		concurrent crypto sessions plus in-flight async operations. When
		all slots are busy, new session requests fail with -ENOMEM.

config CRYPTO_RPMSG_CONNECT_TIMEOUT_MS
	int "Timeout (ms) waiting for rpmsg crypto server connection"
	default -1
	depends on CRYPTO_RPMSG
	---help---
		Maximum time in milliseconds to wait for the remote rpmsg crypto
		server endpoint to bind before returning -ENOTCONN. A value of -1
		means wait indefinitely (original behaviour).

config CRYPTO_RPMSG_RSA_KEYBUF_SIZE
	int "RSA key buffer size for rpmsg crypto"
	default 80
	---help---
		Size of the RSA key DER buffer used for ASN1 key encoding.
		This buffer holds DER-encoded key parameters. Recommended values:
		  80   - KeyID mode (4B per parameter + ASN1 overhead, 16-byte aligned)
		  1536 - Raw RSA-2048 CRT key (n+e+d+p+q+dp+dq+qp in plaintext)

config CRYPTO_RPMSG_DATA_POOL_COUNT
	int "Number of pre-allocated server data blocks"
	default 0
	depends on CRYPTO_RPMSG_SERVER
	---help---
		Number of rpmsg_crypto_server_data_s blocks pre-allocated in the
		static mempool. This pool eliminates runtime dynamic memory
		allocation on the crypto hot path. Set to the maximum number of
		concurrent crypto sessions plus in-flight async operations.

menuconfig DEV_SE05X
	bool "Enable secure element (SE05X)"
	depends on I2C
	depends on CRYPTO
	default n
	---help---
		Enable support for /dev/se05x secure element provided by NXP SE050
		or SE051

if DEV_SE05X

choice
	prompt "Channel communication interface"
	default DEV_SE05X_PLAIN
	---help---
		Select authentication method

config DEV_SE05X_SCP03
	bool "SCP03 secure channel (TBI)"
	select CRYPTO_RANDOM_POOL
	select CRYPTO_AES

config DEV_SE05X_PLAIN
	bool "plain communication"

endchoice # Channel communication interface

config DEV_SE05X_SCP03_KEY_FILE
	string "SCP03 keys"
	depends on DEV_SE05X_SCP03
	default "/host/path/to/key_file"
	---help---
		Specify file containing the keys needed with SCP03 channel authentication.
		Location may be relative to the NuttX root folder. File should contain
		the definitions for SCP03_ENC_KEY, SCP03_MAC_KEY and SCP03_DEK_KEY as
		byte array initializers.

choice SE05X_LOG_LEVEL
	prompt "SE05x debug log level"
	default SE05X_LOG_NONE
	---help---
		The SE05x log is divided into the following levels: ERROR,WARNING,INFO,DEBUG.

config SE05X_LOG_NONE
	bool "No output"

config SE05X_LOG_ERROR
	bool "Error"

config SE05X_LOG_WARNING
	bool "Warning"

config SE05X_LOG_INFO
	bool "Info"

config SE05X_LOG_DEBUG
	bool "Debug"

endchoice # SE05x debug log level

endif #DEV_SE05X

config DEV_RNG90
	bool "Enable Microchip RNG90 TRNG"
	depends on I2C
	depends on CRYPTO
	default n
	---help---
		Enable support for /dev/rng90 random number generator provided by
		Microchip RNG90 TRNG.
```
