## boards/mips/pic32mx/mirtoo/Kconfig
```kconfig
#
# For a description of the syntax of this configuration file,
# see the file kconfig-language.txt in the NuttX tools repository.
#

if ARCH_BOARD_MIRTOO

config MIRTOO_RELEASE
	int "Mirtoo release number"
	default 2
	---help---
		Select the Mirtoo release number.  For example, 1 for release R1.

endif
```

## boards/mips/pic32mz/flipnclick-pic32mz/Kconfig
```kconfig
#
# For a description of the syntax of this configuration file,
# see the file kconfig-language.txt in the NuttX tools repository.
#

if ARCH_BOARD_FLIPNCLICK_PIC32MZ

config FLIPNCLICK_PIC32MZ_SSD1306
	bool "SSD1306 Click Present"
	default n
	depends on LCD_SSD1306
	select NXSTART_EXTERNINIT if NX

choice
	prompt "SSD1306 mikroBUS"
	default FLIPNCLICK_PIC32MZ_SSD1306_MBA
	depends on FLIPNCLICK_PIC32MZ_SSD1306

config FLIPNCLICK_PIC32MZ_SSD1306_MBA
	bool "mikroBUS A"

config FLIPNCLICK_PIC32MZ_SSD1306_MBB
	bool "mikroBUS B"

config FLIPNCLICK_PIC32MZ_SSD1306_MBC
	bool "mikroBUS C"

config FLIPNCLICK_PIC32MZ_SSD1306_MBD
	bool "mikroBUS D"

endchoice # SSD1306 mikroBUS

endif # ARCH_BOARD_FLIPNCLICK_PIC32MZ
```

## boards/renesas/rx65n/rx65n-rsk1mb/configs/netnsh/defconfig
```kconfig
# CONFIG_NSH_DISABLE_IFCONFIG is not set
# CONFIG_NSH_DISABLE_PS is not set
CONFIG_ARCH_BOARD_RX65N=y
#CONFIG_ARCH_BOARD_RX65N_RSK1MB=y
CONFIG_ARCH_BOARD="rx65n"
CONFIG_ARCH_CHIP_R5F565NEDDFC=y
CONFIG_ARCH_RENESAS=y
CONFIG_ARCH_STACKDUMP=y
CONFIG_ARCH="renesas"
#CONFIG_BOARD_LOOPSPERMSEC=572
#CONFIG_DISABLE_MOUNTPOINT=y
#CONFIG_DISABLE_MQUEUE=y
#CONFIG_DISABLE_POLL=y
#CONFIG_DISABLE_POSIX_TIMERS=y
#CONFIG_DISABLE_PTHREAD=y
#CONFIG_DISABLE_SIGNALS=y
CONFIG_MOTOROLA_SREC=y
CONFIG_ENDIAN_LITTLE=y
CONFIG_SYSTEM_NSH=y
CONFIG_MAX_TASKS=8
CONFIG_DEBUG_FEATURES=y
CONFIG_ARCH_INTERRUPTSTACK=1024
CONFIG_BUILTIN=y
CONFIG_ETH0_PHY_KSZ8081=y
CONFIG_NET=y
#CONFIG_NETDEV_LATEINIT=y
CONFIG_NETDB_DNSCLIENT=y
CONFIG_NETDB_DNSSERVER_NOADDR=y
CONFIG_NETDEV_PHY_IOCTL=y
CONFIG_NETDEV_STATISTICS=y
#CONFIG_NETUTILS_TELNETD=y
CONFIG_NETUTILS_TFTPC=y
CONFIG_NETUTILS_WEBCLIENT=y
CONFIG_NET_ARP_SEND=y
CONFIG_NET_BROADCAST=y
CONFIG_NET_ICMP=y
CONFIG_NET_ICMP_SOCKET=y
CONFIG_NET_SOCKOPTS=y
CONFIG_NET_STATISTICS=y
CONFIG_NET_TCP=y
CONFIG_NET_TCPBACKLOG=y
CONFIG_NET_TCP_WRITE_BUFFERS=y
CONFIG_NET_UDP=y
CONFIG_NSH_BUILTIN_APPS=y
CONFIG_NFILE_DESCRIPTORS=8
CONFIG_NFILE_STREAMS=8
#CONFIG_NSH_CONSOLE_LOGIN=y
CONFIG_NSH_FILEIOSIZE=512
CONFIG_NSH_LINELEN=64
CONFIG_PREALLOC_TIMERS=0
CONFIG_PTHREAD_STACK_DEFAULT=1024
CONFIG_RAM_SIZE=655360
CONFIG_RAM_START=0x00000000
CONFIG_RAW_BINARY=y

#CONFIG_SCI0_SERIALDRIVER=y
#CONFIG_SCI0_SERIAL_CONSOLE=y
#CONFIG_RX65N_SCI0=y
#CONFIG_SCI1_SERIALDRIVER=y
#CONFIG_SCI1_SERIAL_CONSOLE=y
#CONFIG_RX65N_SCI1=y
CONFIG_SCI2_SERIALDRIVER=y
CONFIG_SCI2_SERIAL_CONSOLE=y
CONFIG_RX65N_SCI2=y
#CONFIG_SCI8_SERIALDRIVER=y
#CONFIG_SCI8_SERIAL_CONSOLE=y
#CONFIG_RX65N_SCI8=y

CONFIG_RX65N_EMAC=y
CONFIG_RX65N_EMAC0=y
CONFIG_RX65N_EMAC0_PHYSR=30
CONFIG_RX65N_EMAC0_PHYSR_100FD=0x6
CONFIG_RX65N_EMAC0_PHYSR_100HD=0x2
CONFIG_RX65N_EMAC0_PHYSR_10FD=0x5
CONFIG_RX65N_EMAC0_PHYSR_10HD=0x1
CONFIG_RX65N_EMAC0_PHYSR_ALTCONFIG=y
CONFIG_RX65N_EMAC0_PHYSR_ALTMODE=0x7
CONFIG_RX65N_EMAC0_MII=y
CONFIG_RX65N_EMAC0_PHYADDR=30

CONFIG_SCHED_WORKQUEUE=y
CONFIG_SCHED_HPWORK=y
CONFIG_SCHED_LPWORK=y

CONFIG_SDCLONE_DISABLE=y
CONFIG_SYSTEM_PING=y
CONFIG_ICU=y
CONFIG_STDIO_DISABLE_BUFFERING=y
CONFIG_TASK_NAME_SIZE=0
CONFIG_USER_ENTRYPOINT="nsh_main"
CONFIG_USERMAIN_STACKSIZE=1024

CONFIG_FS_PROCFS=y
CONFIG_FS_PROCFS_REGISTER=y
CONFIG_NET_ETH_PKTSIZE = 1518
CONFIG_RX65N_CMT2=y
CONFIG_RX65N_CMT3=y
CONFIG_RX65N_PERIB=y

#CONFIG_NET_IPv6=y
#CONFIG_NET_ICMPv6=y
#CONFIG_NET_MCASTGROUP=y
```
