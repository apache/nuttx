## boards/x86_64/intel64/qemu-intel64/Kconfig
```kconfig
#
# For a description of the syntax of this configuration file,
# see the file kconfig-language.txt in the NuttX tools repository.
#
#
config QEMU_PCI
	bool "Initialize and enumerate PCI Bus"
	default n
	select PCI

	---help---
		Enables initialization and scanning of standard x86-64 pci bus.
```

## boards/xtensa/esp32-core/Kconfig
```kconfig
#
# For a description of the syntax of this configuration file,
# see the file kconfig-language.txt in the NuttX tools repository.
#

if ARCH_BOARD_ESP32CORE

choice
	prompt "On-board Crystal Frequency"
	default ESP32CORE_XTAL_40MZ

config ESP32CORE_XTAL_40MZ
	bool "40MHz"

config ESP32CORE_XTAL_26MHz
	bool "26MHz"

endchoice # On-board Crystal Frequency

config ESP32CORE_RUN_IRAM
	bool "Run from IRAM"
	default n
	---help---
		The default configuration is set up run from IRAM.  However, the
		current (2016-11-14) OpenOCD for ESP32 does not support writing to
		FLASH.  This option sets up the linker scripts to support execution
		from IRAM.  In this case, OpenOCD can be used to load directly into
		IRAM.

		At this stage the nuttx image is small enough to be entirely memory-
		resident.  Once board support is more mature you can add flash cache
		mapping code to run from SPI flash after initial boot. There are at
		least two possible approaches you could take: You can add the flash
		cache mapping code into nuttx directly, so it is self-contained -
		early nuttx initialization runs from IRAM and enables flash cache,
		and then off you go. Or you can use the esp-idf software bootloader
		and partition table scheme and have nuttx be an esp-idf "app" which
		allows interoperability with the esp-idf system but makes you
		reliant on the esp-idf design for these parts. Both are possible.

endif # ARCH_BOARD_ESP32CORE
```

## boards/xtensa/esp32/common/Kconfig
```kconfig
#
# For a description of the syntax of this configuration file,
# see the file kconfig-language.txt in the NuttX tools repository.
#

config ESP32_MERGE_BINS
	bool "Merge raw binary files into a single file"
	default n
	---help---
		Merge the raw binary files into a single file for flashing to the
		device.
		This is only useful when the path to binary files (e.g. bootloader)
		is provided via the ESPTOOL_BINDIR variable.

config ESP32_QEMU_IMAGE
	bool "ESP32 binary image for QEMU"
	default n
	select ESP32_MERGE_BINS
	---help---
		Create a binary flash image used for QEMU.

choice ESP32_SPIFLASH_FS
	prompt "Mount SPI Flash MTD on bring-up"
	default ESP32_SPIFLASH_SMARTFS
	depends on ESP32_SPIFLASH
	optional
	---help---
		Mount the SPI Flash MTD with the selected File System format on board
		bring-up.
		If not selected, the MTD will be registered as a device node on /dev.

	config ESP32_SPIFLASH_SMARTFS
		bool "SmartFS"
		select FS_SMARTFS
		select MTD_SMART
		depends on !ESP32_SECURE_FLASH_ENC_ENABLED

	comment "SmartFS not supported with Flash Encryption"
		depends on ESP32_SECURE_FLASH_ENC_ENABLED

	config ESP32_SPIFLASH_NXFFS
		bool "NXFFS"
		select FS_NXFFS
		depends on !ESP32_SECURE_FLASH_ENC_ENABLED

	comment "NXFFS not supported with Flash Encryption"
		depends on ESP32_SECURE_FLASH_ENC_ENABLED

	config ESP32_SPIFLASH_SPIFFS
		bool "SPIFFS"
		select FS_SPIFFS
		depends on !ESP32_SECURE_FLASH_ENC_ENABLED

	comment "SPIFFS not supported with Flash Encryption"
		depends on ESP32_SECURE_FLASH_ENC_ENABLED

	config ESP32_SPIFLASH_LITTLEFS
		bool "LittleFS"
		select FS_LITTLEFS

endchoice

if LCD_SSD1680
config SSD1680_GPIO_PIN_RST
	int "Pin that handles the reset line (output)"
	default "12" if ARCH_BOARD_TTGO_T5V2_ESP32

config SSD1680_GPIO_PIN_BUSY
	int "Pin that handles the busy line (input)"
	default "4" if ARCH_BOARD_TTGO_T5V2_ESP32

config SSD1680_GPIO_PIN_PWR
	int "Pin that handles the pwr on/off line (output)"
	default "-1" if ARCH_BOARD_TTGO_T5V2_ESP32

config SSD1680_GPIO_PIN_CS
	int "Pin that select the chip on SPI bus"
	default "5" if ARCH_BOARD_TTGO_T5V2_ESP32

config SSD1680_GPIO_PIN_DTA_CMD
	int "Pin that switch between command and data on 4-wire SPI bus"
	default "19" if ARCH_BOARD_TTGO_T5V2_ESP32

config SSD1680_SPI_BUS
	int "Spi Bus Number"
	range 2 3
	default "3"
	depends on ESP32_SPI

endif #LCD_SSD1680

config ESP32_LCD_OVERCLOCK
	bool "Run LCD at higher clock speed than allowed"
	default n
	depends on LCD_ILI9341
	---help---
		The ILI9341 and ST7789 specify that the maximum clock speed for the
		SPI interface is 10MHz. However, in practice the driver chips work
		fine with a higher clock rate, and using that gives a better
		framerate. Select this to try using the out-of-spec clock rate.
```

## boards/xtensa/esp32/esp32-core/Kconfig
```kconfig
#
# For a description of the syntax of this configuration file,
# see the file kconfig-language.txt in the NuttX tools repository.
#

if ARCH_BOARD_ESP32CORE

choice
	prompt "On-board Crystal Frequency"
	default ESP32CORE_XTAL_40MZ

config ESP32CORE_XTAL_40MZ
	bool "40MHz"

config ESP32CORE_XTAL_26MHz
	bool "26MHz"

endchoice # On-board Crystal Frequency

config ESP32CORE_RUN_IRAM
	bool "Run from IRAM"
	default n
	---help---
		The default configuration is set up run from IRAM.  However, the
		current (2016-11-14) OpenOCD for ESP32 does not support writing to
		FLASH.  This option sets up the linker scripts to support execution
		from IRAM.  In this case, OpenOCD can be used to load directly into
		IRAM.

		At this stage the nuttx image is small enough to be entirely memory-
		resident.  Once board support is more mature you can add flash cache
		mapping code to run from SPI flash after initial boot. There are at
		least two possible approaches you could take: You can add the flash
		cache mapping code into nuttx directly, so it is self-contained -
		early nuttx initialization runs from IRAM and enables flash cache,
		and then off you go. Or you can use the esp-idf software bootloader
		and partition table scheme and have nuttx be an esp-idf "app" which
		allows interoperability with the esp-idf system but makes you
		reliant on the esp-idf design for these parts. Both are possible.

config ESP32CORE_FLASH_IMAGE
	bool "esp32 flash image"
	default n
	---help---
		Create flash_image.bin mainly used for QEMU.

choice
  prompt "SPIFLASH File System"
  default ESP32_SPIFLASH_SMARTFS
  depends on ESP32_SPIFLASH

  config ESP32_SPIFLASH_SMARTFS
        bool "SmartFS"
        depends on FS_SMARTFS
  config ESP32_SPIFLASH_NXFFS
        bool "NXFFS"
        depends on FS_NXFFS
  config ESP32_SPIFLASH_SPIFFS
        bool "SPIFFS"
        depends on FS_SPIFFS
  config ESP32_SPIFLASH_LITTLEFS
        bool "LittleFS"
        depends on FS_LITTLEFS
endchoice

if PM

config PM_ALARM_SEC
	int "PM_STANDBY delay (seconds)"
	default 15
	depends on PM
	---help---
		Number of seconds to wait in PM_STANDBY before going to PM_STANDBY mode.

config PM_ALARM_NSEC
	int "PM_STANDBY delay (nanoseconds)"
	default 0
	depends on PM
	---help---
		Number of additional nanoseconds to wait in PM_STANDBY before going to PM_STANDBY mode.

config PM_SLEEP_WAKEUP_SEC
	int "PM_SLEEP delay (seconds)"
	default 20
	depends on PM
	---help---
		Number of seconds to wait in PM_SLEEP.

config PM_SLEEP_WAKEUP_NSEC
	int "PM_SLEEP delay (nanoseconds)"
	default 0
	depends on PM
	---help---
		Number of additional nanoseconds to wait in PM_SLEEP.

endif # PM

endif # ARCH_BOARD_ESP32CORE
```
