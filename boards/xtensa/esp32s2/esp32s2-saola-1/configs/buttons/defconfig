## boards/xtensa/esp32s3/common/Kconfig
```kconfig
#
# For a description of the syntax of this configuration file,
# see the file kconfig-language.txt in the NuttX tools repository.
#

config ESP32S3_MERGE_BINS
	bool "Merge raw binary files into a single file"
	default n
	---help---
		Merge the raw binary files into a single file for flashing to the
		device.
		This is only useful when the path to binary files (e.g. bootloader)
		is provided via the ESPTOOL_BINDIR variable.

config ESP32S3_QEMU_IMAGE
	bool "ESP32S3 binary image for QEMU"
	default n
	select ESP32S3_MERGE_BINS
	---help---
		Create a binary flash image used for QEMU.

config ESP32S3_SPEED_UP_ISR
	bool "Speed up ISR"
	default n
	---help---
		Move ESP32-S3's interrupt, OS timer tick, and scheduler functions
		from Flash to IRAM. This can speed up interrupt service processing
		and also reduce reading data from Flash.

		If you run applications that need continue reading data from PSRAM,
		such as LCD display, please select this option.

config ESP32S3_STORAGE_MTD_OFFSET
	hex "Storage MTD base address in SPI Flash"
	default 0x180000 if !ESP32S3_HAVE_OTA_PARTITION
	default 0x250000 if ESP32S3_HAVE_OTA_PARTITION
	depends on ESP32S3_MTD
	---help---
		MTD base address in SPI Flash.

config ESP32S3_STORAGE_MTD_SIZE
	hex "Storage MTD size in SPI Flash"
	default 0x100000
	range 0x0 0x400000 if ESP32S3_FLASH_4M
	range 0x0 0x800000 if ESP32S3_FLASH_8M
	range 0x0 0x1000000 if ESP32S3_FLASH_16M
	range 0x0 0x2000000 if ESP32S3_FLASH_32M
	depends on ESP32S3_MTD
	---help---
		MTD size in SPI Flash.

choice ESP32S3_SPIFLASH_FS
	prompt "Mount SPI Flash MTD on bring-up"
	default ESP32S3_SPIFLASH_SMARTFS
	depends on ESP32S3_MTD
	optional
	---help---
		Mount the SPI Flash MTD with the selected File System format on board
		bring-up.
		If not selected, the MTD will be registered as a device node on /dev.

config ESP32S3_SPIFLASH_SMARTFS
	bool "SmartFS"
	select FS_SMARTFS
	select MTD_SMART

config ESP32S3_SPIFLASH_NXFFS
	bool "NXFFS"
	select FS_NXFFS

config ESP32S3_SPIFLASH_SPIFFS
	bool "SPIFFS"
	select FS_SPIFFS

config ESP32S3_SPIFLASH_LITTLEFS
	bool "LittleFS"
	select FS_LITTLEFS

endchoice # ESP32S3_SPIFLASH_FS

if PM

config PM_EXT1_WAKEUP
	bool "PM EXT1 Wakeup"
	default n
	---help---
		Enable EXT1 wakeup functionality.
		This allows the system to wake up from PM_STANDBY or PM_SLEEP
		when a GPIO pin configured as an EXT1 wakeup source is triggered.

if PM_EXT1_WAKEUP

menu "PM EXT1 Wakeup Sources"

config PM_EXT1_WAKEUP_RTC_GPIO0
	bool "RTC_GPIO0"
	default n
	---help---
		Enable RTC GPIO0 as an EXT1 wakeup source.

config PM_EXT1_WAKEUP_RTC_GPIO1
	bool "RTC_GPIO1"
	default n
	---help---
		Enable RTC GPIO1 as an EXT1 wakeup source.

config PM_EXT1_WAKEUP_RTC_GPIO2
	bool "RTC_GPIO2"
	default n
	---help---
		Enable RTC GPIO2 as an EXT1 wakeup source.

config PM_EXT1_WAKEUP_RTC_GPIO3
	bool "RTC_GPIO3"
	default n
	---help---
		Enable RTC GPIO3 as an EXT1 wakeup source.

config PM_EXT1_WAKEUP_RTC_GPIO4
	bool "RTC_GPIO4"
	default n
	---help---
		Enable RTC GPIO4 as an EXT1 wakeup source.

config PM_EXT1_WAKEUP_RTC_GPIO5
	bool "RTC_GPIO5"
	default n
	---help---
		Enable RTC GPIO5 as an EXT1 wakeup source.

config PM_EXT1_WAKEUP_RTC_GPIO6
	bool "RTC_GPIO6"
	default n
	---help---
		Enable RTC GPIO6 as an EXT1 wakeup source.

config PM_EXT1_WAKEUP_RTC_GPIO7
	bool "RTC_GPIO7"
	default n
	---help---
		Enable RTC GPIO7 as an EXT1 wakeup source.

config PM_EXT1_WAKEUP_RTC_GPIO8
	bool "RTC_GPIO8"
	default n
	---help---
		Enable RTC GPIO8 as an EXT1 wakeup source.

config PM_EXT1_WAKEUP_RTC_GPIO9
	bool "RTC_GPIO9"
	default n
	---help---
		Enable RTC GPIO9 as an EXT1 wakeup source.

config PM_EXT1_WAKEUP_RTC_GPIO10
	bool "RTC_GPIO10"
	default n
	---help---
		Enable RTC GPIO10 as an EXT1 wakeup source.

config PM_EXT1_WAKEUP_RTC_GPIO11
	bool "RTC_GPIO11"
	default n
	---help---
		Enable RTC GPIO11 as an EXT1 wakeup source.

config PM_EXT1_WAKEUP_RTC_GPIO12
	bool "RTC_GPIO12"
	default n
	---help---
		Enable RTC GPIO12 as an EXT1 wakeup source.

config PM_EXT1_WAKEUP_RTC_GPIO13
	bool "RTC_GPIO13"
	default n
	---help---
		Enable RTC GPIO13 as an EXT1 wakeup source.

config PM_EXT1_WAKEUP_RTC_GPIO14
	bool "RTC_GPIO14"
	default n
	---help---
		Enable RTC GPIO14 as an EXT1 wakeup source.

config PM_EXT1_WAKEUP_RTC_GPIO15
	bool "RTC_GPIO15"
	default n
	---help---
		Enable RTC GPIO15 as an EXT1 wakeup source.

config PM_EXT1_WAKEUP_RTC_GPIO16
	bool "RTC_GPIO16"
	default n
	---help---
		Enable RTC GPIO16 as an EXT1 wakeup source.

config PM_EXT1_WAKEUP_RTC_GPIO17
	bool "RTC_GPIO17"
	default n
	---help---
		Enable RTC GPIO17 as an EXT1 wakeup source.

config PM_EXT1_WAKEUP_RTC_GPIO18
	bool "RTC_GPIO18"
	default n
	---help---
		Enable RTC GPIO18 as an EXT1 wakeup source.

config PM_EXT1_WAKEUP_RTC_GPIO19
	bool "RTC_GPIO19"
	default n
	---help---
		Enable RTC GPIO19 as an EXT1 wakeup source.

config PM_EXT1_WAKEUP_RTC_GPIO20
	bool "RTC_GPIO20"
	default n
	---help---
		Enable RTC GPIO20 as an EXT1 wakeup source.

endmenu # PM_EXT1_WAKEUP_SOURCES


config PM_EXT1_WAKEUP_TRIGGER_MODE
	int "PM EXT1 Wakeup Trigger Mode"
	range 0 1
	default 0
	---help---
		Select EXT1 wakeup mode:
		0 = Wakeup when any selected GPIO is LOW
		1 = Wakeup when any selected GPIO is HIGH

endif # PM_EXT1_WAKEUP

config PM_ULP_WAKEUP
	bool "PM ULP Wakeup"
	default n
	---help---
		Enable ULP RISC-V coprocessor wakeup functionality.
		This allows the system to wake up from PM_STANDBY or PM_SLEEP
		when ULP app triggers HP core to wakeup with "ulp_riscv_wakeup_main_processor"
		call on ULP app.

config PM_ALARM_SEC
	int "PM_STANDBY delay (seconds)"
	default 15
	---help---
		Number of seconds to wait in PM_STANDBY before going to PM_STANDBY mode.

config PM_ALARM_NSEC
	int "PM_STANDBY delay (nanoseconds)"
	default 0
	---help---
		Number of additional nanoseconds to wait in PM_STANDBY before going to PM_STANDBY mode.

config PM_SLEEP_WAKEUP_SEC
	int "PM_SLEEP delay (seconds)"
	default 20
	---help---
		Number of seconds to wait in PM_SLEEP.

config PM_SLEEP_WAKEUP_NSEC
	int "PM_SLEEP delay (nanoseconds)"
	default 0
	---help---
		Number of additional nanoseconds to wait in PM_SLEEP.

endif # PM

config ESP32S3_BOARD_I2C
	bool
	default y if ESP32S3_I2C0 || ESP32S3_I2C1

config ESPRESSIF_ULP_USE_TEST_BIN
	bool "Run example prebuilt binary for ULP core"
	depends on ESPRESSIF_USE_ULP_RISCV_CORE
	default n
	---help---
		Run example prebuilt binary for ULP core which is resides in
		`Documentation/platforms/xtensa/esp32s3/boards/esp32s3-devkit/ulp_riscv_blink.bin`
```

## boards/xtensa/esp32s3/esp32s3-8048S043/Kconfig
```kconfig
#
# For a description of the syntax of this configuration file,
# see the file kconfig-language.txt in the NuttX tools repository.
#

if ARCH_BOARD_ESP32S3_8048S043

config ESP32S3_BOARD_LCD
	bool "Enable Board LCD"
	default n
	depends on ESP32S3_LCD
	---help---
		Enable board LCD support.

config ESP32S3_BOARD_TOUCHSCREEN
	bool "Enable Board Touchscreen"
	default n
	select ESP32S3_I2C0
	select INPUT
	select INPUT_TOUCHSCREEN
	select INPUT_GT9XX
	---help---
		Enable board touchscreen support, IC is: GT911

menu "Board Touchscreen Configuration"
	depends on ESP32S3_BOARD_TOUCHSCREEN

config ESP32S3_BOARD_TOUCHSCREEN_PATH
	string "Touchscreen Path for VFS"
	default "/dev/input0"

config ESP32S3_BOARD_TOUCHSCREEN_WIDTH
	int "Touchscreen Width"
	default 800
	depends on ESP32S3_8048S043

config ESP32S3_BOARD_TOUCHSCREEN_HEIGHT
	int "Touchscreen Height"
	default 480
	depends on ESP32S3_8048S043

config ESP32S3_BOARD_TOUCHSCREEN_SAMPLE_CACHES
	int "Touchscreen Sample Cache Number"
	default 64

config ESP32S3_BOARD_TOUCHSCREEN_SAMPLE_DELAYS
	int "Touchscreen Sample Delay Ticks"
	default 20

config ESP32S3_BOARD_TOUCHSCREEN_X_MIRROR
	bool "Touchscreen X Mirror"
	default y
	depends on ESP32S3_8048S043

config ESP32S3_BOARD_TOUCHSCREEN_Y_MIRROR
	bool "Touchscreen Y Mirror"
	default n
	depends on ESP32S3_8048S043

endmenu # Touchscreen Configuration

endif # ARCH_BOARD_ESP32S3_8048S043
```

## boards/xtensa/esp32s3/esp32s3-box/Kconfig
```kconfig
#
# For a description of the syntax of this configuration file,
# see the file kconfig-language.txt in the NuttX tools repository.
#

if ARCH_BOARD_ESP32S3_BOX

choice
	prompt "ESP32-S3-BOX Version"
	default ESP32_S3_BOX_3

config ESP32_S3_BOX
	bool "ESP32-S3-BOX(old)"

config ESP32_S3_BOX_3
	bool "ESP32-S3-BOX-3"
endchoice

config ESP32S3_BOX_LCD
	bool "Enable ESP32-S3 LCD"
	default n
	select ESP32S3_SPI2
	select LCD
	select LCD_DEV
	select LCD_ST7789
	---help---
		Enable board LCD support, IC is:

			ESP32-S3-BOX:   ST7789V
			ESP32-S3-BOX-3: ILI9342C

config ESP32S3_BOARD_TOUCHSCREEN
	bool "Enable Board Touchscreen"
	default n
	select ESP32S3_I2C0
	select INPUT
	select INPUT_TOUCHSCREEN
	---help---
		Enable board touchscreen support, IC is:

			ESP32-S3-BOX:   TT21100
			ESP32-S3-BOX-3: GT911

menu "Board Touchscreen Configuration"
	depends on ESP32S3_BOARD_TOUCHSCREEN

config ESP32S3_BOARD_TOUCHSCREEN_PATH
	string "Touchscreen Path for VFS"
	default "/dev/input0"

config ESP32S3_BOARD_TOUCHSCREEN_WIDTH
	int "Touchscreen Width"
	default 320
	depends on ESP32_S3_BOX

config ESP32S3_BOARD_TOUCHSCREEN_HEIGHT
	int "Touchscreen Height"
	default 240
	depends on ESP32_S3_BOX

config ESP32S3_BOARD_TOUCHSCREEN_SAMPLE_CACHES
	int "Touchscreen Sample Cache Number"
	default 64

config ESP32S3_BOARD_TOUCHSCREEN_SAMPLE_DELAYS
	int "Touchscreen Sample Delay Ticks"
	default 20

config ESP32S3_BOARD_TOUCHSCREEN_X_MIRROR
	bool "Touchscreen X Mirror"
	default y
	depends on ESP32_S3_BOX

config ESP32S3_BOARD_TOUCHSCREEN_Y_MIRROR
	bool "Touchscreen Y Mirror"
	default n
	depends on ESP32_S3_BOX

endmenu # Touchscreen Configuration

endif # ARCH_BOARD_ESP32S3_BOX
```

## boards/xtensa/esp32s3/esp32s3-devkit/Kconfig
```kconfig
#
# For a description of the syntax of this configuration file,
# see the file kconfig-language.txt in the NuttX tools repository.
#

if ARCH_BOARD_ESP32S3_DEVKIT

choice
	prompt "ESP32-S3-DevKitC-1 version"
	default ESP32S3_DEVKITC_1_V10

config ESP32S3_DEVKITC_1_V10
	bool "ESP32-S3-DevKitC-1 v1.0"

config ESP32S3_DEVKITC_1_V11
	bool "ESP32-S3-DevKitC-1 v1.1"
endchoice

endif # ARCH_BOARD_ESP32S3_DEVKIT
```

## boards/xtensa/esp32s3/esp32s3-devkit/configs/adb/defconfig
```kconfig
#include "../usb_device/defconfig"
CONFIG_ADBD_SHELL_SERVICE=y
CONFIG_ADBD_STACKSIZE=8192
CONFIG_ADBD_USB_BOARDCTL=y
CONFIG_ADBD_USB_SERVER=y
CONFIG_CDCACM=n
CONFIG_ESP32S3_OTG_ENDPOINT_NUM=2
CONFIG_ETC_ROMFS=y
CONFIG_EXAMPLES_USBSERIAL=n
CONFIG_FS_ROMFS=y
CONFIG_LIBC_EXECFUNCS=y
CONFIG_LIBUV=y
CONFIG_POSIX_SPAWN_DEFAULT_STACKSIZE=4096
CONFIG_PSEUDOTERM=y
CONFIG_PTHREAD_MUTEX_TYPES=y
CONFIG_SCHED_BACKTRACE=y
CONFIG_SCHED_HPWORKSTACKSIZE=8192
CONFIG_SYSLOG_CHARDEV=y
CONFIG_SYSTEM_ADBD=y
CONFIG_TLS_NCLEANUP=4
CONFIG_TLS_NELEM=4
CONFIG_TLS_TASK_NELEM=4
CONFIG_USBADB=y
```

## boards/xtensa/esp32s3/esp32s3-devkit/configs/fastboot/defconfig
```kconfig
#include "../usb_device/defconfig"
CONFIG_BCH=y
CONFIG_BOARDCTL_USBDEVCTRL=y
CONFIG_CDCACM=n
CONFIG_ESP32S3_OTG_ENDPOINT_NUM=2
CONFIG_ETC_ROMFS=y
CONFIG_EXAMPLES_USBSERIAL=n
CONFIG_FS_ROMFS=y
CONFIG_NSH_CMDOPT_HEXDUMP=y
CONFIG_PIPES=y
CONFIG_SCHED_CHILD_STATUS=y
CONFIG_SCHED_HAVE_PARENT=y
CONFIG_SYSTEM_FASTBOOTD=y
CONFIG_SYSTEM_FASTBOOTD_SHELL=y
CONFIG_SYSTEM_FASTBOOTD_USB_BOARDCTL=y
CONFIG_SYSTEM_POPEN=y
CONFIG_USBADB=y
CONFIG_USBFASTBOOT=y
```

## boards/xtensa/esp32s3/esp32s3-devkit/configs/usbmsc/defconfig
```kconfig
#include "../usb_device/defconfig"
CONFIG_BCH=y
CONFIG_DEV_ZERO=y
CONFIG_ESP32S3_SPIFLASH=y
CONFIG_ESP32S3_SPIFLASH_MTD_BLKSIZE=512
CONFIG_SYSTEM_USBMSC=y
CONFIG_SYSTEM_USBMSC_DEVMINOR1=0
CONFIG_SYSTEM_USBMSC_DEVMINOR2=1
CONFIG_SYSTEM_USBMSC_DEVPATH1="/dev/ram10"
CONFIG_SYSTEM_USBMSC_DEVPATH2="/dev/esp32s3flash"
CONFIG_USBMSC=y
CONFIG_USBMSC_EPBULKIN=2
CONFIG_USBMSC_EPBULKOUT=1
```

## boards/xtensa/esp32s3/esp32s3-eye/Kconfig
```kconfig
#
# For a description of the syntax of this configuration file,
# see the file kconfig-language.txt in the NuttX tools repository.
#

if ARCH_BOARD_ESP32S3_EYE

config ESP32S3_EYE_LCD
	bool "Enable ESP32-S3 LCD"
	default n
	select ESP32S3_SPI2
	select SPI_CMDDATA
	select LCD
	select LCD_DEV
	select LCD_ST7789
	---help---
		Enable board LCD support, IC is LCD_ST7789V.

endif # ARCH_BOARD_ESP32S3_EYE
```

## boards/xtensa/esp32s3/esp32s3-lcd-ev/Kconfig
```kconfig
#
# For a description of the syntax of this configuration file,
# see the file kconfig-language.txt in the NuttX tools repository.
#

if ARCH_BOARD_ESP32S3_LCD_EV

choice ESP32S3_LCD_EV_BOARD_VERSION
	prompt "ESP32-S3-LCD-EV-BOARD version"
	default ESP32S3_LCD_EV_BOARD_V14 if ARCH_CHIP_ESP32S3WROOM2N16R8V
	default ESP32S3_LCD_EV_BOARD_V15 if ARCH_CHIP_ESP32S3WROOM1N16R16V

config ESP32S3_LCD_EV_BOARD_V14
	depends on ARCH_CHIP_ESP32S3WROOM2N16R8V
	bool "ESP32-S3-LCD-EV-BOARD v1.4"

config ESP32S3_LCD_EV_BOARD_V15
	depends on ARCH_CHIP_ESP32S3WROOM1N16R16V
	bool "ESP32-S3-LCD-EV-BOARD v1.5"
endchoice

config ESP32S3_BOARD_IOEXPANDER
	bool "Enable Board IO Expander"
	default n
	depends on ESP32S3_BOARD_I2C
	---help---
		Enable board IO expander support, IC is TC9554.

config ESP32S3_BOARD_LCD
	bool "Enable Board LCD"
	default n
	depends on ESP32S3_LCD
	select ESP32S3_BOARD_IOEXPANDER
	---help---
		Enable board LCD support, IC is GC9503CV.

config ESP32S3_BOARD_TOUCHPAD
	bool "Enable Board Touchpad"
	default n
	depends on ESP32S3_BOARD_I2C
	---help---
		Enable board touchpad support, IC is FT5X06.

endif # ARCH_BOARD_ESP32S3_LCD_EV
```
