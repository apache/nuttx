## boards/xtensa/esp32/esp32-ethernet-kit/Kconfig
```kconfig
#
# For a description of the syntax of this configuration file,
# see the file kconfig-language.txt in the NuttX tools repository.
#

if ARCH_BOARD_ESP32_ETHERNETKIT

source boards/xtensa/esp32/common/Kconfig

endif # ARCH_BOARD_ESP32_ETHERNETKIT
```

## boards/xtensa/esp32/esp32-lyrat/Kconfig
```kconfig
#
# For a description of the syntax of this configuration file,
# see the file kconfig-language.txt in the NuttX tools repository.
#

if ARCH_BOARD_ESP32_LYRAT

config ESP32_TOUCH
	bool "Touch pads"
	default n
	---help---
		Enable ESP32 touch pad support.

config ESP32_TOUCH_FILTER
	bool "Touch pad IIR filter"
	select ESP32_RT_TIMER
	default n
	depends on ESP32_TOUCH
	---help---
		Enable infinite impulse response filter for the touch pads.

endif # ARCH_BOARD_ESP32_LYRAT
```

## boards/xtensa/esp32/ttgo_t_display_esp32/Kconfig
```kconfig
#
# For a description of the syntax of this configuration file,
# see the file kconfig-language.txt in the NuttX tools repository.
#

if ARCH_BOARD_TTGO_T_DISPLAY_ESP32

if PM

config PM_ALARM_SEC
	int "PM_STANDBY delay (seconds)"
	default 15
	depends on PM
	---help---
		Number of seconds to wait in PM_STANDBY before going to PM_STANDBY mode.

config PM_ALARM_NSEC
	int "PM_STANDBY delay (nanoseconds)"
	default 0
	depends on PM
	---help---
		Number of additional nanoseconds to wait in PM_STANDBY before going to PM_STANDBY mode.

config PM_SLEEP_WAKEUP_SEC
	int "PM_SLEEP delay (seconds)"
	default 20
	depends on PM
	---help---
		Number of seconds to wait in PM_SLEEP.

config PM_SLEEP_WAKEUP_NSEC
	int "PM_SLEEP delay (nanoseconds)"
	default 0
	depends on PM
	---help---
		Number of additional nanoseconds to wait in PM_SLEEP.

endif # PM

if ESP32_SPIRAM

menu "PSRAM clock and cs IO for ESP32-DOWD"
config D0WD_PSRAM_CLK_IO
	int "PSRAM CLK IO number"
	range 0 33
	default 17
	---help---
		The PSRAM CLOCK IO can be any unused GPIO, user can config it
		based on hardware design. If user use 1.8V flash and 1.8V psram,
		this value can only be one of 6, 7, 8, 9, 10, 11, 16, 17.

config D0WD_PSRAM_CS_IO
	int "PSRAM CS IO number"
	range 0 33
	default 16
	---help---
		The PSRAM CS IO can be any unused GPIO, user can config it based
		on hardware design. If user use 1.8V flash and 1.8V psram, this
		value can only be one of 6, 7, 8, 9, 10, 11, 16, 17.
endmenu

menu "PSRAM clock and cs IO for ESP32-D2WD"
config D2WD_PSRAM_CLK_IO
	int "PSRAM CLK IO number"
	range 0 33
	default 9
	---help---
		User can config it based on hardware design. For ESP32-D2WD chip,
		the psram can only be 1.8V psram, so this value can only be one
		of 6, 7, 8, 9, 10, 11, 16, 17.

config D2WD_PSRAM_CS_IO
	int "PSRAM CS IO number"
	range 0 33
	default 10
	---help---
		User can config it based on hardware design. For ESP32-D2WD chip,
		the psram can only be 1.8V psram, so this value can only be one
		of 6, 7, 8, 9, 10, 11, 16, 17.
endmenu

menu "PSRAM clock and cs IO for ESP32-PICO"
config PICO_PSRAM_CS_IO
	int "PSRAM CS IO number"
	range 0 33
	default 10
	---help---
		The PSRAM CS IO can be any unused GPIO, user can config it based on
		hardware design.
		For ESP32-PICO chip, the psram share clock with flash, so user do
		not need to configure the clock IO.
		For the reference hardware design, please refer to
		https://www.espressif.com/sites/default/files/documentation/esp32-pico-d4_datasheet_en.pdf
endmenu

config ESP32_SPIRAM_SPIWP_SD3_PIN
	int "SPI PSRAM WP(SD3) Pin when customising pins via eFuse (read help)"
	range 0 33
	default 7
	---help---
		This value is ignored unless flash mode is set to DIO or DOUT and
		the SPI flash pins have been overridden by setting the eFuses
		SPI_PAD_CONFIG_xxx.

		When this is the case, the eFuse config only defines 3 of the 4
		Quad I/O data pins. The WP pin (aka ESP32 pin "SD_DATA_3" or SPI
		flash pin "IO2") is not specified in eFuse. And the psram only
		has QPI mode, the WP pin is necessary, so we need to configure
		this value here.

		When flash mode is set to QIO or QOUT, the PSRAM WP pin will be
		set as the value configured in bootloader.

		For ESP32-PICO chip, the default value of this config should be 7.

endif # ESP32_PSRAM

endif # ARCH_BOARD_TTGO_T_DISPLAY_ESP32
```

## boards/xtensa/esp32s2/common/Kconfig
```kconfig
#
# For a description of the syntax of this configuration file,
# see the file kconfig-language.txt in the NuttX tools repository.
#

config ESP32S2_MERGE_BINS
	bool "Merge raw binary files into a single file"
	default n
	---help---
		Merge the raw binary files into a single file for flashing to the
		device.
		This is only useful when the path to binary files (e.g. bootloader)
		is provided via the ESPTOOL_BINDIR variable.

choice ESP32S2_SPIFLASH_FS
	prompt "Mount SPI Flash MTD on bring-up"
	default ESP32S2_SPIFLASH_SMARTFS
	depends on ESPRESSIF_SPIFLASH
	optional
	---help---
		Mount the SPI Flash MTD with the selected File System format on board
		bring-up.
		If not selected, the MTD will be registered as a device node on /dev.

config ESP32S2_SPIFLASH_SMARTFS
	bool "SmartFS"
	select FS_SMARTFS
	select MTD_SMART
	depends on !ESP32S2_SECURE_FLASH_ENC_ENABLED

comment "SmartFS not supported with Flash Encryption"
	depends on ESP32S2_SECURE_FLASH_ENC_ENABLED

config ESP32S2_SPIFLASH_NXFFS
	bool "NXFFS"
	select FS_NXFFS
	depends on !ESP32S2_SECURE_FLASH_ENC_ENABLED

comment "NXFFS not supported with Flash Encryption"
	depends on ESP32S2_SECURE_FLASH_ENC_ENABLED

config ESP32S2_SPIFLASH_SPIFFS
	bool "SPIFFS"
	select FS_SPIFFS
	depends on !ESP32S2_SECURE_FLASH_ENC_ENABLED

comment "SPIFFS not supported with Flash Encryption"
	depends on ESP32S2_SECURE_FLASH_ENC_ENABLED

config ESP32S2_SPIFLASH_LITTLEFS
	bool "LittleFS"
	select FS_LITTLEFS

endchoice

config ESP32S2_LCD_OVERCLOCK
	bool "Run LCD at higher clock speed than allowed"
	default n
	depends on LCD_ILI9341
	---help---
		The ILI9341 and ST7789 specify that the maximum clock speed for the
		SPI interface is 10MHz. However, in practice the driver chips work
		fine with a higher clock rate, and using that gives a better
		framerate. Select this to try using the out-of-spec clock rate.
```

## boards/xtensa/esp32s2/esp32s2-kaluga-1/Kconfig
```kconfig
#
# For a description of the syntax of this configuration file,
# see the file kconfig-language.txt in the NuttX tools repository.
#

if ARCH_BOARD_ESP32S2_KALUGA_1

config ESP32S2_TOUCH
	bool "Touch pads"
	default n
	---help---
		Enable ESP32-S2 touch pad support.

if ESP32S2_TOUCH

config ESP32S2_TOUCH_THRESHOLD_POSEDGE
	bool "Touch pad inverted threshold detection"
	default y
	---help---
		Detect positive edge of touch pad threshold rather than negative edge.

config ESP32S2_TOUCH_FILTER
	bool "Touch pad filter"
	default n
	---help---
		Enable internal filter for the touch pads.

config ESP32S2_TOUCH_DENOISE
	bool "Touch pad denoise"
	default n
	---help---
		Enable internal denoise for the touch pads.

config ESP32S2_TOUCH_IRQ
	bool "Enable touch pad interrupts"
	select ESP32S2_RTCIO_IRQ
	select ESP32S2_RT_TIMER
	depends on ARCH_IRQBUTTONS
	default n
	---help---
		Enable interrupt support for the touch pads.

config ESP32S2_TOUCH_IRQ_INTERVAL_MS
	int "Minimum interrupt interval (ms)"
	depends on ESP32S2_TOUCH_IRQ
	default 100
	---help---
		Minimum interval between touch pad interrupts (in milliseconds).
		As the RTC interrupts are triggered by level, this interrupt
		will be constantly set off as long as the touch pad is pressed.
		To avoid that, we disable the interrupt when it is triggered and
		set a timer for it to be re-enabled.

endif # ESP32S2_TOUCH

endif # ARCH_BOARD_ESP32S2_KALUGA_1
```
