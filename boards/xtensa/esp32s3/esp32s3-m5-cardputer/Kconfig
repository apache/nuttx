## boards/xtensa/esp32s3/esp32s3-m5-cardputer/Kconfig
```kconfig
#
# For a description of the syntax of this configuration file,
# see the file kconfig-language.txt in the NuttX tools repository.
#

if ARCH_BOARD_ESP32S3_M5_CARDPUTER

config ESP32S3_M5_CARDPUTER_KEYBOARD
	bool "Cardputer matrix keyboard"
	default n
	select INPUT
	select INPUT_KEYBOARD
	select SCHED_LPWORK
	---help---
		Enable the M5Stack Cardputer 56-key matrix keyboard driver.  The
		driver scans the 74HC138-multiplexed key matrix and registers a
		keyboard device (/dev/kbdN).

if ESP32S3_M5_CARDPUTER_KEYBOARD

config ESP32S3_M5_CARDPUTER_KBD_BUFNUM
	int "Cardputer keyboard event buffer size"
	default 8
	---help---
		Number of key events buffered by the Cardputer matrix keyboard
		driver before the oldest events are overwritten.

config ESP32S3_M5_CARDPUTER_KBD_DEBUG
	bool "Cardputer keyboard scan debug logging"
	default n
	---help---
		Log every detected key matrix transition to the syslog.  Useful to
		bring up the keyboard and to verify the key map.

endif # ESP32S3_M5_CARDPUTER_KEYBOARD

endif # ARCH_BOARD_ESP32S3_M5_CARDPUTER
```

## boards/xtensa/esp32s3/esp32s3-ws-lcd128/Kconfig
```kconfig
#
# For a description of the syntax of this configuration file,
# see the file kconfig-language.txt in the NuttX tools repository.
#

if ARCH_BOARD_ESP32S3_WS_LCD128

choice
	prompt "BOARD VARIANT"
	default ARCH_BOARD_ESP32S3_WS_LCD128_NOTOUCH
	---help---
		There are two variants of the board with [1] and without [2] touch screen.
		These boards also have slightly different signals and capabilities.
		Non-touch variant has two connectors with many more GPIO available.

		[1] https://www.waveshare.com/esp32-s3-touch-lcd-1.28.htm
		[2] https://www.waveshare.com/esp32-s3-lcd-1.28.htm

		NOTE: Touch screen driver is not yet implemented!

config ARCH_BOARD_ESP32S3_WS_LCD128_NOTOUCH
	bool "NO-TOUCH ESP32-S3-LCD-1.28"
	select LCD
	---help---
		Mark this choice if your board has no touch screen module installed.
		www.waveshare.com/esp32-s3-lcd-1.28.htm

config ARCH_BOARD_ESP32S3_WS_LCD128_TOUCH
	bool "TOUCH ESP32-S3-Touch-LCD-1.28"
	---help---
		Mark this choice if your board has touch screen module installed.
		www.waveshare.com/esp32-s3-touch-lcd-1.28.htm

		NOTE: Touch screen driver is not yet implemented!

endchoice

endif # ARCH_BOARD_ESP32S3_WS_LCD128
```

## boards/xtensa/esp32s3/lckfb-szpi-esp32s3/Kconfig
```kconfig
#
# For a description of the syntax of this configuration file,
# see the file kconfig-language.txt in the NuttX tools repository.
#

if ARCH_BOARD_ESP32S3_LCKFB_SZPI

config ARCH_BOARD_ESP32S3_LCKFB_SZPI_DISPLAY_XRES
	int
	default LCD_ST7789_XRES
	depends on LCD_ST7789

config ARCH_BOARD_ESP32S3_LCKFB_SZPI_DISPLAY_YRES
	int
	default LCD_ST7789_YRES
	depends on LCD_ST7789

config ARCH_BOARD_ESP32S3_LCKFB_SZPI_TOUCHSCREEN_MIRRORY
	bool "SZPI-ESP32-S3 Touchscreen mirror Y"
	depends on INPUT_TOUCHSCREEN

config ARCH_BOARD_ESP32S3_LCKFB_SZPI_TOUCHSCREEN_SWAPXY
	bool "SZPI-ESP32-S3 Touchscreen sway X/Y"
	depends on INPUT_TOUCHSCREEN

endif # ARCH_BOARD_ESP32S3_LCKFB_SZPI
```

## boards/xtensa/esp32s3/lckfb-szpi-esp32s3/configs/txtable/defconfig
```kconfig
#include "../adb/defconfig"
CONFIG_BCH=y
CONFIG_DEV_ZERO=y
CONFIG_ESP32S3_SPIFLASH=y
CONFIG_TXTABLE_DEFAULT_PARTITION=1
CONFIG_TXTABLE_PARTITION=y
```

## boards/z80/ez80/makerlisp/Kconfig
```kconfig
#
# For a description of the syntax of this configuration file,
# see the file kconfig-language.txt in the NuttX tools repository.
#

if ARCH_BOARD_MAKERLISP

config MAKERLISP_VGA
	bool "VGA Controller attached?"
	default n
	---help---
		Select this option if you have an I/O Controller and a VGA vide card
		connected.

config MAKERLISP_COPYTORAM
	bool "Copy to RAM"
	default n
	depends on BOOT_RUNFROMEXTSRAM
	---help---
		This option is available only when running from external SRAM
		(CONFIG_BOOT_RUNFROMEXTSRAM).  In that case there are two possible
		options:  (1) The configuration runs entirely out of SRAM and must
		be copied into SRAM by a boot loader.  Or (2) The configuration
		boots out of FLASH, copies itself to SRAM, and runs from SRAM.  This
		configuration setting selects that latter option.

config MAKERLISP_SDBOOT
	bool "Build SD boot loader"
	default n
	select EZ80_BOOTLOADER
	---help---
		Select this option only with the boards/makerlisp/sdboot
		configuration.  This will enable the components needed only by the
		boot loader.

endif # ARCH_BOARD_MAKERLISP
```

## boards/z80/ez80/z20x/Kconfig
```kconfig
#
# For a description of the syntax of this configuration file,
# see the file kconfig-language.txt in the NuttX tools repository.
#

if ARCH_BOARD_Z20X

choice
	prompt "Build selection"
	default Z20X_PROGRAM

config Z20X_SDBOOT
	bool "SD boot loader"
	select LIBC_HEX2BIN
	select EZ80_BOOTLOADER
	depends on EZ80_SPI && MMCSD_SPI
	---help---
		Select this option only with the boards/z20x/sdboot
		configuration.  This will enable the components needed only by the
		boot loader.

config Z20X_W25BOOT
	bool "W25 boot loader"
	depends on Z20X_W25_CHARDEV
	select LIBC_HEX2BIN
	select EZ80_BOOTLOADER
	depends on EZ80_SPI && MTD_W25
	---help---
		Select this option only with the boards/z20x/w25boot
		configuration.  This will enable the components needed only by the
		boot loader.

config Z20X_PROGRAM
	bool "Loadable program"
	select EZ80_PROGRAM
	---help---
		Normal program that resides on SD card or in W25 FLASH and is
		loaded into RAM by a bootloader.

config Z20X_STANDALONE
	bool "Standalone FLASH progroam"
	depends on BOOT_RUNFROMFLASH
	---help---
		Select this option only to build a small program that executes
		from z20x FLASH memory.

config Z20X_COPYTORAM
	bool "Copy to RAM"
	depends on BOOT_RUNFROMEXTSRAM
	---help---
		This option is available only when running from external SRAM
		(CONFIG_BOOT_RUNFROMEXTSRAM).  In that case there are two possible
		options:  (1) The configuration runs entirely out of SRAM and must
		be copied into SRAM by a boot loader.  Or (2) The configuration
		boots out of FLASH, copies itself to SRAM, and runs from SRAM.  This
		configuration setting selects that latter option.

endchoice

config Z20X_W25_PROGSIZE
	int "W25 partition size"
	default 262144
	range 131072 524288
	depends on Z20X_W25BOOT
	---help---
		This is the size of the partition at the beginning to the W25
		serial FLASH that will be used to hold the boot program.  Since
		this program must run from SRAM, there would be no purpose int
		making this size any larger than the size of the internal SRAM.

choice
	prompt "Winbond W25 Usage"
	default Z20X_W25_CHARDEV
	depends on EZ80_SPI && MTD_W25

config Z20X_W25_CHARDEV
	bool "Character device"
	select BCH

config Z20X_W25_BLOCKDEV
	bool "Block device"

config Z20X_W25_MTDDEV
	bool "MTD device"

endchoice

config Z20X_W25_MINOR
	int "W25 device minor number"
	default 0
	range 0 255
	depends on Z20X_W25_CHARDEV

endif # ARCH_BOARD_Z20X
```
