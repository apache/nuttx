## arch/arm/src/common/stm32/Kconfig.ble
```kconfig
#
# STM32 common BLE options.
#

if STM32_BLE

config STM32_BLE_C2HOST
	bool "Enable CPU2 HOST stack"
	default n
	---help---
		The full stack version of CPU2 firmware allows to enable CPU2 HOST stack and
		control it using vendor ACL protocol. However, it is not expected to enable
		this option in the current implementation.

config STM32_BLE_MAX_CONN
	int "Maximum BLE simultaneous connections"
	range 1 8
	default 2

config STM32_BLE_GATT_MAX_ATTR_NUM
	int "GATT attributes max count"
	range 9 255
	default 64

config STM32_BLE_GATT_MAX_SVC_NUM
	int "GATT services max count"
	range 2 64
	default 8

config STM32_BLE_GATT_ATTR_BUF_SIZE
	int "GATT attributes storage buf size"
	default 1344
	---help---
		Size of the storage area for attribute values. Hardcoded in CPU2 firmware.

config STM32_BLE_DLE
	bool "Support Data Length Extension (DLE)"
	default y

config STM32_BLE_MAX_ATT_MTU
	int "Maximum supported attribute MTU"
	range 23 512
	default 156

config STM32_BLE_SLAVE_SCA
	int "Sleep clock accuracy in slave mode [PPM]"
	default 500
	---help---
		Sleep clock accuracy (ppm value) in slave mode.

choice
	prompt "Sleep clock accuracy in master mode"
	default STM32_BLE_MASTER_SCA_0
	---help---
		Sleep clock accuracy in master mode.

config STM32_BLE_MASTER_SCA_0
	bool "251-500 ppm"

config STM32_BLE_MASTER_SCA_1
	bool "151-250 ppm"

config STM32_BLE_MASTER_SCA_2
	bool "101-150 ppm"

config STM32_BLE_MASTER_SCA_3
	bool "76-100 ppm"

config STM32_BLE_MASTER_SCA_4
	bool "51-75 ppm"

config STM32_BLE_MASTER_SCA_5
	bool "31-50 ppm"

config STM32_BLE_MASTER_SCA_6
	bool "21-30 ppm"

config STM32_BLE_MASTER_SCA_7
	bool "0-20 ppm"

endchoice # Sleep clock accuracy in master mode

config STM32_BLE_MASTER_SCA
	int
	default 7 if STM32_BLE_MASTER_SCA_7
	default 6 if STM32_BLE_MASTER_SCA_6
	default 5 if STM32_BLE_MASTER_SCA_5
	default 4 if STM32_BLE_MASTER_SCA_4
	default 3 if STM32_BLE_MASTER_SCA_3
	default 2 if STM32_BLE_MASTER_SCA_2
	default 1 if STM32_BLE_MASTER_SCA_1
	default 0

choice
	prompt "Low speed clock source"
	default STM32_BLE_LS_CLK_SRC_LSE
	---help---
		Low speed 32 kHz clock source.

config STM32_BLE_LS_CLK_SRC_LSE
	bool "LSE"

config STM32_BLE_LS_CLK_SRC_HSE
	bool "HSE"

endchoice # Low speed clock source

config STM32_BLE_LS_CLK_SRC
	int
	default 1 if STM32_BLE_LS_CLKSRC_HSE
	default 0

config STM32_BLE_MAX_CONN_EVT_LENGTH
	hex "Max connection event length"
	default 0xffffffff
	---help---
		Maximum duration of a slave connection event in units of 625/256us (~2.44us).

config STM32_BLE_HSE_STARTUP
	hex "HSE startup time"
	default 0x148
	---help---
		HSE startup time in units of 625/256us (~2.44us).

config STM32_BLE_VITERBI
	bool "Enable Viterbi algorithm"
	default y
	---help---
		Enable Viterbi algorithm implementation

config STM32_BLE_MAX_INITOR_COC_NUM
	int "Max number of connection-oriented channels"
	range 0 64
	default 32
	---help---
		Maximum number of connection-oriented channels in initiator mode.

config STM32_BLE_SVC_CHANGED_CHAR
	bool "Enable service changed characteristic"
	default n

config STM32_BLE_WRITABLE_DEVICE_NAME
	bool "Writable device name"
	default y

config STM32_BLE_CHAN_SEL_ALG2
	bool "Enable channel selection algorithm 2"
	default n

choice
	prompt "Power class"
	default STM32_BLE_POWER_CLASS_2_3

config STM32_BLE_POWER_CLASS_2_3
	bool "Power Class 2-3"

config STM32_BLE_POWER_CLASS_1
	bool "Power Class 1"

endchoice # Power class

config STM32_BLE_MIN_TX_POWER
	int "Minimum transmit power [dBm]"
	range -127 20
	default 0

config STM32_BLE_MAX_TX_POWER
	int "Maximum transmit power [dBm]"
	range -127 20
	default 0

choice
	prompt "AGC RSSI model"
	default STM32_BLE_AGC_RSSI_LEGACY

config STM32_BLE_AGC_RSSI_LEGACY
	bool "AGC RSSI Legacy"

config STM32_BLE_AGC_RSSI_IMPROVED
	bool "AGC RSSI Improved"

endchoice # AGC RSSI model

config STM32_BLE_ADVERTISING
	bool "Support advertising"
	default y

config STM32_BLE_SCANNING
	bool "Support scanning"
	default y

config STM32_BLE_LE_2M_PHY
	bool "Support LE 2M PHY"
	default y

config STM32_BLE_LE_CODED_PHY
	bool "Support LE Coded PHY"
	default STM32_STM32WB15 || STM32_STM32WB35 || STM32_STM32WB55
	depends on STM32_STM32WB15 || STM32_STM32WB35 || STM32_STM32WB55

config STM32_BLE_FICR_STATIC_ADDR
	bool "Configure factory generated static random address"
	default n

config STM32_BLE_PUB_ADDR
	hex "Configure BT public address"
	default 0x0000000000

endif # STM32_BLE

if STM32_MBOX

config STM32_MBOX_TX_CMD_QUEUE_LEN
	int "Mailbox TX command queue length"
	default 2

config STM32_MBOX_RX_EVT_QUEUE_LEN
	int "Mailbox RX event queue length"
	default 5

endif # STM32_MBOX
```

## arch/arm/src/common/stm32/Kconfig.cache
```kconfig
#
# STM32 cache configuration options.
#

menu "ICACHE Configuration"
	depends on STM32_ICACHE

config STM32_ICACHE_MONITOR_EN
	bool "Enable ICACHE Hit/Miss Counters"
	default n

config STM32_ICACHE_DIRECT
	bool "Enable 1-Way Direct Mapped Cache (N-Way = default)"
	default n

menu "ICACHE Interrupt Configuration"
	depends on STM32_ICACHE

config STM32_ICACHE_INV_INT
	bool "Enable interrupts on full invalidation completion."
	default n

config STM32_ICACHE_ERR_INT
	bool "Enable interrupts on occurrences of cache errors."
	default n

endmenu # ICACHE Interrupt Configuration

menu "ICACHE Region Configuration"
	depends on STM32_ICACHE

config STM32_ICACHE_REGION0
	bool "Enable Configuration of ICACHE Region 0"
	default n

config STM32_ICACHE_REGION1
	bool "Enable Configuration of ICACHE Region 1"
	default n

config STM32_ICACHE_REGION2
	bool "Enable Configuration of ICACHE Region 2"
	default n

config STM32_ICACHE_REGION3
	bool "Enable Configuration of ICACHE Region 3"
	default n

menu "Region 0 Configuration"
	depends on STM32_ICACHE_REGION0 && STM32_HAVE_ICACHE_REMAP

config STM32_ICACHE_REGION0_BADDR
	hex "ICACHE Region 0 Base Address Bits [28:21]"
	default 0
	range 0 255
	depends on STM32_ICACHE_REGION0
	---help---
		Set bits [28:21] of the base address for ICACHE Region 0.

config STM32_ICACHE_REGION0_RSIZE
	int "ICACHE Region 0 Size"
	default 1
	range 1 7
	depends on STM32_ICACHE_REGION0
	---help---
		Set the size of Region 0.
                1 = 2 Mbytes, 2 = 4 Mbytes, 3 = 8 Mbytes, 4 = 16 Mbytes,
                5 = 2 Mbytes, 6 = 64 Mbytes, 7 = 128 Mbytes.

config STM32_ICACHE_REGION0_REMAPADDR
	hex "ICACHE Region 0 Remap Address Bits [31:21]"
	default 0
	range 0 2047
	depends on STM32_ICACHE_REGION0
	---help---
		Set bits [31:21] of ICACHE Region 0 Remap Address..

config STM32_ICACHE_REGION0_MSTSEL
	int "ICACHE Region 0 Master Select (0 or 1)"
	default 0
	range 0 1
	depends on STM32_ICACHE_REGION0
	---help---
		Select ICACHE Region 0 Master 1 (0) or Master 2 (1).

config STM32_ICACHE_REGION0_HBURST
	int "ICACHE Region 0 Output Burst Type (0 = Wrap, 1 = Incr)"
	default 0
	range 0 1
	depends on STM32_ICACHE_REGION0
	---help---
		Select Wrap (0) or Increment (1) Output Burst Type.

endmenu # Region 0 Configuration

menu "Region 1 Configuration"
	depends on STM32_ICACHE_REGION1 && STM32_HAVE_ICACHE_REMAP

config STM32_ICACHE_REGION1_BADDR
	hex "ICACHE Region 1 Base Address Bits [28:21]"
	default 0
	range 0 255
	depends on STM32_ICACHE_REGION1
	---help---
		Set bits [28:21] of the base address for ICACHE Region 1.

config STM32_ICACHE_REGION1_RSIZE
	int "ICACHE Region 1 Size"
	default 1
	range 1 7
	depends on STM32_ICACHE_REGION1
	---help---
		Set the size of Region 1.
                1 = 2 Mbytes, 2 = 4 Mbytes, 3 = 8 Mbytes, 4 = 16 Mbytes,
                5 = 2 Mbytes, 6 = 64 Mbytes, 7 = 128 Mbytes.

config STM32_ICACHE_REGION1_REMAPADDR
	hex "ICACHE Region 1 Remap Address Bits [31:21]"
	default 0
	range 0 2047
	depends on STM32_ICACHE_REGION1
	---help---
		Set bits [31:21] of ICACHE Region 1 Remap Address..

config STM32_ICACHE_REGION1_MSTSEL
	int "ICACHE Region 1 Master Select (0 or 1)"
	default 0
	range 0 1
	depends on STM32_ICACHE_REGION1
	---help---
		Select ICACHE Region 1 Master 1 (0) or Master 2 (1).

config STM32_ICACHE_REGION1_HBURST
	int "ICACHE Region 1 Output Burst Type (0 = Wrap, 1 = Incr)"
	default 0
	range 0 1
	depends on STM32_ICACHE_REGION1
	---help---
		Select Wrap (0) or Increment (1) Output Burst Type.

endmenu # Region 1 Configuration

menu "Region 2 Configuration"
	depends on STM32_ICACHE_REGION2 && STM32_HAVE_ICACHE_REMAP

config STM32_ICACHE_REGION2_BADDR
	hex "ICACHE Region 2 Base Address Bits [28:21]"
	default 0
	range 0 255
	depends on STM32_ICACHE_REGION2
	---help---
		Set bits [28:21] of the base address for ICACHE Region 2.

config STM32_ICACHE_REGION2_RSIZE
	int "ICACHE Region 2 Size"
	default 1
	range 1 7
	depends on STM32_ICACHE_REGION2
	---help---
		Set the size of Region 2.
                1 = 2 Mbytes, 2 = 4 Mbytes, 3 = 8 Mbytes, 4 = 16 Mbytes,
                5 = 2 Mbytes, 6 = 64 Mbytes, 7 = 128 Mbytes.

config STM32_ICACHE_REGION2_REMAPADDR
	hex "ICACHE Region 2 Remap Address Bits [31:21]"
	default 0
	range 0 2047
	depends on STM32_ICACHE_REGION2
	---help---
		Set bits [31:21] of ICACHE Region 2 Remap Address..

config STM32_ICACHE_REGION2_MSTSEL
	int "ICACHE Region 2 Master Select (0 or 1)"
	default 0
	range 0 1
	depends on STM32_ICACHE_REGION2
	---help---
		Select ICACHE Region 2 Master 1 (0) or Master 2 (1).

config STM32_ICACHE_REGION2_HBURST
	int "ICACHE Region 2 Output Burst Type (0 = Wrap, 1 = Incr)"
	default 0
	range 0 1
	depends on STM32_ICACHE_REGION2
	---help---
		Select Wrap (0) or Increment (1) Output Burst Type.

endmenu # Region 2 Configuration

menu "Region 3 Configuration"
	depends on STM32_ICACHE_REGION3 && STM32_HAVE_ICACHE_REMAP

config STM32_ICACHE_REGION3_BADDR
	hex "ICACHE Region 3 Base Address Bits [28:21]"
	default 0
	range 0 255
	depends on STM32_ICACHE_REGION3
	---help---
		Set bits [28:21] of the base address for ICACHE Region 3.

config STM32_ICACHE_REGION3_RSIZE
	int "ICACHE Region 3 Size"
	default 1
	range 1 7
	depends on STM32_ICACHE_REGION3
	---help---
		Set the size of Region 3.
                1 = 2 Mbytes, 2 = 4 Mbytes, 3 = 8 Mbytes, 4 = 16 Mbytes,
                5 = 2 Mbytes, 6 = 64 Mbytes, 7 = 128 Mbytes.

config STM32_ICACHE_REGION3_REMAPADDR
	hex "ICACHE Region 3 Remap Address Bits [31:21]"
	default 0
	range 0 2047
	depends on STM32_ICACHE_REGION3
	---help---
		Set bits [31:21] of ICACHE Region 3 Remap Address..

config STM32_ICACHE_REGION3_MSTSEL
	int "ICACHE Region 3 Master Select (0 or 1)"
	default 0
	range 0 1
	depends on STM32_ICACHE_REGION3
	---help---
		Select ICACHE Region 3 Master 1 (0) or Master 2 (1).

config STM32_ICACHE_REGION3_HBURST
	int "ICACHE Region 3 Output Burst Type (0 = Wrap, 1 = Incr)"
	default 0
	range 0 1
	depends on STM32_ICACHE_REGION3
	---help---
		Select Wrap (0) or Increment (1) Output Burst Type.

endmenu # Region 3 Configuration

endmenu # ICACHE Region Configuration

endmenu # ICACHE Configuration
```

## arch/arm/src/common/stm32/Kconfig.can
```kconfig
#
# STM32 CAN configuration options.
#

choice
	prompt "CAN character driver or SocketCAN support"
	default STM32_CAN_CHARDRIVER

config STM32_CAN_CHARDRIVER
	bool "STM32 CAN character driver support"
	select ARCH_HAVE_CAN_ERRORS
	select CAN

config STM32_CAN_SOCKET
	bool "STM32 CAN SocketCAN support"
	select NET_CAN_HAVE_ERRORS

endchoice # CAN character driver or SocketCAN support

config STM32_CAN1_BAUD
	int "CAN1 BAUD"
	depends on STM32_CAN1
	default 250000
	---help---
		CAN1 BAUD rate.  Required if CONFIG_STM32_CAN1 is defined.

config STM32_CAN2_BAUD
	int "CAN2 BAUD"
	depends on STM32_CAN2
	default 250000
	---help---
		CAN2 BAUD rate.  Required if CONFIG_STM32_CAN2 is defined.

config STM32_CAN3_BAUD
	int "CAN3 BAUD"
	depends on STM32_CAN3
	default 250000
	---help---
		CAN3 BAUD rate. Required if CONFIG_STM32_CAN3 is defined.

config STM32_CAN_TSEG1
	int "TSEG1 quanta"
	default 6
	---help---
		The number of CAN time quanta in segment 1. Default: 6

config STM32_CAN_TSEG2
	int "TSEG2 quanta"
	default 7
	---help---
		The number of CAN time quanta in segment 2. Default: 7

config STM32_CAN_REGDEBUG
	bool "CAN Register level debug"
	depends on DEBUG_CAN_INFO
	---help---
		Output detailed register-level CAN device debug information.
		Requires also CONFIG_DEBUG_CAN_INFO.
```
