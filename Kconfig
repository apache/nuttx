## arch/arm/src/bcm2708/Kconfig
```kconfig
#
# For a description of the syntax of this configuration file,
# see the file kconfig-language.txt in the NuttX tools repository.
#

if ARCH_CHIP_BCM2708

comment "BCM2708 Configuration Options"

choice
	prompt "BCM2708 Chip Selection"
	default ARCH_CHIP_BCM2835

config ARCH_CHIP_BCM2835
	bool "Broadcom BCM2835"

endchoice # BCM2708 Configuration Option

menu "BCM2708 Peripheral Selections"

config BCM2708_MINI_UART
	bool "Mini-UART"

config BCM2708_PL011_UART
	bool "PL011 UART"

config BCM2708_SPI1
	bool "SPI1"

config BCM2708_SPI2
	bool "SPI2"

endmenu # BCM2708 Peripheral Selections

menu "BCM2708 UART Configuration"
	depends on BCM2708_MINI_UART || BCM2708_PL011_UART

menu "BCM2708 Mini-UART Configuration"
	depends on BCM2708_MINI_UART

config BCM2708_MINI_UART_RXBUFSIZE
	int "Receive buffer size"
	default 256
	---help---
		Characters are buffered as they are received. This specifies
		the size of the receive buffer.

config BCM2708_MINI_UART_TXBUFSIZE
	int "Transmit buffer size"
	default 256
	---help---
		Characters are buffered before being sent.  This specifies
		the size of the transmit buffer.

config BCM2708_MINI_UART_BAUD
	int "BAUD rate"
	default 115200
	---help---
		The configured BAUD of the UART.

config BCM2708_MINI_UART_BITS
	int "Character size"
	default 8
	---help---
		The number of bits.  Must be either 7 or 8.

config BCM2708_MINI_UART_PARITY
	int "Parity setting"
	range 0 2
	default 0
	---help---
		0=no parity, 1=odd parity, 2=even parity

config BCM2708_MINI_UART_2STOP
	int "use 2 stop bits"
	default 0
	---help---
		1=Two stop bits

config BCM2708_MINI_UART_IFLOWCONTROL
	bool "Mini-UART RTS flow control"
	default n
	select SERIAL_IFLOWCONTROL
	---help---
		Enable BCM2708_MINI_UART RTS flow control

config BCM2708_MINI_UART_OFLOWCONTROL
	bool "Mini-UART CTS flow control"
	default n
	select SERIAL_OFLOWCONTROL
	---help---
		Enable BCM2708_MINI_UART CTS flow control

config BCM2708_MINI_UART_BREAKS
	bool "Break support"
	default n
	---help---
		Support BSD style BREAK IOCTL commands

endmenu # BCM2708 Mini-UART Configuration

menu "BCM2708 PL011 UART Configuration"
	depends on BCM2708_PL011_UART

config BCM2708_PL011_UART_RXBUFSIZE
	int "Receive buffer size"
	default 256
	---help---
		Characters are buffered as they are received. This specifies
		the size of the receive buffer.

config BCM2708_PL011_UART_TXBUFSIZE
	int "Transmit buffer size"
	default 256
	---help---
		Characters are buffered before being sent.  This specifies
		the size of the transmit buffer.

config BCM2708_PL011_UART_BAUD
	int "BAUD rate"
	default 115200
	---help---
		The configured BAUD of the UART.

config BCM2708_PL011_UART_BITS
	int "Character size"
	default 8
	---help---
		The number of bits.  Must be either 7 or 8.

config BCM2708_PL011_UART_PARITY
	int "Parity setting"
	range 0 2
	default 0
	---help---
		0=no parity, 1=odd parity, 2=even parity

config BCM2708_PL011_UART_2STOP
	int "use 2 stop bits"
	default 0
	---help---
		1=Two stop bits

config BCM2708_PL011_UART_IFLOWCONTROL
	bool "UART RTS flow control"
	default n
	select SERIAL_IFLOWCONTROL
	---help---
		Enable UART RTS flow control. CD, DSR, DTR, and RI are not supported.

config BCM2708_PL011_UART_OFLOWCONTROL
	bool "UART CTS flow control"
	default n
	select SERIAL_OFLOWCONTROL
	---help---
		Enable UART CTS flow control. CD, DSR, DTR, and RI are not supported.

endmenu # BCM2708 PL011 UART Configuration

choice
	prompt "BCM2708 Serial Console"
	default BCM2708_NO_SERIAL_CONSOLE
	depends on DEV_CONSOLE

config BCM2708_MINI_UART_SERIAL_CONSOLE
	bool "Use Mini-UART as the serial console"
	depends on BCM2708_MINI_UART
	select OTHER_SERIAL_CONSOLE
	---help---
		Use the Mini-UART as the serial console

config BCM2708_PL011_UART_SERIAL_CONSOLE
	bool "Use PO011 UART as the serial console"
	depends on BCM2708_PL011_UART
	select OTHER_SERIAL_CONSOLE
	---help---
		Use the PO011 UART as the serial console

config BCM2708_NO_SERIAL_CONSOLE
	bool "No serial console"
	---help---
		No serial based console

endchoice # BCM2708 Serial Console
endmenu # BCM2708 UART Configuration

config BCM2708_GPIO_IRQ
	bool "GPIO pin interrupts"
	---help---
		Enable support for interrupting GPIO pins

endif # ARCH_CHIP_BCM2708
```

## arch/arm/src/c5471/Kconfig
```kconfig
#
# For a description of the syntax of this configuration file,
# see the file kconfig-language.txt in the NuttX tools repository.
#

comment "C5471 Configuration Options"

menu "IrDA UART Configuration"

config UART_IRDA_BAUD
	int "IrDA UART BAUD"
	default 115200

config UART_IRDA_PARITY
	int "IrDA UART parity"
	default 0
	---help---
		IrDA UART parity.  0=None, 1=Odd, 2=Even.  Default: None

config UART_IRDA_BITS
	int "IrDA UART number of bits"
	default 8
	---help---
		IrDA UART number of bits.  Default: 8

config UART_IRDA_2STOP
	int "IrDA UART two stop bits"
	default 0
	---help---
		0=1 stop bit, 1=Two stop bits.  Default: 1 stop bit

config UART_IRDA_RXBUFSIZE
	int "IrDA UART Rx buffer size"
	default 256
	---help---
		IrDA UART Rx buffer size.  Default: 256

config UART_IRDA_TXBUFSIZE
	int "IrDA UART Tx buffer size"
	default 256
	---help---
		IrDA UART Tx buffer size.  Default: 256

endmenu # IrDA UART Configuration

menu "Modem UART Configuration"

config UART_MODEM_BAUD
	int "IrDA UART BAUD"
	default 115200

config UART_MODEM_PARITY
	int "IrDA UART parity"
	default 0
	---help---
		IrDA UART parity.  0=None, 1=Odd, 2=Even.  Default: None

config UART_MODEM_BITS
	int "IrDA UART number of bits"
	default 8
	---help---
		IrDA UART number of bits.  Default: 8

config UART_MODEM_2STOP
	int "IrDA UART two stop bits"
	default 0
	---help---
		0=1 stop bit, 1=Two stop bits.  Default: 1 stop bit

config UART_MODEM_RXBUFSIZE
	int "IrDA UART Rx buffer size"
	default 256
	---help---
		IrDA UART Rx buffer size.  Default: 256

config UART_MODEM_TXBUFSIZE
	int "IrDA UART Tx buffer size"
	default 256
	---help---
		IrDA UART Tx buffer size.  Default: 256

endmenu # Modem UART Configuration

choice
	prompt "Ethernet PHY"
	default C5471_PHY_LU3X31T_T64

config C5471_PHY_NONE
	bool "None"

config C5471_PHY_AC101L
	bool "AC101L"

config C5471_PHY_LU3X31T_T64
	bool "LU3X31T T64"

endchoice

choice
	prompt "PHY mode"
	default C5471_AUTONEGOTIATION

config C5471_AUTONEGOTIATION
	bool "Autonegotiation"

config C5471_BASET100
	bool "100BaseT FullDuplex"

config C5471_BASET10
	bool "10BaseT FullDuplex"

endchoice

choice
	prompt "Ethernet work queue"
	default C5471_LPWORK if SCHED_LPWORK
	default C5471_HPWORK if !SCHED_LPWORK && SCHED_HPWORK
	depends on SCHED_WORKQUEUE
	---help---
		Work queue support is required to use the Ethernet driver.  If the
		low priority work queue is available, then it should be used by the
		driver.

config C5471_HPWORK
	bool "High priority"
	depends on SCHED_HPWORK

config C5471_LPWORK
	bool "Low priority"
	depends on SCHED_LPWORK

endchoice # Work queue
```

## arch/arm/src/calypso/Kconfig
```kconfig
#
# For a description of the syntax of this configuration file,
# see misc/tools/kconfig-language.txt.
#

comment "Calypso Configuration Options"

menu "Modem UART Configuration"

config UART_MODEM_BAUD
	int "Modem UART BAUD"
	default 115200

config UART_MODEM_PARITY
	int "Modem UART parity"
	default 0
	---help---
		Modem UART parity.  0=None, 1=Odd, 2=Even.  Default: None

config UART_MODEM_BITS
	int "Modem UART number of bits"
	default 8
	---help---
		Modem UART number of bits.  Default: 8

config UART_MODEM_2STOP
	int "Modem UART two stop bits"
	default 0
	---help---
		0=1 stop bit, 1=Two stop bits.  Default: 1 stop bit

config UART_MODEM_RXBUFSIZE
	int "Modem UART Rx buffer size"
	default 256
	---help---
		Modem UART Rx buffer size.  Default: 256

config UART_MODEM_TXBUFSIZE
	int "Modem UART Tx buffer size"
	default 256
	---help---
		Modem UART Tx buffer size.  Default: 256

config UART_MODEM_HWFLOWCONTROL
	bool "Hardware flow control"
	default n
	---help---
		Enabled Modem UART hardware flow control. Default: n

endmenu

menu "IrDA UART Configuration"

config UART_IRDA_BAUD
	int "IrDA UART BAUD"
	default 115200

config UART_IRDA_PARITY
	int "IrDA UART parity"
	default 0
	---help---
		IrDA UART parity.  0=None, 1=Odd, 2=Even.  Default: None

config UART_IRDA_BITS
	int "IrDA UART number of bits"
	default 8
	---help---
		IrDA UART number of bits.  Default: 8

config UART_IRDA_2STOP
	int "IrDA UART two stop bits"
	default 0
	---help---
		0=1 stop bit, 1=Two stop bits.  Default: 1 stop bit

config UART_IRDA_RXBUFSIZE
	int "IrDA UART Rx buffer size"
	default 256
	---help---
		IrDA UART Rx buffer size.  Default: 256

config UART_IRDA_TXBUFSIZE
	int "IrDA UART Tx buffer size"
	default 256
	---help---
		IrDA UART Tx buffer size.  Default: 256

config UART_IRDA_HWFLOWCONTROL
	bool "Hardware flow control"
	default n
	---help---
		Enabled IrDA UART hardware flow control. Default: n

endmenu

choice
	prompt "Serial Console Selection"
	default SERIAL_CONSOLE_NONE

config SERCOMM_CONSOLE
	bool "SERCOMM console"

config SERIAL_MODEM_CONSOLE
	bool "Serial console on modem UART"

config SERIAL_IRDA_CONSOLE
	bool "Serial console on IrDA UART"

config SERIAL_CONSOLE_NONE
	bool "No serial console"

endchoice
```

## arch/arm/src/common/stm32/Kconfig
```kconfig
#
# Common STM32 Kconfig options shared by STM32 families.
#

menu "STM32 Configuration Options"
	depends on ARCH_CHIP_STM32

config STM32_COMMON_LEGACY
	bool
	default y if ARCH_CHIP_STM32F1
	default y if ARCH_CHIP_STM32F2
	default y if ARCH_CHIP_STM32F3
	default y if ARCH_CHIP_STM32F4
	default y if ARCH_CHIP_STM32G4
	default y if ARCH_CHIP_STM32L1

config STM32_COMMON_F0_L0_G0_C0
	bool
	default y if ARCH_CHIP_STM32F0
	default y if ARCH_CHIP_STM32L0
	default y if ARCH_CHIP_STM32G0
	default y if ARCH_CHIP_STM32C0

config STM32_COMMON_F7_H7
	bool
	default y if ARCH_CHIP_STM32F7
	default y if ARCH_CHIP_STM32H7

config STM32_COMMON_H7_H5
	bool
	default y if ARCH_CHIP_STM32H7
	default y if ARCH_CHIP_STM32H5

config STM32_COMMON_F7_H7_H5
	bool
	default y if STM32_COMMON_F7_H7
	default y if ARCH_CHIP_STM32H5

config STM32_COMMON_L4_L5_U5
	bool
	default y if ARCH_CHIP_STM32L4
	default y if ARCH_CHIP_STM32L5
	default y if ARCH_CHIP_STM32U5

config STM32_COMMON_L5_U5
	bool
	default y if ARCH_CHIP_STM32L5
	default y if ARCH_CHIP_STM32U5

config STM32_COMMON_L4_H5_L5_U5
	bool
	default y if STM32_COMMON_L4_L5_U5
	default y if ARCH_CHIP_STM32H5

config STM32_COMMON_FULL_FEATURED
	bool
	default y if STM32_COMMON_LEGACY
	default y if STM32_COMMON_F0_L0_G0_C0
	default y if STM32_COMMON_F7_H7_H5
	default y if STM32_COMMON_L4_L5_U5

config STM32_COMMON_SRAM2_OPTIONS
	bool
	default y if ARCH_CHIP_STM32L4
	default y if ARCH_CHIP_STM32H5
	default y if ARCH_CHIP_STM32L5
	default y if ARCH_CHIP_STM32U5 && STM32_SRAM2

source "arch/arm/src/common/stm32/Kconfig.have"

source "arch/arm/src/common/stm32/Kconfig.periph"

menu "ADC Configuration"
	depends on STM32_ADC
source "arch/arm/src/common/stm32/Kconfig.adc"
endmenu # ADC Configuration

menu "SDADC Configuration"
	depends on STM32_SDADC
source "arch/arm/src/common/stm32/Kconfig.sdadc"
endmenu # SDADC Configuration

menu "Cache Configuration"
source "arch/arm/src/common/stm32/Kconfig.cache"
endmenu # Cache Configuration

menu "CAN Configuration"
	depends on STM32_CAN
source "arch/arm/src/common/stm32/Kconfig.can"
endmenu # CAN Configuration

menu "FDCAN Configuration"
	depends on STM32_FDCAN
source "arch/arm/src/common/stm32/Kconfig.fdcan"
endmenu # FDCAN Configuration

menu "DAC Configuration"
	depends on STM32_DAC
source "arch/arm/src/common/stm32/Kconfig.dac"
endmenu # DAC Configuration

menu "DFSDM Configuration"
	depends on STM32_DFSDM1 || STM32_MDF1 || STM32_ADF1
source "arch/arm/src/common/stm32/Kconfig.dfsdm"
endmenu # DFSDM Configuration

menu "DMA Configuration"
	depends on STM32_DMA || STM32_DMA2D
source "arch/arm/src/common/stm32/Kconfig.dma"
endmenu # DMA Configuration

menu "Ethernet Configuration"
	depends on STM32_ETHMAC
source "arch/arm/src/common/stm32/Kconfig.eth"
endmenu # Ethernet Configuration

menu "Flash Configuration"
source "arch/arm/src/common/stm32/Kconfig.flash"
endmenu # Flash Configuration

menu "FOC Configuration"
	depends on STM32_HAVE_COMMON_FOC
source "arch/arm/src/common/stm32/Kconfig.foc"
endmenu # FOC Configuration

menu "GPIO Configuration"
source "arch/arm/src/common/stm32/Kconfig.gpio"
endmenu # GPIO Configuration

menu "I2C Configuration"
	depends on STM32_I2C
source "arch/arm/src/common/stm32/Kconfig.i2c"
endmenu # I2C Configuration

menu "IPCC Configuration"
	depends on STM32_IPCC || STM32_HAVE_HSEM
source "arch/arm/src/common/stm32/Kconfig.ipcc"
endmenu # IPCC Configuration

menu "BLE Configuration"
	depends on STM32_BLE || STM32_MBOX
source "arch/arm/src/common/stm32/Kconfig.ble"
endmenu # BLE Configuration

menu "LTDC Configuration"
	depends on STM32_LTDC
source "arch/arm/src/common/stm32/Kconfig.ltdc"
endmenu # LTDC Configuration

menu "Memory Configuration"
source "arch/arm/src/common/stm32/Kconfig.memory"
endmenu # Memory Configuration

menu "QSPI/OCTOSPI Configuration"
	depends on STM32_QSPI || STM32_QSPI1 || STM32_OCTOSPI1 || STM32_OCTOSPI2
source "arch/arm/src/common/stm32/Kconfig.qspi"
endmenu # QSPI/OCTOSPI Configuration

menu "RTC Configuration"
	depends on STM32_RTC
source "arch/arm/src/common/stm32/Kconfig.rtc"
endmenu # RTC Configuration

menu "SAI Configuration"
source "arch/arm/src/common/stm32/Kconfig.sai"
endmenu # SAI Configuration

menu "SDIO/SDMMC Configuration"
	depends on STM32_SDIO || STM32_SDMMC
source "arch/arm/src/common/stm32/Kconfig.sdio"
endmenu # SDIO/SDMMC Configuration

menu "COMP Configuration"
	depends on STM32_COMP
source "arch/arm/src/common/stm32/Kconfig.comp"
endmenu # COMP Configuration

menu "DTS Configuration"
	depends on STM32_DTS
source "arch/arm/src/common/stm32/Kconfig.dts"
endmenu # DTS Configuration

menu "U[S]ART Configuration"
	depends on STM32_USART
source "arch/arm/src/common/stm32/Kconfig.uart"
endmenu # U[S]ART Configuration

menu "SPI/I2S Configuration"
	depends on STM32_SPI || STM32_I2S
source "arch/arm/src/common/stm32/Kconfig.spi"
endmenu # SPI/I2S Configuration

menu "System Configuration"
source "arch/arm/src/common/stm32/Kconfig.system"
endmenu # System Configuration

menu "Timer Configuration"
	depends on STM32_TIM || STM32_LPTIM
source "arch/arm/src/common/stm32/Kconfig.tim"
endmenu # Timer Configuration

menu "HRTIM Configuration"
	depends on STM32_HRTIM
source "arch/arm/src/common/stm32/Kconfig.hrtim"
endmenu # HRTIM Configuration

menu "USB Configuration"
	depends on STM32_USB || STM32_USBFS || STM32_OTGFS || STM32_OTGHS || STM32_OTGFSHS
source "arch/arm/src/common/stm32/Kconfig.usb"
endmenu # USB Configuration

endmenu # Common STM32 Configuration Options
```
