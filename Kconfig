## arch/arm/src/armv7-r/Kconfig
```kconfig
#
# For a description of the syntax of this configuration file,
# see the file kconfig-language.txt in the NuttX tools repository.
#

comment "ARMv7-R Configuration Options"

config ARMV7R_HAVE_GICv2
	bool "ARMV7R_GICv2 support"
	select ARCH_HAVE_IRQTRIGGER
	default y
	---help---
		Selected by the configuration tool if the architecture supports the
		Generic Interrupt Controller (GIC)

config ARMV7R_HAVE_PTM
	bool
	default n
	---help---
		Selected by the configuration tool if the architecture supports the
		per-processor Private Timers (PTMs)

config ARMV7R_MEMINIT
	bool
	default y if BOOT_SDRAM_DATA
	default n if !BOOT_SDRAM_DATA
	---help---
		If this configuration *not* selected, then it is assumed that all
		memory resources are initialized via arm_data_initialize() and
		available at power-up reset time.  Other memories, such as SDRAM or
		some ECC SRAM memories, require some platform-specific
		initialization first.  In that case, this option should be selected
		and the platform-specific implementation of arm_boot() must perform
		the memory initialization first, then explicitly call
		arm_data_initialize().

config ARMV7R_HAVE_L2CC
	bool
	default n
	---help---
		Selected by the configuration tool if the architecture supports any
		kind of L2 cache.

config ARMV7R_HAVE_L2CC_PL310
	bool
	default n
	select ARMV7R_HAVE_L2CC
	---help---
		Set by architecture-specific code if the hardware supports a PL310
		r3p2 L2 cache (only version r3p2 is supported).

if ARMV7R_HAVE_L2CC

menu "L2 Cache Configuration"

config ARMV7R_L2CC_PL310
	bool "ARMv7-R L2CC P310 Support"
	default n
	depends on ARMV7R_HAVE_L2CC_PL310
	select ARCH_L2CACHE
	---help---
		Enable the 2 Cache Controller (L2CC) is based on the L2CC-PL310 ARM
		multi-way cache macrocell, version r3p2.  The addition of an on-chip
		secondary cache, also referred to as a Level 2 or L2 cache, is a
		method of improving the system performance when significant memory
		traffic is generated by the processor.

if ARCH_L2CACHE
if ARMV7R_L2CC_PL310

config PL310_LOCKDOWN_BY_MASTER
	bool "PL310 Lockdown by Master"
	default n

config PL310_LOCKDOWN_BY_LINE
	bool "PL310 Lockdown by Line"
	default n

config PL310_ADDRESS_FILTERING
	bool "PL310 Address Filtering by Line"
	default n

config PL310_TRCR
	bool "PL310 TRCR set by usr"
	default n

if PL310_TRCR
config PL310_TRCR_TSETLAT
	int "PL310 TRCR setup latency"
	default 1

config PL310_TRCR_TRDLAT
	bool "PL310 TRCR read access latency"
	default 1

config PL310_TRCR_WRLAT
	bool "PL310 TRCR write access latency"
	default 1
endif # PL310_TRCR

config PL310_DRCR
	bool "PL310 DRCR set by usr"
	default n

if PL310_DRCR
config PL310_DRCR_TSETLAT
	int "PL310 DRCR setup latency"
	default 1

config PL310_DRCR_TRDLAT
	bool "PL310 DRCR read access latency"
	default 1

config PL310_DRCR_WRLAT
	bool "PL310 DRCR write access latency"
	default 1
endif # PL310_DRCR
endif # ARMV7R_L2CC_PL310

choice
	prompt "L2 Cache Associativity"
	default ARMV7R_ASSOCIATIVITY_8WAY
	depends on ARCH_L2CACHE
	---help---
		This choice specifies the associativity of L2 cache in terms of the
		number of ways.  This value could be obtained by querying cache
		configuration registers.  However, by defining a configuration
		setting instead, we can avoid using RAM memory to hold information
		about properties of the memory.

config ARMV7R_ASSOCIATIVITY_8WAY
	bool "8-Way Associativity"

config ARMV7R_ASSOCIATIVITY_16WAY
	bool "16-Way Associativity"

endchoice # L2 Cache Associativity

choice
	prompt "L2 Cache Way Size"
	default ARMV7R_WAYSIZE_16KB
	depends on ARCH_L2CACHE
	---help---
		This choice specifies size of each way. This value can be obtained
		by querying cache configuration registers.  However, by defining a
		configuration setting instead, we can avoid using RAM memory to hold
		information

config ARMV7R_WAYSIZE_16KB
	bool "16 KiB"

config ARMV7R_WAYSIZE_32KB
	bool "32 KiB"

config ARMV7R_WAYSIZE_64KB
	bool "64 KiB"

config ARMV7R_WAYSIZE_128KB
	bool "128 KiB"

config ARMV7R_WAYSIZE_256KB
	bool "256 KiB"

config ARMV7R_WAYSIZE_512KB
	bool "512 KiB"

endchoice # L2 Cache Associativity
endif # ARCH_L2CACHE
endmenu # L2 Cache Configuration
endif # ARMV7R_HAVE_L2CC

config ARMV7R_HAVE_DECODEFIQ
	bool
	default n

config ARMV7R_DECODEFIQ
	bool "FIQ Handler"
	default n
	depends on ARMV7R_HAVE_DECODEFIQ
	---help---
		Select this option if your platform supports the function
		arm_decodefiq().

config ARMV7R_ALIGNMENT_TRAP
	bool "Enable Alignment Check at __start"
	default n

config ARMV7R_CACHE_ROUND_ROBIN
	bool "Enable Cache Round Robin Replacement Policy at __start"
	default n

config ARMV7R_DCACHE_DISABLE
	bool "Disable DCACHE at __start"
	default n

config ARMV7R_ICACHE_DISABLE
	bool "Disable ICACHE at __start"
	default n

config ARMV7R_SCTLR_CCP15BEN
	bool "Enable CP15 Barrier at __start"
	default y

config ARMV7R_BACKGROUND_REGION
	bool "Enable MPU Background region at __start"
	default y

config ARMV7R_DIV0_FAULT
	bool "Enable DIV0 Fault at __start"
	default n

config ARMV7R_FAST_INTERRUPT
	bool "Enable Fast Interrupts at __start"
	default n

config ARMV7R_IMPL_VECTORS
	bool "Enable Interrupt Vector at __start"
	default n

config ARMV7R_NONMASKABLE_FIQ
	bool "Enable Non-maskable FIQ Support at __start"
	default n
```

## arch/arm/src/armv8-m/Kconfig
```kconfig
#
# For a description of the syntax of this configuration file,
# see the file kconfig-language.txt in the NuttX tools repository.
#

comment "ARMv8-M Configuration Options"

config ARMV8M_HAVE_ICACHE
	bool
	default n

config ARMV8M_HAVE_DCACHE
	bool
	default n

config ARMV8M_USEBASEPRI
	bool "Use BASEPRI Register"
	default y if ARCH_HIPRI_INTERRUPT
	---help---
		Use the BASEPRI register to enable and disable interrupts. By
		default, the PRIMASK register is used for this purpose. This
		usually results in hardfaults when supervisor calls are made.
		Though, these hardfaults are properly handled by the RTOS, the
		hardfaults can confuse some debuggers. With the BASEPRI
		register, these hardfaults, will be avoided. For more details see
		https://cwiki.apache.org/confluence/display/NUTTX/ARMv7-M+Hardfaults%2C+SVCALL%2C+and+Debuggers

		WARNING:  If CONFIG_ARCH_HIPRI_INTERRUPT is selected, then you
		MUST select CONFIG_ARMV8M_USEBASEPRI.  The Kconfig dependencies
		here will permit to select an invalid configuration because it
		cannot enforce that requirement.  If you create this invalid
		configuration, you will encounter some problems that may be
		very difficult to debug.

config ARMV8M_ICACHE
	bool "Use I-Cache"
	default n
	depends on ARMV8M_HAVE_ICACHE
	select ARCH_ICACHE

config ARMV8M_DCACHE
	bool "Use D-Cache"
	default n
	depends on ARMV8M_HAVE_DCACHE
	select ARCH_DCACHE

config ARMV8M_DCACHE_WRITETHROUGH
	bool "D-Cache Write-Through"
	default n
	depends on ARMV8M_DCACHE

config ARMV8M_HAVE_ITCM
	bool
	default n

config ARMV8M_HAVE_DTCM
	bool
	default n

config ARMV8M_ITCM
	bool "Use ITCM"
	default n
	depends on ARMV8M_HAVE_ITCM

config ARMV8M_DTCM
	bool "Use DTCM"
	default n
	depends on ARMV8M_HAVE_DTCM

config ARMV8M_TARGET2_PREL
	bool "R_ARM_TARGET2 is PC relative"
	default n if !CXX_EXCEPTION
	default y if CXX_EXCEPTION
	depends on LIBC_ARCH_ELF
	---help---
		Perform a PC relative relocation for relocation type R_ARM_TARGET2

choice
	prompt "Select the stack protection Schema"
	default ARMV8M_STACKCHECK_NONE

config ARMV8M_STACKCHECK_NONE
	bool "Do not check for stack overflow"

config ARMV8M_STACKCHECK
	bool "Check for stack overflow on each function call"
	---help---
		This check uses R10 to check for a stack overflow within each
		function call. This has performances and code size impacts, but it
		will be able to catch hard to find stack overflows.

		Currently only available only for the STM32, SAM3/4 and SAMA5D
		architectures.  The changes are not complex and patches for
		other architectures will be accepted.

		This option requires that you are using a GCC toolchain and that
		you also include -finstrument-functions in your CFLAGS when you
		compile.  This addition to your CFLAGS should probably be added
		to the definition of the CFFLAGS in your board Make.defs file.

config ARMV8M_STACKCHECK_HARDWARE
	bool "Check for stack overflow by stack pointer limit register"
	---help---
		This option signifies the CPU has the MSPLIM, PSPLIM registers.

		The stack pointer limit registers, MSPLIM, PSPLIM, limit the
		extend to which the Main and Process Stack Pointers, respectively,
		can descend. MSPLIM, PSPLIM are always present in ARMv8-M
		MCUs that implement the ARMv8-M Main Extension (Mainline).

		In an ARMv8-M Mainline implementation with the Security Extension
		the MSPLIM, PSPLIM registers have additional Secure instances.
		In an ARMv8-M Baseline implementation with the Security Extension
		the MSPLIM, PSPLIM registers have only Secure instances.

endchoice

config ARMV8M_ITMSYSLOG
	bool "ITM SYSLOG support"
	default n
	select ARCH_SYSLOG
	select SYSLOG
	---help---
		Enable hooks to support ITM syslog output.  This requires additional
		MCU support in order to be used.  See arch/arm/src/armv8-m/itm_syslog.h
		for additional initialization information.

if ARMV8M_ITMSYSLOG

config ARMV8M_ITMSYSLOG_PORT
	int "ITM SYSLOG Port"
	default 0
	range 0 31

config ARMV8M_ITMSYSLOG_SWODIV
	int "ITM SYSLOG SWO divider"
	default 15
	range 1 8192

endif # ARMV8M_ITMSYSLOG

config ARMV8M_SYSTICK
	bool "SysTick timer driver"
	depends on TIMER
	---help---
		Enable SysTick timer driver.
```

## arch/arm/src/armv8-r/Kconfig
```kconfig
#
# For a description of the syntax of this configuration file,
# see the file kconfig-language.txt in the NuttX tools repository.
#

comment "ARMv8-R Configuration Options"

config ARMV8R_HAVE_GICv3
	bool "ARMV8R_GICv3 support"
	select ARCH_HAVE_IRQTRIGGER
	default y
	---help---
		Selected by the configuration tool if the architecture supports the
		Generic Interrupt Controller (GIC)

if ARMV8R_HAVE_GICv3

config ARMV8R_GIC_EOIMODE
	bool
	default n
	---help---
		Enable GICC_CTLR.EOImode, this will separates the priority drop and interrupt
		deactivation operations.

config ARMV8R_GIC_SPI_EDGE
	bool "Configure all SPIs(Shared Peripheral Interrupts) as edge-triggered by default"
	default n
	---help---
		Configure all SPIs(Shared Peripheral Interrupts) as edge-triggered by default.

endif # ARMV8R_HAVE_GICv3

config ARMV8R_MEMINIT
	bool
	default BOOT_SDRAM_DATA
	---help---
		If this configuration *not* selected, then it is assumed that all
		memory resources are initialized via arm_data_initialize() and
		available at power-up reset time.  Other memories, such as SDRAM or
		some ECC SRAM memories, require some platform-specific
		initialization first.  In that case, this option should be selected
		and the platform-specific implementation of arm_boot() must perform
		the memory initialization first, then explicitly call
		arm_data_initialize().

config ARMV8R_ALIGNMENT_TRAP
	bool "Enable Alignment Check at __start"
	default n

config ARMV8R_CACHE_ROUND_ROBIN
	bool "Enable Cache Round Robin Replacement Policy at __start"
	default n

config ARMV8R_DCACHE_DISABLE
	bool "Disable DCACHE at __start"
	default n

config ARMV8R_ICACHE_DISABLE
	bool "Disable ICACHE at __start"
	default n

config ARMV8R_SCTLR_CCP15BEN
	bool "Enable CP15 Barrier at __start"
	default y

config ARMV8R_BACKGROUND_REGION
	bool "Enable MPU Background region at __start"
	default y

config ARMV8R_DIV0_FAULT
	bool "Enable DIV0 Fault at __start"
	default n

config ARMV8R_FAST_INTERRUPT
	bool "Enable Fast Interrupts at __start"
	default n

config ARMV8R_NONMASKABLE_FIQ
	bool "Enable Non-maskable FIQ Support at __start"
	default n

config ARMV8R_HAVE_L2CC
	bool
	default n
	---help---
		Selected by the configuration tool if the architecture supports any
		kind of L2 cache.

config ARMV8R_HAVE_L2CC_PL310
	bool
	default n
	select ARMV8R_HAVE_L2CC
	---help---
		Set by architecture-specific code if the hardware supports a PL310
		r3p2 L2 cache (only version r3p2 is supported).

if ARMV8R_HAVE_L2CC

menu "L2 Cache Configuration"

config ARMV8R_L2CC_PL310
	bool "ARMv8-R L2CC P310 Support"
	default n
	depends on ARMV8R_HAVE_L2CC_PL310
	select ARCH_L2CACHE
	---help---
		Enable the 2 Cache Controller (L2CC) is based on the L2CC-PL310 ARM
		multi-way cache macrocell, version r3p2.  The addition of an on-chip
		secondary cache, also referred to as a Level 2 or L2 cache, is a
		method of improving the system performance when significant memory
		traffic is generated by the processor.

if ARCH_L2CACHE
if ARMV8R_L2CC_PL310

config PL310_LOCKDOWN_BY_MASTER
	bool "PL310 Lockdown by Master"
	default n

config PL310_LOCKDOWN_BY_LINE
	bool "PL310 Lockdown by Line"
	default n

config PL310_ADDRESS_FILTERING
	bool "PL310 Address Filtering by Line"
	default n

config PL310_TRCR
	bool "PL310 TRCR set by usr"
	default n

if PL310_TRCR
config PL310_TRCR_TSETLAT
	int "PL310 TRCR setup latency"
	default 1

config PL310_TRCR_TRDLAT
	int "PL310 TRCR read access latency"
	default 1

config PL310_TRCR_TWRLAT
	int "PL310 TRCR write access latency"
	default 1

endif # PL310_TRCR

config PL310_DRCR
	bool "PL310 DRCR set by usr"
	default n

if PL310_DRCR
config PL310_DRCR_DSETLAT
	int "PL310 DRCR setup latency"
	default 1

config PL310_DRCR_DRDLAT
	int "PL310 DRCR read access latency"
	default 1

config PL310_DRCR_DWRLAT
	int "PL310 DRCR write access latency"
	default 1

endif # PL310_DRCR
endif # ARMV8R_L2CC_PL310

choice
	prompt "L2 Cache Associativity"
	default ARMV8R_ASSOCIATIVITY_8WAY
	depends on ARCH_L2CACHE
	---help---
		This choice specifies the associativity of L2 cache in terms of the
		number of ways.  This value could be obtained by querying cache
		configuration registers.  However, by defining a configuration
		setting instead, we can avoid using RAM memory to hold information
		about properties of the memory.

config ARMV8R_ASSOCIATIVITY_8WAY
	bool "8-Way Associativity"

config ARMV8R_ASSOCIATIVITY_16WAY
	bool "16-Way Associativity"

endchoice # L2 Cache Associativity

choice
	prompt "L2 Cache Way Size"
	default ARMV8R_WAYSIZE_16KB
	depends on ARCH_L2CACHE
	---help---
		This choice specifies size of each way. This value can be obtained
		by querying cache configuration registers.  However, by defining a
		configuration setting instead, we can avoid using RAM memory to hold
		information

config ARMV8R_WAYSIZE_16KB
	bool "16 KiB"

config ARMV8R_WAYSIZE_32KB
	bool "32 KiB"

config ARMV8R_WAYSIZE_64KB
	bool "64 KiB"

config ARMV8R_WAYSIZE_128KB
	bool "128 KiB"

config ARMV8R_WAYSIZE_256KB
	bool "256 KiB"

config ARMV8R_WAYSIZE_512KB
	bool "512 KiB"

endchoice # L2 Cache Way Size
endif # ARCH_L2CACHE
endmenu # L2 Cache Configuration
endif # ARMV8R_HAVE_L2CC
```
