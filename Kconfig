## arch/arm/src/am67/Kconfig
```kconfig
#
# For a description of the syntax of this configuration file,
# see the file kconfig-language.txt in the NuttX tools repository.
#

comment "AM67 Configuration Options"

config AM67_GPIO
	bool "AM67 padconfig GPIO driver"
	default y
	---help---
		Enable the AM67 GPIO driver used by PX4 board support and
		example applications (LED, IMU_EN, SPI CS padconfig).


config AM67_EPWM0
	bool "AM67 EPWM0 driver"
	default n
	depends on PWM
	select ARCH_HAVE_PWM_MULTICHAN
	---help---
		Enable EPWM driver on EPWM0 (outputs A and B; requires
		PWM_MULTICHAN with PWM_NCHANNELS >= 2)

config AM67_EPWM1
	bool "AM67 EPWM1 driver"
	default n
	depends on PWM
	select ARCH_HAVE_PWM_MULTICHAN
	---help---
		Enable EPWM driver on EPWM1 (outputs A and B on HAT GPIO-6
		and GPIO-13; requires PWM_MULTICHAN with PWM_NCHANNELS >= 2).
		EPWM2 is the board cooling fan and is deliberately not
		supported.


config AM67_MCSPI0
	bool "AM67 MCU_MCSPI0 master driver"
	default n
	depends on SPI
	---help---
		Enable polled SPI master on MCU_MCSPI0 @ 0x04b00000 (onboard
		ICM-20948 CS3 and LPS22DF CS1).

if AM67_MCSPI0

config AM67_MCSPI0_FCLK
	int "MCU_MCSPI0 functional clock (Hz)"
	default 48000000

endif

config AM67_I2C
	bool "AM67 I2C support"
	default n
	depends on I2C

if AM67_I2C

config AM67_I2C0
	bool "AM67 MCU_I2C0 driver (MCU domain, 0x04900000)"
	default n
	---help---
		Enable the I2C master driver for MCU_I2C0.

config AM67_WKUP_I2C0
	bool "AM67 WKUP_I2C0 driver (WKUP domain, 0x2b200000)"
	default n
	---help---
		Enable the I2C master driver for WKUP_I2C0.

endif # AM67_I2C
```

## arch/arm/src/arm/Kconfig
```kconfig
#
# For a description of the syntax of this configuration file,
# see the file kconfig-language.txt in the NuttX tools repository.
#

comment "ARM Configuration Options"

config ARM_ALIGNMENT_TRAP
	bool "Enable Alignment Check at __start"
	default n

config ARM_DCACHE_WRITETHROUGH
	bool "Enable DCACHE Write-Through at __start"
	default n

config ARM_CACHE_ROUND_ROBIN
	bool "Enable Cache Round Robin Replacement Policy at __start"
	default n

config ARM_DCACHE_DISABLE
	bool "Disable DCACHE at __start"
	default n

config ARM_ICACHE_DISABLE
	bool "Disable ICACHE at __start"
	default n
```

## arch/arm/src/armv6-m/Kconfig
```kconfig
#
# For a description of the syntax of this configuration file,
# see the file kconfig-language.txt in the NuttX tools repository.
#

comment "ARMv6-M Configuration Options"

choice
	prompt "Toolchain Selection"
	default ARMV6M_TOOLCHAIN_GNU_EABI

config ARMV6M_TOOLCHAIN_BUILDROOT
	bool "Buildroot (Cygwin or Linux)"
	select ARCH_TOOLCHAIN_GNU

config ARMV6M_TOOLCHAIN_GNU_EABI
	bool "Generic GNU EABI toolchain"
	select ARCH_TOOLCHAIN_GNU
	---help---
		This option should work for any modern GNU toolchain (GCC 4.5 or newer)
		configured for arm-none-eabi.

config ARMV6M_TOOLCHAIN_CLANG
	bool "Generic Clang toolchain"
	select ARCH_TOOLCHAIN_CLANG

endchoice
```

## arch/arm/src/armv7-a/Kconfig
```kconfig
#
# For a description of the syntax of this configuration file,
# see the file kconfig-language.txt in the NuttX tools repository.
#

comment "ARMv7-A Configuration Options"

config ARMV7A_HAVE_GICv2
	bool
	select ARCH_HAVE_IRQTRIGGER
	select ARCH_HAVE_IRQPRIO
	select ARCH_HAVE_HIPRI_INTERRUPT
	default n
	---help---
		Selected by the configuration tool if the architecture supports the
		Generic Interrupt Controller (GIC)

if ARMV7A_HAVE_GICv2

config ARMV7A_GIC_EOIMODE
	bool "Enable GIC EOImode"
	default n
	---help---
		Enable GICC_CTLR.EOImode, this will separates the priority drop and interrupt
		deactivation operations.

config ARMV7A_GICV2_LEGACY_IRQ0
	int "pci legacy irq0 default val"
	default 35
	---help---
		The qemu pci lagacy irq0 default is 35. -1 mean disable

config ARMV7A_GICv2M
	bool "gic support msi irq"
	depends on PCI_MSIX
	default n

endif # ARMV7A_HAVE_GICv2

config ARMV7A_HAVE_GTM
	bool
	default n
	---help---
		Selected by the configuration tool if the architecture supports the
		Global Timer (GTM)

config ARMV7A_HAVE_PTM
	bool
	default n
	---help---
		Selected by the configuration tool if the architecture supports the
		per-processor Private Timers (PTMs)

config ARMV7A_HAVE_L2CC
	bool
	default n
	---help---
		Selected by the configuration tool if the architecture supports any
		kind of L2 cache.

config ARMV7A_SMP_BUSY_WAIT
	bool "Busy wait when SMP boot"
	default n
	depends on SMP
	---help---
		Enables busy wait when SMP boot

config ARMV7A_SMP_BUSY_WAIT_FLAG_ADDR
	hex "Busy wait flag address"
	depends on ARMV7A_SMP_BUSY_WAIT

config ARMV7A_HAVE_L2CC_PL310
	bool
	default n
	select ARMV7A_HAVE_L2CC
	---help---
		Set by architecture-specific code if the hardware supports a PL310
		r3p2 L2 cache (only version r3p2 is supported).

if ARMV7A_HAVE_L2CC

menu "L2 Cache Configuration"

config ARMV7A_L2CC_PL310
	bool "ARMv7-A L2CC P310 Support"
	default n
	depends on ARMV7A_HAVE_L2CC_PL310
	select ARCH_L2CACHE
	---help---
		Enable the 2 Cache Controller (L2CC) is based on the L2CC-PL310 ARM
		multi-way cache macrocell, version r3p2.  The addition of an on-chip
		secondary cache, also referred to as a Level 2 or L2 cache, is a
		method of improving the system performance when significant memory
		traffic is generated by the processor.

if ARCH_L2CACHE
if ARMV7A_L2CC_PL310

config PL310_LOCKDOWN_BY_MASTER
	bool "PL310 Lockdown by Master"
	default n

config PL310_LOCKDOWN_BY_LINE
	bool "PL310 Lockdown by Line"
	default n

config PL310_ADDRESS_FILTERING
	bool "PL310 Address Filtering by Line"
	default n

config PL310_TRCR
	bool "PL310 TRCR set by usr"
	default n

if PL310_TRCR
config PL310_TRCR_TSETLAT
	int "PL310 TRCR setup latency"
	default 1

config PL310_TRCR_TRDLAT
	int "PL310 TRCR read access latency"
	default 1

config PL310_TRCR_TWRLAT
	int "PL310 TRCR write access latency"
	default 1
endif # PL310_TRCR

config PL310_DRCR
	bool "PL310 DRCR set by usr"
	default n

if PL310_DRCR
config PL310_DRCR_DSETLAT
	int "PL310 DRCR setup latency"
	default 1

config PL310_DRCR_DRDLAT
	int "PL310 DRCR read access latency"
	default 1

config PL310_DRCR_DWRLAT
	int "PL310 DRCR write access latency"
	default 1
endif # PL310_DRCR
endif # ARMV7A_L2CC_PL310

choice
	prompt "L2 Cache Associativity"
	default ARMV7A_ASSOCIATIVITY_8WAY
	depends on ARCH_L2CACHE
	---help---
		This choice specifies the associativity of L2 cache in terms of the
		number of ways.  This value could be obtained by querying cache
		configuration registers.  However, by defining a configuration
		setting instead, we can avoid using RAM memory to hold information
		about properties of the memory.

config ARMV7A_ASSOCIATIVITY_8WAY
	bool "8-Way Associativity"

config ARMV7A_ASSOCIATIVITY_16WAY
	bool "16-Way Associativity"

endchoice # L2 Cache Associativity

choice
	prompt "L2 Cache Way Size"
	default ARMV7A_WAYSIZE_16KB
	depends on ARCH_L2CACHE
	---help---
		This choice specifies size of each way. This value can be obtained
		by querying cache configuration registers.  However, by defining a
		configuration setting instead, we can avoid using RAM memory to hold
		information

config ARMV7A_WAYSIZE_16KB
	bool "16 KiB"

config ARMV7A_WAYSIZE_32KB
	bool "32 KiB"

config ARMV7A_WAYSIZE_64KB
	bool "64 KiB"

config ARMV7A_WAYSIZE_128KB
	bool "128 KiB"

config ARMV7A_WAYSIZE_256KB
	bool "256 KiB"

config ARMV7A_WAYSIZE_512KB
	bool "512 KiB"

endchoice # L2 Cache Associativity
endif # ARCH_L2CACHE
endmenu # L2 Cache Configuration
endif # ARMV7A_HAVE_L2CC

config ARMV7A_ALIGNMENT_TRAP
	bool "Enable Alignment Check at __start"
	default n

config ARMV7A_CACHE_ROUND_ROBIN
	bool "Enable Cache Round Robin Replacement Policy at __start"
	default n

config ARMV7A_DCACHE_DISABLE
	bool "Disable DCACHE at __start"
	default n

config ARMV7A_ICACHE_DISABLE
	bool "Disable ICACHE at __start"
	default n

config ARMV7A_AFE_ENABLE
	bool "Enable Access Flag at __start"
	default n
```

## arch/arm/src/armv7-m/Kconfig
```kconfig
#
# For a description of the syntax of this configuration file,
# see the file kconfig-language.txt in the NuttX tools repository.
#

comment "ARMv7-M Configuration Options"

config ARMV7M_HAVE_ICACHE
	bool
	default n

config ARMV7M_HAVE_DCACHE
	bool
	default n

config ARMV7M_BASEPRI_WAR
	bool "Cortex-M7 r0p1 Errata 837070 Workaround"
	default n
	depends on ARCH_CORTEXM7
	---help---
		Enable workaround for r0p1 Errata 837070: Increasing priority using
		write to BASEPRI does not take effect immediately.

		This update is required to be serialized to the instruction stream
		meaning that after this update completes, it takes effect
		immediately and no exceptions of lower priority than the new boosted
		priority can preempt execution.  Because of this erratum, the
		priority boosting does not take place immediately, allowing the
		instruction after the MSR to be interrupted by an exception of
		lower priority than the new boosted priority. This effect is only
		limited to the next instruction. Subsequent instructions are
		guaranteed to see the new boosted priority.

config ARMV7M_ICACHE
	bool "Use I-Cache"
	default n
	depends on ARMV7M_HAVE_ICACHE
	select ARCH_ICACHE

config ARMV7M_DCACHE
	bool "Use D-Cache"
	default n
	depends on ARMV7M_HAVE_DCACHE
	select ARCH_DCACHE

config ARMV7M_DCACHE_WRITETHROUGH
	bool "D-Cache Write-Through"
	default n
	depends on ARMV7M_DCACHE

config ARMV7M_HAVE_ITCM
	bool
	default n

config ARMV7M_HAVE_DTCM
	bool
	default n

config ARMV7M_ITCM
	bool "Use ITCM"
	default n
	depends on ARMV7M_HAVE_ITCM

config ARMV7M_DTCM
	bool "Use DTCM"
	default n
	depends on ARMV7M_HAVE_DTCM

config ARMV7M_TARGET2_PREL
	bool "R_ARM_TARGET2 is PC relative"
	default CXX_EXCEPTION
	depends on LIBC_ARCH_ELF
	---help---
		Perform a PC relative relocation for relocation type R_ARM_TARGET2

config ARMV7M_HAVE_STACKCHECK
	bool
	default n

config ARMV7M_STACKCHECK
	bool "Check for stack overflow on each function call"
	default n
	depends on ARMV7M_HAVE_STACKCHECK
	---help---
		This check uses R10 to check for a stack overflow within each
		function call. This has performances and code size impacts, but it
		will be able to catch hard to find stack overflows.

		Currently only available only for the STM32, SAM3/4 and SAMA5D
		architectures.  The changes are not complex and patches for
		other architectures will be accepted.

		This option requires that you are using a GCC toolchain and that
		you also include -finstrument-functions and -ffixed-r10 in your
		CFLAGS when you compile. This addition to your CFLAGS should probably
		be added to the definition of the CFFLAGS in your board Make.defs file.

config ARMV7M_STACKCHECK_BREAKPOINT
	bool "Breakpoint on stack overflow"
	default n
	depends on ARMV7M_STACKCHECK
	---help---
		If enabled, a hard-coded breakpoint will be inserted to the stack
		overflow trap. This is useful to stop the execution of the program
		and diagnose the issue before the hardfault handler is called (and
		context information is lost).

config ARMV7M_ITMSYSLOG
	bool "ITM SYSLOG support"
	default n
	select SYSLOG_REGISTER
	---help---
		Enable hooks to support ITM syslog output.  This requires additional
		MCU support in order to be used.  See arch/arm/src/armv7-m/itm_syslog.h
		for additional initialization information.

if ARMV7M_ITMSYSLOG

config ARMV7M_ITMSYSLOG_PORT
	int "ITM SYSLOG Port"
	default 0
	range 0 31

config ARMV7M_ITMSYSLOG_SWODIV
	int "ITM SYSLOG SWO divider"
	default 15
	range 1 8192

endif # ARMV7M_ITMSYSLOG

config ARMV7M_SYSTICK
	bool "SysTick timer driver"
	depends on TIMER
	---help---
		Enable SysTick timer driver.

config ARMV7M_SYSTICK_IRQ_WQUEUE
	bool "attach irq by irq_attach_wqueue"
	default n
	depends on ARMV7M_SYSTICK

if ARMV7M_SYSTICK_IRQ_WQUEUE

config ARMV7M_SYSTICK_IRQ_WQUEUE_PRIORITY
	int "SYSTICK IRQ WQUEUE PRIORITY"
	default 255
	range 0 255

config ARMV7M_SYSTICK_IRQ_THREAD_STACK_SIZE
	int "SYSTICK IRQ THREAD STACK SIZE"
	default DEFAULT_TASK_STACKSIZE

endif # ARMV7M_SYSTICK_IRQ_WQUEUE
```
