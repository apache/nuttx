## arch/8051/Kconfig
```kconfig
#
# For a description of the syntax of this configuration file,
# see misc/tools/kconfig-language.txt.
#

if ARCH_8051
comment "ARM Options"

choice
	prompt "8051 Chip Selection"
	default ARCH_CHIP_8052

config ARCH_CHIP_8051
	bool "8051"

config ARCH_CHIP_8052
	bool "8052"

endchoice # 8051 Chip Selection

comment "Bring-up Debug Options"

config ARCH_8051_BRINGUP
	bool "Bring-up debug"
	default n
	---help---
		Enable bring-up debug instrumentation

config ARCH_8051_NOSYSTIMER
	bool "No system timer"
	---help---
		By default, Timer0 will be used as the system timer.  Use of the
		system timer can be suppressed with the setting.  This is useful
		during bring-up.

config ARCH_8051_BRINGUP
	bool "Bring-up debug"
	default n
	---help---
		Enable bring-up debug instrumentation

config ARCH_8051_SUPRESS_INTERRUPTS
	bool "Suppress interrupts"
	default n
	---help---
		It is useful during low-level bring-up to suppress all interrupts.

endif # ARCH_8051
```
