/****************************************************************************
 * libs/libc/math/lib_scalbnf.c
 * get a double number of x*2^n
 *
 * This file is a part of NuttX:
 *
 *   Copyright (C) 2012 Gregory Nutt. All rights reserved.
 *   Ported by: Darcy Gong
 *
 *
 ****************************************************************************/

/****************************************************************************
 * Included Files
 ****************************************************************************/

#include <math.h>
#include <stdint.h>

#define FLT_MIN 0x1p-126f
/****************************************************************************
 * Public Functions
 ****************************************************************************/

/****************************************************************************
 * Name: scalbnf
 *
 * Description:
 *   get a float number of x*2^n
 *
 ****************************************************************************/

float scalbnf(float x, int n)
{
  union
    {
      float f;
      uint32_t i;
    }u;

  float_t y = x;

  if (n > 127)
    {
      y *= 0x1p127f;
      n -= 127;
      if (n > 127)
        {
          y *= 0x1p127f;
          n -= 127;
          if (n > 127)
            {
              n = 127;
            }
        }
    }
  else if (n < -126)
    {
      y *= FLT_MIN * 0x1p24f;
      n += 126 - 24;
      if (n < -126)
        {
          y *= FLT_MIN * 0x1p24f;
          n += 126 - 24;
          if (n < -126)
            {
              n = -126;
            }
        }
    }

  u.i = (uint32_t)(0x7f + n) << 23;
  x = y * u.f;
  return x;
}

