## libs/libm/Kconfig
```kconfig
#
# For a description of the syntax of this configuration file,
# see the file kconfig-language.txt in the NuttX tools repository.
#

choice
	prompt "Select math library"
	default LIBM_NONE if DEFAULT_SMALL
	default LIBM_TOOLCHAIN if !DEFAULT_SMALL

config LIBM
	bool "Math library from NuttX"
	depends on !ARCH_MATH_H
	select ARCH_FLOAT_H
	---help---
		By default, no math library will be provided by NuttX.  In this
		case, it is assumed that (1) no math library is required, or (2) you
		will be using the math.h and float.h headers file and the libm
		library provided by your toolchain.

		This is may be a very good choice is possible because your toolchain
		may have have a highly optimized version of libm.

		Another possibility is that you have a custom, architecture-specific
		math library and that the corresponding math.h file resides at
		arch/<architecture>/include/math.h.  The option is selected via
		CONFIG_ARCH_MATH_H.  If ARCH_MATH_H is selected,then the
		include/nuttx/libmath.h header file will be copied to include/math.h
		where it can be used by your applications.

		If ARCH_MATH_H is not defined, then this option can be selected to
		build a generic, math library built into NuttX.  This math library
		comes from the Rhombus OS and was written by Nick Johnson.  The
		Rhombus OS math library port was contributed by Darcy Gong.

config LIBM_NEWLIB
	bool "Math library from Newlib"
	depends on !ARCH_MATH_H
	---help---
		Math library from Newlib

config LIBM_LIBMCS
	bool "Math library from LibmCS"
	depends on !ARCH_MATH_H
	depends on ALLOW_BSD_COMPONENTS
	---help---
		Math library from libmcs

config LIBM_OPENLIBM
	bool "Math library from openlibm"
	depends on !ARCH_MATH_H
	---help---
		Math library from openlibm

config LIBM_TOOLCHAIN
	bool "Math library from toolchain"

config LIBM_NONE
	bool "No math library"

endchoice

if LIBM
source "libs/libm/libm/Kconfig"
endif

if LIBM_NEWLIB
source "libs/libm/newlib/Kconfig"
endif

if LIBM_LIBMCS
source "libs/libm/libmcs/Kconfig"
endif
```

## libs/libm/libm/Kconfig
```kconfig
#
# For a description of the syntax of this configuration file,
# see the file kconfig-language.txt in the NuttX tools repository.
#

# These are library functions that may be overridden by architecture-
# specific implementations.  Not all architectures support implementations
# for every library function.

# Default settings for C library functions that may be replaced with
# architecture-specific versions.

config LIBM_ARCH_CEIL
	bool
	default n
	depends on LIBM

config LIBM_ARCH_FLOOR
	bool
	default n
	depends on LIBM

config LIBM_ARCH_NEARBYINT
	bool
	default n
	depends on LIBM

config LIBM_ARCH_RINT
	bool
	default n
	depends on LIBM

config LIBM_ARCH_ROUND
	bool
	default n
	depends on LIBM

config LIBM_ARCH_TRUNC
	bool
	default n
	depends on LIBM

config LIBM_ARCH_CEILF
	bool
	default n
	depends on LIBM

config LIBM_ARCH_FLOORF
	bool
	default n
	depends on LIBM

config LIBM_ARCH_NEARBYINTF
	bool
	default n
	depends on LIBM

config LIBM_ARCH_RINTF
	bool
	default n
	depends on LIBM

config LIBM_ARCH_ROUNDF
	bool
	default n
	depends on LIBM

config LIBM_ARCH_TRUNCF
	bool
	default n
	depends on LIBM

config LIBM_ARCH_FABSF
	bool
	default n

config LIBM_ARCH_SQRTF
	bool
	default n

# One or more the of above may be selected by architecture specific logic

if ARCH_ARM
source "libs/libm/libm/arm/Kconfig"
endif
```

## libs/libm/libm/arm/Kconfig
```kconfig
#
# For a description of the syntax of this configuration file,
# see the file kconfig-language.txt in the NuttX tools repository.
#

if ARCH_ARMV7M
source "libs/libm/libm/arm/armv7-m/Kconfig"
endif

if ARCH_ARMV8M
source "libs/libm/libm/arm/armv8-m/Kconfig"
endif
```

## libs/libm/libm/arm/armv7-m/Kconfig
```kconfig
#
# For a description of the syntax of this configuration file,
# see the file kconfig-language.txt in the NuttX tools repository.
#

if ARCH_ARMV7M

config ARMV7M_LIBM
	bool "Architecture specific FPU optimizations"
	default n
	select LIBM_ARCH_FABSF
	select LIBM_ARCH_SQRTF
	depends on ARCH_FPU
	depends on LIBM
	---help---
		Enable ARMv7E-M specific floating point optimizations
		for fabsf() and fsqrtf()

endif
```

## libs/libm/libm/arm/armv8-m/Kconfig
```kconfig
#
# For a description of the syntax of this configuration file,
# see the file kconfig-language.txt in the NuttX tools repository.
#

if ARCH_ARMV8M

config ARMV8M_LIBM
	bool "Architecture specific optimizations"
	default n
	select LIBM_ARCH_CEIL if ARCH_DPFPU
	select LIBM_ARCH_FLOOR if ARCH_DPFPU
	select LIBM_ARCH_NEARBYINT if ARCH_DPFPU
	select LIBM_ARCH_RINT if ARCH_DPFPU
	select LIBM_ARCH_ROUND if ARCH_DPFPU
	select LIBM_ARCH_TRUNC if ARCH_DPFPU
	select LIBM_ARCH_CEILF if ARCH_FPU
	select LIBM_ARCH_FLOORF if ARCH_FPU
	select LIBM_ARCH_NEARBYINTF if ARCH_FPU
	select LIBM_ARCH_RINTF if ARCH_FPU
	select LIBM_ARCH_ROUNDF if ARCH_FPU
	select LIBM_ARCH_TRUNCF if ARCH_FPU
	depends on LIBM
	---help---
		Enable ARMv8 specific floating point optimizations.

endif
```

## libs/libm/libmcs/Kconfig
```kconfig
#
# For a description of the syntax of this configuration file,
# see the file kconfig-language.txt in the NuttX tools repository.
#

config LIBM_LIBMCS_WANT_COMPLEX
	bool "libmcs complex support"
	default y
	---help---
		complex support, will use complex.h
```

## libs/libm/newlib/Kconfig
```kconfig
#
# For a description of the syntax of this configuration file,
# see the file kconfig-language.txt in the NuttX tools repository.
#

config LIBM_NEWLIB_HW_FP
	bool "Newlib hardware floating-point routines"
	default n
	---help---
		The option is being disabled because the mathfp library is
		not up to standard due to inaccuracies caused by some of the
		floating-point algorithms used.
```

## libs/libnx/Kconfig
```kconfig
#
# For a description of the syntax of this configuration file,
# see the file kconfig-language.txt in the NuttX tools repository.
#

source libs/libnx/nx/Kconfig
source libs/libnx/nxfonts/Kconfig
source libs/libnx/nxglib/Kconfig
source libs/libnx/nxmu/Kconfig
source libs/libnx/nxtk/Kconfig
```
