## libs/libc/string/Kconfig
```kconfig
#
# For a description of the syntax of this configuration file,
# see the file kconfig-language.txt in the NuttX tools repository.
#

menu "errno Decode Support"

config LIBC_STRERROR
	bool "Enable strerror"
	default n
	---help---
		strerror() is useful because it decodes 'errno' values into a human readable
		strings.  But it can also require a lot of memory.  If this option is not
		selected, strerror() will still exist in the build but it will not decode error
		values.  This option should be used by other logic to decide if it should use
		strerror() or not.  For example, the NSH application will not use strerror()
		if this option is not selected; perror() will not use strerror() is this option
		is not selected (see also NSH_STRERROR).

config LIBC_STRERROR_SHORT
	bool "Use short error descriptions in strerror()"
	default n
	depends on LIBC_STRERROR
	---help---
		If this option is selected, then strerror() will use a shortened string when
		it decodes the error.  Specifically, strerror() is simply use the string that
		is the common name for the error.  For example, the 'errno' value of 2 will
		produce the string "No such file or directory" is LIBC_STRERROR_SHORT
		is not defined but the string "ENOENT" is LIBC_STRERROR_SHORT is defined.

config LIBC_PERROR_STDOUT
	bool "perror() to stdout"
	default n
	---help---
		POSIX requires that perror() provide its output on stderr.  This option may
		be defined, however, to provide perror() output that is serialized with
		other stdout messages.

endmenu # errno Decode Support

menu "memcpy/memset Options"

config MEMCPY_VIK
	bool "Vik memcpy()"
	default n
	depends on !LIBC_ARCH_MEMCPY
	---help---
		Select this option to use the optimized memcpy() function by Daniel Vik.
		Select this option for improved performance at the expense of increased
		size. See licensing information in the top-level LICENSE file.

if MEMCPY_VIK

config MEMCPY_PRE_INC_PTRS
	bool "Pre-increment pointers"
	default n
	---help---
		Use pre-increment of pointers. Default is post increment of pointers.

config MEMCPY_INDEXED_COPY
	bool "Array indexing"
	default y
	---help---
		Copying data using array indexing. Using this option, disables the
		MEMCPY_PRE_INC_PTRS option.

config MEMCPY_64BIT
	bool "64-bit memcpy()"
	default n
	---help---
		Compiles memcpy() for architectures that support 64-bit operations
		efficiently.

endif # MEMCPY_VIK

config MEMSET_OPTSPEED
	bool "Optimize memset() for speed"
	default n
	depends on !LIBC_ARCH_MEMSET
	---help---
		Select this option to use a version of memcpy() optimized for speed.
		Default: memcpy() is optimized for size.

config MEMSET_64BIT
	bool "64-bit memset()"
	default n
	depends on MEMSET_OPTSPEED
	---help---
		Compiles memset() for architectures that support 64-bit operations
		efficiently.

endmenu # memcpy/memset Options
```

## libs/libc/symtab/Kconfig
```kconfig
#
# For a description of the syntax of this configuration file,
# see the file kconfig-language.txt in the NuttX tools repository.
#

config ALLSYMS
	bool "Load all symbols for debugging"
	default n
	---help---
		Say Y here to let the nuttx print out symbolic crash information and
		symbolic stack backtraces. This increases the size of the nuttx
		somewhat, as all symbols have to be loaded into the nuttx image.

config SYMTAB_ORDEREDBYNAME
	bool "Symbol Tables Ordered by Name"
	default n
	---help---
		Select if the symbol table is ordered by symbol name.  In this case,
		the logic can perform faster lookups using a binary search.
		Otherwise, the symbol table is assumed to be un-ordered and only
		slow, linear searches are supported.

config SYMTAB_ORDEREDBYVALUE
	bool "Symbol Tables Ordered by Value"
	default n
	---help---
		Select if the symbol table is ordered by symbol value.

config SYMTAB_DECORATED
	bool "Symbols are decorated with leading underscores"
	default n
	---help---
		Select if symbols in relocatable objects are decorated with a leading
		underscore. This option will remove the underscore from symbol names
		when relocating a loadable object.
```

## libs/libc/time/Kconfig
```kconfig
#
# For a description of the syntax of this configuration file,
# see the file kconfig-language.txt in the NuttX tools repository.
#

menu "Time/Time Zone Support"

config LIBC_STRFTIME_C_STANDARD_FORMATS
	bool "strftime ISO C conversion specifiers"
	default !DEFAULT_SMALL
	---help---
		Enable ISO C strftime conversion specifiers that are not part of
		the small always-enabled subset.  Disabling this option
		removes support for %A, %B, %I, %j, %p, %U, %w, %W, %x, %X, and
		%y.  The always-enabled subset is %a, %b/%h, %d, %H, %m, %M,
		%S, %Y, and %%.

		Disabling this option makes strftime smaller, but the implementation
		no longer supports all conversion specifiers required by ISO C.

config LIBC_STRFTIME_POSIX_FORMATS
	bool "strftime POSIX conversion specifiers"
	default !DEFAULT_SMALL
	depends on LIBC_STRFTIME_C_STANDARD_FORMATS
	---help---
		Enable POSIX strftime conversion specifiers beyond ISO C that are
		implemented by NuttX.  Disabling this option removes support for
		%C, %e, %F, %g, %G, %n, %r, %R, %t, %T, %u, %V, and %z.
		Enabling this option also enables the ISO C conversion specifiers.

		Note that %h is kept in the always-enabled subset as an alias for
		%b because it shares the same implementation.  Some POSIX
		specifiers may be controlled by other options.

config LIBC_STRFTIME_NONSTANDARD_FORMATS
	bool "strftime non-standard conversion specifiers"
	default !DEFAULT_SMALL
	---help---
		Enable NuttX/GNU-style strftime conversion specifiers that are not
		required by ISO C or POSIX.  Disabling this option removes support
		for %k, %l, %P, and %s.

config LIBC_LOCALTIME
	bool "localtime API call support"
	default "n"
	depends on !DISABLE_ENVIRON
	---help---
		localtime API call support

		Logic currently depends on file system support with, at a minimum, these
		files in the zoneinfo directory:  GMT and posixrules.  An additional
		timezone file is required for any additional, local time zone(s) and the
		environment variable TZ must be set to the name of that timezone file
		when tzset() is called.

		See https://www.iana.org/time-zones .  See also libs/libc/zoneinfo
		which provides a framework for incorporating the TZ database into a
		NuttX build.

if LIBC_LOCALTIME

config LIBC_TZ_MAX_TIMES
	int "Maximum number of times in timezone"
	default 370
	---help---
		Timezone files with more than this number of times will not be used
		(timecnt).

		Warning: Some files in IANA TZ database include many times.  The current
		posixrules file, for example, has timecnt = 236.  The value of
		TX_MAX_ITMES in the tzfile.h header file on my Linux system is 370, the
		default used here.  You may want to reduce this value for a smaller
		footprint.

config LIBC_TZ_MAX_TYPES
	int "Maximum number of TZ types"
	default 20
	---help---
		Maximum number of local time types.  You may want to reduce this value
		for a smaller footprint.

config LIBC_TZDIR
	string "zoneinfo directory path"
	default "/etc/zoneinfo"
	---help---
		This is the full path to the location where the TZ database is expected
		to be found.

config LIBC_ZONEINFO
	bool "TZ database"
	default n
	---help---
		Download and build the TZ/Olson database.

if LIBC_ZONEINFO

config LIBC_ZONEINFO_ROMFS
	bool "Build ROMFS filesystem"
	default n
	depends on FS_ROMFS
	---help---
		Build a mountable ROMFS filesystem containing the TZ/Olson database

endif # LIBC_ZONEINFO
endif # LIBC_LOCALTIME
endmenu # Time/Time Zone Support
```

## libs/libc/unistd/Kconfig
```kconfig
#
# For a description of the syntax of this configuration file,
# see the file kconfig-language.txt in the NuttX tools repository.
#

menu "Program Execution Options"

config LIBC_EXECFUNCS
	bool "Enable exec[l|v] / posix_spawn() Support"
	default n
	depends on !BINFMT_DISABLE
	---help---
		Enable support for the exec[l|v] family of functions that can be
		used to start other programs, terminating the current program and
		the posix_spawn() family of functions that can be used to start other
		programs without terminating the current program.  The typical
		usage of the exec[l|v] functions is (1) first call vfork() to create
		a new thread, then (2) call exec[l|v] to replace the new thread with
		a program from the file system.

		NOTE 1: This two step process start is completely unnecessary in
		NuttX and is provided only for compatibility with Unix systems.  These
		functions are essentially just wrapper functions that (1) call the
		non-standard binfmt function 'exec', and then (2) exit(0).  Since
		the new thread will be terminated by the exec[l|v] call, it really
		served no purpose other than to support Unix compatibility.

		The posix_spawn() functions do not have this inefficiency.

		NOTE 2: Support for exec[l|v] and posix_spawn() is conditional
		because they require additional support for symbol tables that
		will not be available in the typical system.

if LIBC_EXECFUNCS

config EXECFUNCS_HAVE_SYMTAB
	bool "Have symbol table"
	default n
	depends on !BUILD_KERNEL
	---help---
		If you have a system symbol table, then you may select this
		option in order to use it.  Symbol tables are required in most
		cases in order to link executable programs to the base code.

		NOTE: This option only pre-initializes the system symbol table as
		defined by CONFIG_EXECFUNCS_SYMTAB_ARRAY and CONFIG_EXECFUNCS_NSYMBOLS_VAR.
		This is simply an optional, automatic initialization of the
		system symbol table.  You would need to do this, for example, in
		in the kernel build were the first task must be run from a program
		on the file system.  This option has no other effect.

		Optionally, you can always call binfmt_setsymtab() from your
		board-specific logic or, equivalently, call boardctl(BOARDIOC_APP_SYMTAB)
		from your application initialization logic.

if EXECFUNCS_HAVE_SYMTAB

config EXECFUNCS_SYMTAB_ARRAY
	string "Symbol table name used by exec[l|v]"
	default "g_symtab"
	---help---
		The exec[l|v] and posix_spawn() functions are wrapper functions that
		call the non-standard binfmt function 'exec').  The binfmt
		function 'exec' needs to have (1) a symbol table that provides the
		list of symbols exported by the base code, and (2) the number of
		symbols in that table.  This selection provides the name of that
		symbol table.

config EXECFUNCS_NSYMBOLS_VAR
	string "Name of variable holding the number of symbols"
	default "g_nsymbols"
	---help---
		The exec[l|v] and posix_spawn() functions are wrapper functions that
		call the non-standard binfmt function 'exec').  The binfmt
		function 'exec' needs to have (1) a symbol table that provides the
		list of symbols exported by the base code, and (2) the number of
		symbols in that table.  This selection provides the name of an 'int'
		variable that contains the number of symbols in the symbol table.

config EXECFUNCS_SYSTEM_SYMTAB
	bool "Generate and include system symbol table"
	default n
	---help---
		Generate symbol table which includes symbols for all available
		syscalls, libc and libm functions. It makes system significantly
		larger but actual applications can reuse maximum from the system
		image.

		The symbol table array is named g_symtab and variable holding
		number of exported symbols g_nsymbols. It matches expected defaults
		from entries above. But they can be changed and generated symbol table
		can be used as template by application.

endif # EXECFUNCS_HAVE_SYMTAB
endif # LIBC_EXECFUNCS

config SYMTAB_ORDEREDBYNAME
	bool "Symbol Tables Ordered by Name"
	default n
	---help---
		Select if the symbol table is ordered by symbol name.  In this case,
		the logic can perform faster lookups using a binary search.
		Otherwise, the symbol table is assumed to be un-ordered and only
		slow, linear searches are supported.

config SYMTAB_ORDEREDBYVALUE
	bool "Symbol Tables Ordered by Value"
	default n
	---help---
		Select if the symbol table is ordered by symbol value.

config SYMTAB_DECORATED
	bool "Symbols are decorated with leading underscores"
	default n
	---help---
		Select if symbols in relocatable objects are decorated with a leading
		underscore. This option will remove the underscore from symbol names
		when relocating a loadable object.

config POSIX_SPAWN_PROXY_STACKSIZE
	int "Spawn Stack Size"
	default 1024
	---help---
		If posix_spawn[p]() and task_spawn() use I/O redirection options,
		they will require an intermediary/proxy task to muck with the file
		descriptors.  This configuration item specifies the stack size
		used for the proxy. Default: 1024 bytes.

config POSIX_SPAWN_DEFAULT_STACKSIZE
	int "Default task_spawn Stack Size"
	default DEFAULT_TASK_STACKSIZE
	---help---
		The actual size to use for the child task's stack can be set with
		posix_spawnattr_setstacksize().  This value specifies the default
		stack size to use if posix_spawnattr_setstacksize() is not used.
		Default: 2048.

endmenu # Program Execution Options

config LIBC_HOSTNAME
	string "Host name for this device"
	default ""
	---help---
		A unique name to identify device on the network

config LIBC_OPEN_MAX
	int "OPEN_MAX for this device"
	default 255
	---help---
		The maximum number of files that a process can have open
		at any time.  Must not be less than _POSIX_OPEN_MAX.
```

## libs/libc/wchar/Kconfig
```kconfig
#
# For a description of the syntax of this configuration file,
# see the file kconfig-language.txt in the NuttX tools repository.
#

#menu "Wide character support"

config LIBC_WCHAR
	bool "Enable wide-characters (Unicode) support"
	default n
	---help---
		By default, wide-characters support is disabled.

#endmenu # Wide character support
```

## libs/libdsp/Kconfig
```kconfig
#
# For a description of the syntax of this configuration file,
# see the file kconfig-language.txt in the NuttX tools repository.
#

menuconfig LIBDSP
	bool "Digital Signal Processing Library"
	default n
	---help---
		Enable build for various DSP functions

if LIBDSP

config LIBDSP_DEBUG
	bool "Libdsp debugging"
	default n
	---help---
		Enable debugging for libdsp. This option enables additional parameters
		checking. It can drastically reduce performance and be potentially
		dangerous to hardware, so it should be used carefully (probably only
		at an early stage of application development).

config LIBDSP_PRECISION
	int "Libdsp precision [0/1/2]"
	default 0
	---help---
		With this option we can select libdsp precision for
		some of calculations. There are 3 available options:
		0 - the fastest calculation but the lowest precision,
		1 - increased precision than for option 0 at the expense
		    of a longer execution time,
		2 - the most accuracte but the slowest one, use standard math functions.

config LIBDSP_FOC_VABC
	bool "Libdsp FOC includes voltage abc frame"

endif # LIBDSP
```
