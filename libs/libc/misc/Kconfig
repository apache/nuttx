## libs/libc/netdb/Kconfig
```kconfig
#
# For a description of the syntax of this configuration file,
# see the file kconfig-language.txt in the NuttX tools repository.
#

config LIBC_NETDB
	bool
	default n

menu "NETDB Support"

config LIBC_GAISTRERROR
	bool "Enable gai_strerror"
	depends on LIBC_NETDB
	default n
	---help---
		The gai_strerror() function shall return a text string describing an error
		value for the getaddrinfo() and getnameinfo(). But it can also require a lot
		of memory. If this option is not selected, gai_strerror() will still exist in
		the build but it will not decode error values.

config NETDB_BUFSIZE
	int "gethostbyname/gethostbyaddr buffer size"
	depends on LIBC_NETDB
	default 256

config NETDB_MAX_IPADDR
	int "Max number of IP addresses per host"
	depends on LIBC_NETDB
	default 2 if NET_IPv4 && NET_IPv6
	default 1
	---help---
		This setting determines the maximum number of IP addresses
		stored to the name resolution cache for a given host.

menuconfig NETDB_HOSTFILE
	bool "Network host file support"
	default n
	select LIBC_NETDB
	---help---
		Enable network host table look ups via gethostbyname() and
		gethostbyaddr().

if NETDB_HOSTFILE

config NETDB_HOSTCONF_PATH
	string "Path to host configuration file"
	default "/etc/hosts"

config NETDB_MAX_ALTNAMES
	int "Max number of alternate host names"
	default 4

endif # NETDB_HOSTFILE

menuconfig NETDB_DNSCLIENT
	bool "DNS Name resolution"
	default n
	depends on NET && NET_UDP
	select LIBC_NETDB
	select NET_SOCKOPTS
	---help---
		Enable support for the name resolution; Enable network host
		resolution via gethostbyname().

if NETDB_DNSCLIENT

config NETDB_DNSCLIENT_ENTRIES
	int "Number of DNS resolver entries"
	default 0 if DEFAULT_SMALL
	default 8 if !DEFAULT_SMALL
	range 0 255
	---help---
		Number of cached DNS resolver entries.  Default: 8.  Zero disables
		all cached name resolutions.

		Disabling the DNS cache means that each access call to
		gethostbyname() will result in a new DNS network query.  If
		CONFIG_NETDB_DNSCLIENT_ENTRIES is non-zero, then entries will be
		cached and if the name mapping can be found in that cache, the
		network query can be avoid.  Of course, this is only useful if you
		query the same name often and if the IP address of the name is
		stable.  If the IP address can change, then caching DNS address
		might have undesirable side-effects (see help for
		CONFIG_NETDB_DNSCLIENT_LIFESEC).

config NETDB_DNSCLIENT_NAMESIZE
	int "Max size of a cached hostname"
	default PATH_MAX
	---help---
		The size of a hostname string in the DNS resolver cache is fixed.
		This setting provides the maximum size of a hostname.  Names longer
		than this will be aliased!  Default: 32

config NETDB_DNSCLIENT_LIFESEC
	int "Life of a DNS cache entry (seconds)"
	default 3600
	---help---
		Cached entries in the name resolution cache older than this will not
		be used.  Default: 1 hour.  Zero means that entries will not expire.

		Small values of CONFIG_NETDB_DNSCLIENT_LIFESEC may result in more
		network DNS queries; larger values can make a host unreachable for
		the entire duration of the timeout value.  This might happen, for
		example, if the remote host was assigned a different IP address by
		a DHCP server.

config NETDB_DNSCLIENT_MAXRESPONSE
	int "Max response size"
	default NETDB_BUFSIZE
	---help---
		This setting determines the maximum size of response message that
		can be received by the DNS resolver.  The default used to be 96,
		which might be enough if you have a control on the DNS servers.
		It may need to be larger on enterprise networks.

config NETDB_DNSCLIENT_RECV_TIMEOUT
	int "DNS receive timeout"
	default 30
	---help---
		This is the timeout value when DNS receives response after
		dns_send_query, unit: seconds

config NETDB_DNSCLIENT_RETRIES
	int "Number of retries for DNS request"
	default 3
	---help---
		This setting determines how many times resolver retries request
		until failing.

config NETDB_RESOLVCONF
	bool "DNS resolver file support"
	default n
	---help---
		Enable DNS server look ups in resolver file like /etc/resolv.conf.

if NETDB_RESOLVCONF

config NETDB_RESOLVCONF_PATH
	string "Path to host configuration file"
	default "/etc/resolv.conf"

config NETDB_RESOLVCONF_NONSTDPORT
	bool "Non-standard port support"
	default n
	---help---
		By default, the resolv.conf file will hold only records like:

			nameserver xx.xx.xx.xx
			nameserver xxxx:::::::xxxx

		The default port of 53 is always assumed.

		If this option is selected, then OpenBSD style resolv.conf files
		will be supported.  This adds logic for a bracket port notation
		like:

			nameserver [xx.xx.xx.xx]:ppppp
			nameserver [xxxx:::::::xxxx]:ppppp

endif # NETDB_RESOLVCONF

config NETDB_DNSSERVER_NAMESERVERS
	int "Max number of configured nameservers"
	default 1
	depends on !NETDB_RESOLVCONF
	---help---
		This setting determines how many nameservers there can be
		in use concurrently.

choice
	prompt "DNS server address type"
	default NETDB_DNSSERVER_IPv4 if NET_IPv4
	default NETDB_DNSSERVER_IPv6 if !NET_IPv4 && NET_IPv6
	default NETDB_DNSSERVER_NOADDR if !NET_IPv4 && !NET_IPv6
	depends on !NETDB_RESOLVCONF

config NETDB_DNSSERVER_NOADDR
	bool "No default DNS server address"
	---help---
		There is not default DNS nameserver address.  Application must call
		dns_add_nameserver() at runtime to add the DNS server address.

config NETDB_DNSSERVER_IPv4
	bool "IPv4 DNS server address"
	depends on NET_IPv4
	---help---
		An IPv4 default DNS nameserver address will be provided.  Application
		may overwrite this start default server address by calling
		dns_add_nameserver() at runtime.

config NETDB_DNSSERVER_IPv6
	bool "IPv6 DNS server address"
	depends on NET_IPv6
	---help---
		An IPv6 default DNS nameserver address will be provided.  Application
		may overwrite this start default server address by calling
		dns_add_nameserver() at runtime.

endchoice # DNS server address type

config NETDB_DNSSERVER_IPv4ADDR
	hex "Target IPv4 address"
	default 0x0a000001
	depends on NETDB_DNSSERVER_IPv4
	---help---
		Default DNS server IPv4 address in host byte order.  Default value
		10.0.0.1.  This may be changed via dns_add_nameserver().

if NETDB_DNSSERVER_IPv6

config NETDB_DNSSERVER_IPv6ADDR_1
	hex "[0]"
	default 0xfc00
	range 0x0 0xffff
	---help---
		This is the default IP address of the DNS server.  This is a 16-bit
		integer value in host order.  Each of the eight values forming the
		full IPv6 address must be specified individually.  This is the first
		of the 8-values.  The default for all eight values is fc00::1.

config NETDB_DNSSERVER_IPv6ADDR_2
	hex "[1]"
	default 0x0000
	range 0x0 0xffff
	---help---
		This is the default IP address of the DNS server.  This is a 16-bit
		integer value in host order.  Each of the eight values forming the
		full IPv6 address must be specified individually.  This is the second
		of the 8-values.  The default for all eight values is fc00::1.

config NETDB_DNSSERVER_IPv6ADDR_3
	hex "[2]"
	default 0x0000
	range 0x0 0xffff
	---help---
		This is the default IP address of the DNS server.  This is a 16-bit
		integer value in host order.  Each of the eight values forming the
		full IPv6 address must be specified individually.  This is the third
		of the 8-values.  The default for all eight values is fc00::1.

config NETDB_DNSSERVER_IPv6ADDR_4
	hex "[3]"
	default 0x0000
	range 0x0 0xffff
	---help---
		This is the default IP address of the DNS server.  This is a 16-bit
		integer value in host order.  Each of the eight values forming the
		full IPv6 address must be specified individually.  This is the fourth
		of the 8-values.  The default for all eight values is fc00::1.

config NETDB_DNSSERVER_IPv6ADDR_5
	hex "[4]"
	default 0x0000
	range 0x0 0xffff
	---help---
		This is the default IP address of the DNS server.  This is a 16-bit
		integer value in host order.  Each of the eight values forming the
		full IPv6 address must be specified individually.  This is the fifth
		of the 8-values.  The default for all eight values is fc00::1.

config NETDB_DNSSERVER_IPv6ADDR_6
	hex "[5]"
	default 0x0000
	range 0x0 0xffff
	---help---
		This is the default IP address of the DNS server.  This is a 16-bit
		integer value in host order.  Each of the eight values forming the
		full IPv6 address must be specified individually.  This is the sixth
		of the 8-values.  The default for all eight values is fc00::1.

config NETDB_DNSSERVER_IPv6ADDR_7
	hex "[6]"
	default 0x0000
	range 0x0 0xffff
	---help---
		This is the default IP address of the DNS server.  This is a 16-bit
		integer value in host order.  Each of the eight values forming the
		full IPv6 address must be specified individually.  This is the seventh
		of the 8-values.  The default for all eight values is fc00::1.

config NETDB_DNSSERVER_IPv6ADDR_8
	hex "[7]"
	default 0x0001
	range 0x0 0xffff
	---help---
		This is the default IP address of the DNS server.  This is a 16-bit
		integer value in host order.  Each of the eight values forming the
		full IPv6 address must be specified individually.  This is the last
		of the 8-values.  The default for all eight values is fc00::1.

endif # NETDB_DNSSERVER_IPv6
endif # NETDB_DNSCLIENT
endmenu # NETDB Support
```

## libs/libc/pwd/Kconfig
```kconfig
#
# For a description of the syntax of this configuration file,
# see the file kconfig-language.txt in the NuttX tools repository.
#

config LIBC_PASSWD_FILE
	bool "Have passwd file"
	default n
	---help---
		Have a passwd file.  The format of the password file is:

		    user:x:uid:gid:home

		  Where:
		    user:  User name
		    x:     Encrypted password
		    uid:   User ID
		    gid:   Group ID
		    home:  Login directory

if LIBC_PASSWD_FILE

config LIBC_PASSWD_FILEPATH
	string "Path to passwd file"
	default "/etc/passwd"
	---help---
		Provides the location of the passwd file.  The default is /etc/passwd

config LIBC_PASSWD_LINESIZE
	int "Maximum line size"
	default 80
	---help---
		The maximum length of one line in the passwd file.  This determines
		the size of the I/O buffer used to access the passwd file.

endif # LIBC_PASSWD_FILE
```

## libs/libc/queue/Kconfig
```kconfig
#
# For a description of the syntax of this configuration file,
# see the file kconfig-language.txt in the NuttX tools repository.
#

config LIBC_INLINE_QUEUE
	bool "Inline queue list to improve the performance"
	default n
	---help---
		Inline queue list to improve the performance
```

## libs/libc/regex/Kconfig
```kconfig
#
# For a description of the syntax of this configuration file,
# see the file kconfig-language.txt in the NuttX tools repository.
#

config LIBC_REGEX
	bool "Enable regex"
	depends on ALLOW_MIT_COMPONENTS
	default y
	---help---
		provide the regex related func, include regcomp, regexec.
```

## libs/libc/sched/Kconfig
```kconfig
#
# For a description of the syntax of this configuration file,
# see the file kconfig-language.txt in the NuttX tools repository.
#

choice
	prompt "CXX initialization style"
	default CXX_INITIALIZE_MACHO if ARCH_SIM && HOST_MACOS
	default CXX_INITIALIZE_SINIT

config CXX_INITIALIZE_SINIT
	bool "_sinit/_einit style intialization"

config CXX_INITIALIZE_MACHO
	bool "Mach-O style intialization (sim/macOS)"

endchoice
```

## libs/libc/stdio/Kconfig
```kconfig
#
# For a description of the syntax of this configuration file,
# see the file kconfig-language.txt in the NuttX tools repository.
#

menu "Standard C I/O"

config STDIO_DISABLE_BUFFERING
	bool "Disable STDIO Buffering"
	depends on FILE_STREAM
	default n
	---help---
		Tiny systems may need to disable all support for I/O buffering in
		order to minimize the memory footprint.

		NOTE that even if STDIO buffering is enabled, you can still disable
		buffering by setting CONFIG_STDIO_BUFFER_SIZE=0 or dynamically
		through the setvbuf() interface.  In this case, however,  memory
		used for buffering will be eliminated, of course, but there will be
		no reduction in static code size.  Only setting
		CONFIG_STDIO_DISABLE_BUFFERING will reduce static code size.

		The setvbuf() interface is not available if
		CONFIG_STDIO_DISABLE_BUFFERING is selected.

if !STDIO_DISABLE_BUFFERING

config STDIO_BUFFER_SIZE
	int "STDIO buffer size"
	default 64
	---help---
		Size of buffers using within the C buffered I/O interfaces (printf,
		putchar, fwrite, etc.).  This function sets the initial I/O buffer
		size.  Zero disables I/O buffering initially.  Any buffer size may
		be subsequently modified using setvbuf().

config STDIO_LINEBUFFER
	bool "STDIO line buffering"
	default y
	---help---
		Sets the default behavior to flush buffered I/O whenever a newline
		character is found in the output data stream.  This setting just
		sets the initial default behavior of all streams.  The behavior of
		an individual stream can be changed via setvbuf().

endif # !STDIO_DISABLE_BUFFERING

config NUNGET_CHARS
	int "Number unget() characters"
	default 2
	---help---
		Number of characters that can be buffered by ungetc() (Only if
		FILE_STREAM equals y)

config LIBC_FLOATINGPOINT
	bool "Enable floating point in printf"
	default !DEFAULT_SMALL && ARCH_FPU
	---help---
		By default, floating point support in printf, sscanf, etc. is
		disabled.  This option will enable floating point support.

config LIBC_LONG_LONG
	bool "Enable long long support in printf"
	default !DEFAULT_SMALL
	---help---
		Enables support for long long formats in printf, sscanf, etc. is
		enabled.  This is enabled by default but if you are trying to
		reduce the FLASH footprint, then disabling this feature is one
		option.  The FLASH saves comes not from disabling the long long
		formats, but rather from omitting the large long long arithmetic
		libraries that will be drawn into the build if long long support
		is enabled.

		NOTE:  This setting has no effect if the underlying architecture
		cannot support long long types

config LIBC_NUMBERED_ARGS
	bool "Enable numbered arguments in printf"
	default n
	depends on LIBC_FLOATINGPOINT || LIBC_LONG_LONG
	---help---
		Enables support for numbered arguments in printf.

		  printf("%3$s %3$s %1$s %2$s\n", "1", "2", "3"); --> "3 3 1 2"
		  printf("%3$*2$.*1$f\n", 4, 8, 1.234567); --> "  1.2346"

		Attention: Mixing of numbered and sequential arguments in one
		format string is not allowed according to POSIX.

config LIBC_NL_ARGMAX
	int "Maximum number of numbered arguments for printf"
	default 16
	range 9 999999
	depends on LIBC_NUMBERED_ARGS
	---help---
		Applies only if there are numbered arguments in your format string.
		The number of sequential arguments isn't affected.
		Will be copied into stdio POSIX macro NL_ARGMAX.

		Attention: Increasing this value will increase stack usage
		of printf.

config LIBC_SCANSET
	bool "Scanset support"
	default n
	---help---
		Add scanset support to sscanf().

endmenu #Standard C I/O
```
