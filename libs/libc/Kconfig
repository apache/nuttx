## libs/libc/Kconfig
```kconfig
#
# For a description of the syntax of this configuration file,
# see the file kconfig-language.txt in the NuttX tools repository.
#

comment "Standard C Library Options"

source "libs/libc/stdio/Kconfig"
source "libs/libc/audio/Kconfig"
source "libs/libc/math/Kconfig"
source "libs/libc/machine/Kconfig"
source "libs/libc/stdlib/Kconfig"
source "libs/libc/unistd/Kconfig"
source "libs/libc/string/Kconfig"
source "libs/libc/pthread/Kconfig"
source "libs/libc/dlfcn/Kconfig"
source "libs/libc/modlib/Kconfig"
source "libs/libc/grp/Kconfig"
source "libs/libc/pwd/Kconfig"
source "libs/libc/locale/Kconfig"
source "libs/libc/lzf/Kconfig"
source "libs/libc/time/Kconfig"
source "libs/libc/tls/Kconfig"
source "libs/libc/net/Kconfig"
source "libs/libc/netdb/Kconfig"
source "libs/libc/misc/Kconfig"
source "libs/libc/wqueue/Kconfig"
source "libs/libc/hex2bin/Kconfig"
source "libs/libc/userfs/Kconfig"
source "libs/libc/builtin/Kconfig"
source "libs/libc/symtab/Kconfig"
source "libs/libc/stream/Kconfig"
source "libs/libc/queue/Kconfig"
```

## libs/libc/audio/libsrc/Kconfig
```kconfig
#
# For a description of the syntax of this configuration file,
# see the file kconfig-language.txt in the NuttX tools repository.
#

config AUDIO_SRC
	bool "Audio Samplerate Converter Library"
	default n
	---help---
		Enable build for various SRC functions

if AUDIO_SRC

choice
	prompt "Audio Conversion Quality"
	default SINC_FAST_CONVERTER
	---help---
		Audio Conversion Quality options:
		    Slowest conversion speed with best quality.
		    Medium conversion speed with medium qulity
		    Fastest conversion with lowest quality

config SINC_FAST_CONVERTER
	bool "Fastest conversion with lowest quality"
	---help---
		Fastest conversion with lowest quality.
		Suitable for most boards due to resource constrains.

config SINC_MEDIUM_CONVERTER
	bool "Medium conversion speed with medium qulity"
	---help---
		Medium conversion speed with medium qulity.
		Not suitable for most boards due to resource constrains.

config SINC_BEST_CONVERTER
	bool "Slowest conversion speed with best quality"
	---help---
		Slowest conversion speed with best quality.
		Not suitable for most boards due to resource constrains.

endchoice

endif # LIBSRC
```

## libs/libc/builtin/Kconfig
```kconfig
#
# For a description of the syntax of this configuration file,
# see the file kconfig-language.txt in the NuttX tools repository.
#

config BUILTIN
	bool "Support Builtin Applications"
	default n
	depends on !BUILD_KERNEL
	---help---
		Enable support for builtin applications.  This features assigns a string
		name to an application and in addition if FS_BINFS is defined, retaining
		those names in a file system from which they can be executed.  This feature
		is also the underlying requirement to support built-in applications in the
		NuttShell (NSH).

config APP_REGISTRY
	bool
	default y if BUILTIN || BUILD_KERNEL
	---help---
		Hidden option indicating that the compile-time name/priority/stacksize
		registry table for applications (struct builtin_s / g_builtins[]) is
		available.  This is a broader condition than BUILTIN: BUILD_KERNEL
		cannot select BUILTIN (main_t dispatch is meaningless when the caller
		and the application are in different address spaces), but it still
		needs this table so that posix_spawn() can pick up each application's
		configured priority and stack size.
```

## libs/libc/debug/Kconfig
```kconfig
#
# For a description of the syntax of this configuration file,
# see the file kconfig-language.txt in the NuttX tools repository.
#

# These are library functions that may be overridden by architecture-
# specific implementations.  Not all architectures support implementations
# for every library function.

menu "Library Debugging"

config UNWINDER
	bool "Stack Unwinder"
	default "n"
	---help---
		This option enables stack unwinding support in NuttX
		using the information automatically generated by the
		compiler. The resulting image is slightly bigger but
		the performance is not affected. Currently, this feature
		only works with EABI compilers.

endmenu # Library Debugging Support
```

## libs/libc/dlfcn/Kconfig
```kconfig
#
# For a description of the syntax of this configuration file,
# see the file kconfig-language.txt in the NuttX tools repository.
#

# menu "Shared Library Support"

config LIBC_DLFCN
	bool "Shared library support"
	default n
	select LIBC_MODLIB if !BUILD_FLAT
	select MODULE if BUILD_FLAT
	---help---
		Enabled support for user-space shared libraries.

if LIBC_DLFCN

config LDPATH_INITIAL
	string "Initial LD_LIBRARY_PATH Value"
	default ""
	depends on LIBC_ENVPATH
	---help---
		The initial value of the LD_LIBRARY_PATH variable.  This is the
		colon-separated list of absolute paths.  E.g., "/lib:/usr/lib:/system/lib"

endif

# endmenu # Shared Library Support
```

## libs/libc/fdt/Kconfig
```kconfig
#
# For a description of the syntax of this configuration file,
# see the file kconfig-language.txt in the NuttX tools repository.
#

config LIBC_FDT
	bool "Flattened Device Tree Library"
	default n
	---help---
		Enable or disable Flattened Device Tree Library features.

if LIBC_FDT

config LIBC_FDT_DTC_VERSION
	string "LIBC FDT DTC Version"
	default "1.7.0"
	---help---
		Version of DTC source code to download from github.

endif # LIBC_FDT
```

## libs/libc/gcov/Kconfig
```kconfig
#
# For a description of the syntax of this configuration file,
# see the file kconfig-language.txt in the NuttX tools repository.
#

config LIB_GCOV
	tristate "Enable GCOV support"
	select HAVE_CXXINITIALIZE
	default n
	---help---
		Enable GCOV support for code coverage analysis.
		After turning on this option, code coverage can be analyzed.
		If this option is enabled, image size and performance will be
		significantly reduced. Before use, you need to add the
		"-fprofile-generate -ftest-coverage" compilation parameters
		to the file to be analyzed.

if LIB_GCOV

choice
	prompt "Select the gcov library source"
	default LIB_GCOV_TOOLCHAIN_CLANG if ARCH_TOOLCHAIN_CLANG
	default LIB_GCOV_TOOLCHAIN_GNU if ARCH_TOOLCHAIN_GNU
	---help---
		Select the gcov library source. This option selects the gcov library
		from the GNU toolchain.

config LIB_GCOV_TOOLCHAIN_GNU
	bool "Use the GNU toolchain GCOV library"
	depends on ARCH_TOOLCHAIN_GNU && !ARCH_TOOLCHAIN_CLANG

config LIB_GCOV_TOOLCHAIN_CLANG
	bool "Use the Clang toolchain GCOV library"
	depends on ARCH_TOOLCHAIN_CLANG
	select COMPILER_RT_PROFILE
	---help---
		Use the toolchain GCOV library. This option selects the gcov library
		from the Clang toolchain.

endchoice

config GCOV_ALL_SOURCES
	bool "Enable gcov call graph for all modules"
	default n
	---help---
		Enable gcov profiling for all code, it will instrument
		all code, which will cause a large performance penalty for the code.

endif
```

## libs/libc/gdbstub/Kconfig
```kconfig
#
# For a description of the syntax of this configuration file,
# see the file kconfig-language.txt in the NuttX tools repository.
#

config LIB_GDBSTUB
	tristate "GDBSTUB"
	depends on ARCH_HAVE_TCBINFO
	---help---
		Enable support for gdbstub.

if LIB_GDBSTUB

config LIB_GDBSTUB_DEBUG
	bool "Gdbstub Debug Info"
	default n
	---help---
		Add debug info to gdbstub

config LIB_GDBSTUB_PKTSIZE
	int "Gdbstub packet size"
	default 32768
	---help---
		The size of the gdbstub packet buffer.

endif # LIB_GDBSTUB
```

## libs/libc/gnssutils/Kconfig
```kconfig
#
# For a description of the syntax of this configuration file,
# see the file kconfig-language.txt in the NuttX tools repository.
#

config GNSSUTILS_MINMEA_LIB
	bool "MINMEA NMEA Library"
	default n
	---help---
		Enable support for the MINMEA NMEA library.

		NOTE: This library depends on having some version of math.h
		at include/nuttx.  There are some different ways to accomplish
		this.  See the discussion in the Documentation/legacy_README.md file.
```

## libs/libc/grp/Kconfig
```kconfig
#
# For a description of the syntax of this configuration file,
# see the file kconfig-language.txt in the NuttX tools repository.
#

config LIBC_GROUP_FILE
	bool "Have group file"
	default n
	---help---
		Have a group file.  The format of the group file is:

		    group:x:gid:users

		  Where:
		    group:  The group name
		    x:      Group password
		    gid:    Group ID
		    users:  A comma separated list of members of the group

if LIBC_GROUP_FILE

config LIBC_GROUP_FILEPATH
	string "Path to group file"
	default "/etc/group"
	---help---
		Provides the location of the group file.  The default is /etc/group

config LIBC_GROUP_NUSERS
	int "Maximum group members"
	default 8
	---help---
		The maximum length number of user names that can be reported for a
		group.

config LIBC_GROUP_LINESIZE
	int "Maximum line size"
	default 80
	---help---
		The maximum length of one line in the group file.  This determines
		the size of the I/O buffer used to access the group file.

endif # LIBC_GROUP_FILE
```

## libs/libc/hex2bin/Kconfig
```kconfig
#
# For a description of the syntax of this configuration file,
# see the file kconfig-language.txt in the NuttX tools repository.
#

config LIBC_HEX2BIN
	bool "Intel HEX to binary conversion library"
	default n
	---help---
		Build in support for conversions from Intel Hex format to binary.
		This selection enables the interfaces of include/hex2bin.h.
```

## libs/libc/librust/Kconfig
```kconfig
#
# For a description of the syntax of this configuration file,
# see the file kconfig-language.txt in the NuttX tools repository.
#

config LIBRUST
	bool "Rust Runtime Compatibility Static Checker"
	default y
	depends on SYSTEM_TIME64
	depends on FS_LARGEFILE
	depends on !SMALL_MEMORY
	depends on TLS_NELEM > 0
	---help---
		This option enables building and linking with Rust language support.
		Currently, it only do static checking for the compatibility of structs
		between Rust and C side.
```

## libs/libc/locale/Kconfig
```kconfig
#
# For a description of the syntax of this configuration file,
# see the file kconfig-language.txt in the NuttX tools repository.
#

menu "Locale Support"

config LIBC_LOCALE
	bool "Enable I18N (LOCALE) support"
	default n
	---help---
		By default, i18n (locale) support is disabled.

if LIBC_LOCALE

config LIBC_LOCALE_CATALOG
	bool "Enable X/Open Message Catalog"
	depends on !DISABLE_ENVIRON
	default n
	---help---
		Enable catopen, catgets and catclose support.

config LIBC_LOCALE_GETTEXT
	bool "Enable GNU gettext(libintl)"
	depends on !DISABLE_ENVIRON
	default n
	---help---
		Enable gettext, textdomain and bindtextdomain support.

config LIBC_LOCALE_PATH
	string "The default search path for message catalog file"
	depends on LIBC_LOCALE_CATALOG || LIBC_LOCALE_GETTEXT
	default "/etc/locale"
	---help---
		This is the default search path to the location where
		the message catalog file is expected to be found.

endif

endmenu # Locale Support
```
