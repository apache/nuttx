## libs/libc/machine/arm/Kconfig
```kconfig
#
# For a description of the syntax of this configuration file,
# see the file kconfig-language.txt in the NuttX tools repository.
#

if ARCH_ARM7TDMI || ARCH_ARM920T || ARCH_ARM926EJS || \
   ARCH_ARM1136J || ARCH_ARM1156T2 || ARCH_ARM1176JZ
source "libs/libc/machine/arm/arm/Kconfig"
endif

if ARCH_ARMV7A
source "libs/libc/machine/arm/armv7-a/Kconfig"
endif

if ARCH_ARMV7R
source "libs/libc/machine/arm/armv7-r/Kconfig"
endif

if ARCH_ARMV6M
source "libs/libc/machine/arm/armv6-m/Kconfig"
endif

if ARCH_ARMV7M
source "libs/libc/machine/arm/armv7-m/Kconfig"
endif

if ARCH_ARMV8M
source "libs/libc/machine/arm/armv8-m/Kconfig"
endif
```

## libs/libc/machine/arm/armv7-a/Kconfig
```kconfig
#
# For a description of the syntax of this configuration file,
# see the file kconfig-language.txt in the NuttX tools repository.
#

config ARMV7A_STRING_FUNCTION
	bool "Enable optimized ARMv7M specific string function"
	default n
	depends on ARCH_TOOLCHAIN_GNU
	select ARMV7A_MEMCHR
	select ARMV7A_MEMCPY
	select ARMV7A_MEMMOVE
	select ARMV7A_MEMSET
	select ARMV7A_STRCMP
	select ARMV7A_STRLEN

config ARMV7A_MEMCHR
	bool "Enable optimized memchr() for ARMv7-A"
	default n
	select LIBC_ARCH_MEMCHR
	depends on ARCH_TOOLCHAIN_GNU
	---help---
		Enable optimized ARMv7-A specific memchr() library function

config ARMV7A_MEMCPY
	bool "Enable optimized memcpy() for ARMv7-A"
	select LIBC_ARCH_MEMCPY
	depends on ARCH_TOOLCHAIN_GNU
	---help---
		Enable optimized ARMv7-A specific memcpy() library function

config ARMV7A_MEMMOVE
	bool "Enable optimized memmove() for ARMv7-A"
	default n
	select LIBC_ARCH_MEMMOVE
	depends on ARCH_TOOLCHAIN_GNU
	---help---
		Enable optimized ARMv7-A specific memmove() library function

config ARMV7A_MEMSET
	bool "Enable optimized memset() for ARMv7-A"
	default n
	select LIBC_ARCH_MEMSET
	depends on ARCH_TOOLCHAIN_GNU
	depends on ARM_NEON
	---help---
		Enable optimized ARMv7-A specific memset() library function

config ARMV7A_STRCMP
	bool "Enable optimized strcmp() for ARMv7-A"
	default n
	select LIBC_ARCH_STRCMP
	depends on ARCH_TOOLCHAIN_GNU
	---help---
		Enable optimized ARMv7-A specific strcmp() library function

config ARMV7A_STRLEN
	bool "Enable optimized strlen() for ARMv7-A"
	default n
	select LIBC_ARCH_STRLEN
	depends on ARCH_TOOLCHAIN_GNU
	---help---
		Enable optimized ARMv7-A specific strlen() library function
```

## libs/libc/machine/arm/armv7-m/Kconfig
```kconfig
#
# For a description of the syntax of this configuration file,
# see the file kconfig-language.txt in the NuttX tools repository.
#

if ARCH_ARMV7M

config ARMV7M_MEMCHR
	bool "Enable optimized memchr() for ARMv7-M"
	default n
	select LIBC_ARCH_MEMCHR
	depends on ARCH_TOOLCHAIN_GNU
	---help---
		Enable optimized ARMv7-M specific memchr() library function

config ARMV7M_MEMCPY
	bool "Enable optimized memcpy() for ARMv7-M"
	default n
	select LIBC_ARCH_MEMCPY
	depends on ARCH_TOOLCHAIN_GNU
	---help---
		Enable optimized ARMv7-M specific memcpy() library function

config ARMV7M_MEMSET
	bool "Enable optimized memset() for ARMv7-M"
	default n
	select LIBC_ARCH_MEMSET
	depends on ARCH_TOOLCHAIN_GNU
	---help---
		Enable optimized ARMv7-M specific memset() library function

config ARMV7M_MEMMOVE
	bool "Enable optimized memmove() for ARMv7-M"
	default n
	select LIBC_ARCH_MEMMOVE
	depends on ARCH_TOOLCHAIN_GNU
	---help---
		Enable optimized ARMv7-M specific memmove() library function

config ARMV7M_STRCMP
	bool "Enable optimized strcmp() for ARMv7-M"
	default n
	select LIBC_ARCH_STRCMP
	depends on ARCH_TOOLCHAIN_GNU
	---help---
		Enable optimized ARMv7-M specific strcmp() library function

config ARMV7M_STRLEN
	bool "Enable optimized strlen() for ARMv7-M"
	default n
	select LIBC_ARCH_STRLEN
	depends on ARCH_TOOLCHAIN_GNU
	---help---
		Enable optimized ARMv7-M specific strlen() library function

endif
```

## libs/libc/machine/arm/armv7-r/Kconfig
```kconfig
#
# For a description of the syntax of this configuration file,
# see the file kconfig-language.txt in the NuttX tools repository.
#

config ARMV7R_MEMCHR
	bool "Enable optimized memchr() for ARMv7-R"
	default n
	select LIBC_ARCH_MEMCHR
	depends on ARCH_TOOLCHAIN_GNU
	---help---
		Enable optimized ARMv7-R specific memchr() library function

config ARMV7R_MEMCPY
	bool "Enable optimized memcpy() for ARMv7-R"
	select LIBC_ARCH_MEMCPY
	depends on ARCH_TOOLCHAIN_GNU
	---help---
		Enable optimized ARMv7-R specific memcpy() library function

config ARMV7R_MEMMOVE
	bool "Enable optimized memmove() for ARMv7-R"
	default n
	select LIBC_ARCH_MEMMOVE
	depends on ARCH_TOOLCHAIN_GNU
	---help---
		Enable optimized ARMv7-R specific memmove() library function

config ARMV7R_MEMSET
	bool "Enable optimized memset() for ARMv7-R"
	default n
	select LIBC_ARCH_MEMSET
	depends on ARCH_TOOLCHAIN_GNU
	depends on ARM_NEON
	---help---
		Enable optimized ARMv7-R specific memset() library function

config ARMV7R_STRCMP
	bool "Enable optimized strcmp() for ARMv7-R"
	default n
	select LIBC_ARCH_STRCMP
	depends on ARCH_TOOLCHAIN_GNU
	---help---
		Enable optimized ARMv7-R specific strcmp() library function

config ARMV7R_STRLEN
	bool "Enable optimized strlen() for ARMv7-R"
	default n
	select LIBC_ARCH_STRLEN
	depends on ARCH_TOOLCHAIN_GNU
	---help---
		Enable optimized ARMv7-R specific strlen() library function
```

## libs/libc/machine/arm/armv8-m/Kconfig
```kconfig
#
# For a description of the syntax of this configuration file,
# see the file kconfig-language.txt in the NuttX tools repository.
#

if ARCH_ARMV8M

config ARMV8M_STRING_FUNCTION
	bool "Enable optimized ARMv8M specific string function"
	default n
	depends on ARCH_TOOLCHAIN_GNU
	select ARMV8M_MEMCHR
	select ARMV8M_MEMCPY
	select ARMV8M_MEMSET
	select ARMV8M_STRCMP
	select ARMV8M_STRCMP
	select ARMV8M_STRLEN

config ARMV8M_MEMCHR
	bool "Enable optimized memchr() for ARMv8-M"
	default n
	select LIBC_ARCH_MEMCHR
	depends on ARCH_TOOLCHAIN_GNU
	---help---
		Enable optimized ARMv8-M specific memchr() library function

config ARMV8M_MEMCPY
	bool "Enable optimized memcpy() for ARMv8-M"
	default n
	select LIBC_ARCH_MEMCPY
	depends on ARCH_TOOLCHAIN_GNU
	---help---
		Enable optimized ARMv8-M specific memcpy() library function

config ARMV8M_MEMSET
	bool "Enable optimized memset() for ARMv8-M"
	default n
	select LIBC_ARCH_MEMSET
	depends on ARCH_TOOLCHAIN_GNU
	---help---
		Enable optimized ARMv8-M specific memset() library function

config ARMV8M_MEMMOVE
	bool "Enable optimized memmove() for ARMv8-M"
	default n
	select LIBC_ARCH_MEMMOVE
	depends on ARCH_TOOLCHAIN_GNU
	---help---
		Enable optimized ARMv8-M specific memmove() library function

config ARMV8M_STRCMP
	bool "Enable optimized strcmp() for ARMv8-M"
	default n
	select LIBC_ARCH_STRCMP
	depends on ARCH_TOOLCHAIN_GNU
	---help---
		Enable optimized ARMv8-M specific strcmp() library function

config ARMV8M_STRLEN
	bool "Enable optimized strlen() for ARMv8-M"
	default n
	select LIBC_ARCH_STRLEN
	depends on ARCH_TOOLCHAIN_GNU
	---help---
		Enable optimized ARMv8-M specific strlen() library function

endif
```

## libs/libc/machine/arm/armv8-r/Kconfig
```kconfig
#
# For a description of the syntax of this configuration file,
# see the file kconfig-language.txt in the NuttX tools repository.
#

config ARMV8R_STRING_FUNCTION
	bool "Enable optimized ARMV8R specific string function"
	default n
	depends on ARCH_TOOLCHAIN_GNU
	select ARMV8R_MEMCHR
	select ARMV8R_MEMCPY
	select ARMV8R_MEMMOVE
	select ARMV8R_MEMSET
	select ARMV8R_STRCMP
	select ARMV8R_STRLEN

config ARMV8R_MEMCHR
	bool "Enable optimized memchr() for ARMv8-R"
	default n
	select LIBC_ARCH_MEMCHR
	depends on ARCH_TOOLCHAIN_GNU
	---help---
		Enable optimized ARMv8-R specific memchr() library function

config ARMV8R_MEMCPY
	bool "Enable optimized memcpy() for ARMv8-R"
	select LIBC_ARCH_MEMCPY
	depends on ARCH_TOOLCHAIN_GNU
	---help---
		Enable optimized ARMv8-R specific memcpy() library function

config ARMV8R_MEMMOVE
	bool "Enable optimized memmove() for ARMv8-R"
	default n
	select LIBC_ARCH_MEMMOVE
	depends on ARCH_TOOLCHAIN_GNU
	---help---
		Enable optimized ARMv8-R specific memmove() library function

config ARMV8R_MEMSET
	bool "Enable optimized memset() for ARMv8-R"
	default n
	select LIBC_ARCH_MEMSET
	depends on ARCH_TOOLCHAIN_GNU
	depends on ARM_NEON
	---help---
		Enable optimized ARMv8-R specific memset() library function

config ARMV8R_STRCMP
	bool "Enable optimized strcmp() for ARMv8-R"
	default n
	select LIBC_ARCH_STRCMP
	depends on ARCH_TOOLCHAIN_GNU
	---help---
		Enable optimized ARMv8-R specific strcmp() library function

config ARMV8R_STRLEN
	bool "Enable optimized strlen() for ARMv8-R"
	default n
	select LIBC_ARCH_STRLEN
	depends on ARCH_TOOLCHAIN_GNU
	---help---
		Enable optimized ARMv8-R specific strlen() library function
```

## libs/libc/machine/arm/armv8/Kconfig
```kconfig
#
# For a description of the syntax of this configuration file,
# see the file kconfig-language.txt in the NuttX tools repository.
#

if ARCH_CORTEXM33

config ARMV8_LIBM
	bool "Architecture specific optimizations"
	default n
	select LIBM_ARCH_CEIL if CONFIG_ARCH_DPFPU
	select LIBM_ARCH_FLOOR if CONFIG_ARCH_DPFPU
	select LIBM_ARCH_NEARBYINT if CONFIG_ARCH_DPFPU
	select LIBM_ARCH_RINT if CONFIG_ARCH_DPFPU
	select LIBM_ARCH_ROUND if CONFIG_ARCH_DPFPU
	select LIBM_ARCH_TRUNC if CONFIG_ARCH_DPFPU
	select LIBM_ARCH_CEILF if CONFIG_ARCH_FPU
	select LIBM_ARCH_FLOORF if CONFIG_ARCH_FPU
	select LIBM_ARCH_NEARBYINTF if CONFIG_ARCH_FPU
	select LIBM_ARCH_RINTF if CONFIG_ARCH_FPU
	select LIBM_ARCH_ROUNDF if CONFIG_ARCH_FPU
	select LIBM_ARCH_TRUNCF if CONFIG_ARCH_FPU
	depends on LIBM
	---help---
		Enable ARMv8 specific floating point optimizations.

endif
```

## libs/libc/machine/arm64/Kconfig
```kconfig
#
# For a description of the syntax of this configuration file,
# see the file kconfig-language.txt in the NuttX tools repository.
#

config ARM64_STRING_FUNCTION
	bool "Enable optimized ARM64 specific string function"
	default n
	depends on ARCH_TOOLCHAIN_GNU
	select ARM64_MEMCHR
	select ARM64_MEMCMP
	select ARM64_MEMCPY
	select ARM64_MEMSET
	select ARM64_MEMMOVE
	select ARM64_STRCHR
	select ARM64_STRCHRNUL
	select ARM64_STRCMP
	select ARM64_STRCPY
	select ARM64_STRLEN
	select ARM64_STRNCMP
	select ARM64_STRNLEN
	select ARM64_STRRCHR

config ARM64_MEMCHR
	bool "Enable optimized memchr() for ARM64"
	default n
	select LIBC_ARCH_MEMCHR
	depends on ARCH_TOOLCHAIN_GNU
	---help---
		Enable optimized ARM64 specific memchr() library function

config ARM64_MEMCMP
	bool "Enable optimized memcmp() for ARM64"
	select LIBC_ARCH_MEMCMP
	depends on ARCH_TOOLCHAIN_GNU
	---help---
		Enable optimized ARM64 specific memcmp() library function

config ARM64_MEMCPY
	bool "Enable optimized memcpy() for ARM64"
	select LIBC_ARCH_MEMCPY
	depends on ARCH_TOOLCHAIN_GNU
	---help---
		Enable optimized ARM64 specific memcpy() library function

config ARM64_MEMSET
	bool "Enable optimized memset() for ARM64"
	default n
	select LIBC_ARCH_MEMSET
	depends on ARCH_TOOLCHAIN_GNU
	---help---
		Enable optimized ARM64 specific memset() library function

config ARM64_MEMMOVE
	bool "Enable optimized memmove() for ARM64"
	default n
	select LIBC_ARCH_MEMMOVE
	depends on ARCH_TOOLCHAIN_GNU
	---help---
		Enable optimized ARM64 specific memmove() library function

config ARM64_STRCHR
	bool "Enable optimized strchr() for ARM64"
	default n
	select LIBC_ARCH_STRCHR
	depends on ARCH_TOOLCHAIN_GNU
	---help---
		Enable optimized ARM64 specific strchr() library function

config ARM64_STRCHRNUL
	bool "Enable optimized strchrnul() for ARM64"
	default n
	select LIBC_ARCH_STRCHRNUL
	depends on ARCH_TOOLCHAIN_GNU
	---help---
		Enable optimized ARM64 specific strchrnul() library function

config ARM64_STRCMP
	bool "Enable optimized strcmp() for ARM64"
	default n
	select LIBC_ARCH_STRCMP
	depends on ARCH_TOOLCHAIN_GNU
	---help---
		Enable optimized ARM64 specific strcmp() library function

config ARM64_STRCPY
	bool "Enable optimized strcpy() for ARM64"
	default n
	select LIBC_ARCH_STRCPY
	depends on ARCH_TOOLCHAIN_GNU
	---help---
		Enable optimized ARM64 specific strcpy() library function

config ARM64_STRLEN
	bool "Enable optimized strlen() for ARM64"
	default n
	select LIBC_ARCH_STRLEN
	depends on ARCH_TOOLCHAIN_GNU
	---help---
		Enable optimized ARM64 specific strlen() library function

config ARM64_STRNCMP
	bool "Enable optimized strncmp() for ARM64"
	default n
	select LIBC_ARCH_STRNCMP
	depends on ARCH_TOOLCHAIN_GNU
	---help---
		Enable optimized ARM64 specific strncmp() library function

config ARM64_STRNLEN
	bool "Enable optimized strnlen() for ARM64"
	default n
	select LIBC_ARCH_STRNLEN
	depends on ARCH_TOOLCHAIN_GNU
	---help---
		Enable optimized ARM64 specific strnlen() library function

config ARM64_STRRCHR
	bool "Enable optimized strrchr() for ARM64"
	default n
	select LIBC_ARCH_STRRCHR
	depends on ARCH_TOOLCHAIN_GNU
	---help---
		Enable optimized ARM64 specific strrchr() library function
```

## libs/libc/machine/risc-v/rv32/Kconfig
```kconfig
#
# For a description of the syntax of this configuration file,
# see the file kconfig-language.txt in the NuttX tools repository.
#

config RISCV_MEMCPY
        bool "Enable optimized memcpy() for RISC-V"
        select LIBC_ARCH_MEMCPY
        ---help---
                Enable optimized RISC-V specific memcpy() library function
```

## libs/libc/machine/x86_64/Kconfig
```kconfig
#
# For a description of the syntax of this configuration file,
# see the file kconfig-language.txt in the NuttX tools repository.
#

if ARCH_TOOLCHAIN_GNU && ALLOW_BSD_COMPONENTS

config X86_64_MEMCMP
	bool "Enable optimized memcmp() for X86_64"
	select LIBC_ARCH_MEMCMP
	depends on ARCH_HAVE_SSE41
	---help---
		Enable optimized X86_64 specific memcmp() library function

config X86_64_MEMMOVE
	bool "Enable optimized memmove()/memcpy() for X86_64"
	default n
	select LIBC_ARCH_MEMMOVE
	select LIBC_ARCH_MEMCPY
	---help---
		Enable optimized X86_64 specific memmove()/memcpy() library function

config X86_64_MEMSET
	bool "Enable optimized memset() for X86_64"
	default n
	select LIBC_ARCH_MEMSET
	---help---
		Enable optimized X86_64 specific memset() library function

config X86_64_STPCPY
	bool "Enable optimized stpcpy() for X86_64"
	default n
	select LIBC_ARCH_STPCPY
	---help---
		Enable optimized X86_64 specific stpcpy() library function

config X86_64_STPNCPY
	bool "Enable optimized stpncpy() for X86_64"
	default n
	select LIBC_ARCH_STPNCPY
	---help---
		Enable optimized X86_64 specific stpncpy() library function

config X86_64_STRCAT
	bool "Enable optimized strcat() for X86_64"
	default n
	select LIBC_ARCH_STRCAT
	---help---
		Enable optimized X86_64 specific strcat() library function

config X86_64_STRCMP
	bool "Enable optimized strcmp() for X86_64"
	default n
	select LIBC_ARCH_STRCMP
	depends on ARCH_HAVE_SSSE3
	---help---
		Enable optimized X86_64 specific strcmp() library function

config X86_64_STRNCMP
	bool "Enable optimized strncmp() for X86_64"
	default n
	select LIBC_ARCH_STRNCMP
	depends on ARCH_HAVE_SSSE3
	---help---
		Enable optimized X86_64 specific strncmp() library function

config X86_64_STRCPY
	bool "Enable optimized strcpy() for X86_64"
	default n
	select LIBC_ARCH_STRCPY
	---help---
		Enable optimized X86_64 specific strcpy() library function

config X86_64_STRLEN
	bool "Enable optimized strlen() for X86_64"
	default n
	select LIBC_ARCH_STRLEN
	---help---
		Enable optimized X86_64 specific strlen() library function

config X86_64_STRNCPY
	bool "Enable optimized strncpy() for X86_64"
	default n
	select LIBC_ARCH_STRNCPY
	---help---
		Enable optimized X86_64 specific strncpy() library function

config X86_64_STRNCMP
	bool "Enable optimized strncmp() for X86_64"
	default n
	select LIBC_ARCH_STRNCMP
	---help---
		Enable optimized X86_64 specific strncmp() library function

endif # ARCH_TOOLCHAIN_GNU && ALLOW_BSD_COMPONENTS
```
