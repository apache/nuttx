## mm/iob/Kconfig
```kconfig
#
# For a description of the syntax of this configuration file,
# see the file kconfig-language.txt in the NuttX tools repository.
#

menu "Common I/O Buffer Support"

config MM_IOB
	bool "Enable generic I/O buffer support"
	default n
	---help---
		This setting will build the common I/O buffer (IOB) support
		library.

if MM_IOB

config IOB_NBUFFERS
	int "Number of pre-allocated I/O buffers"
	default 36 if NET_WRITE_BUFFERS
	default 24 if !NET_WRITE_BUFFERS && NET_READAHEAD
	default 8 if !NET_WRITE_BUFFERS && !NET_READAHEAD
	---help---
		Each packet is represented by a series of small I/O buffers in a
		chain.  This setting determines the number of preallocated I/O
		buffers available for packet data.

config IOB_BUFSIZE
	int "Payload size of one I/O buffer"
	default 196
	---help---
		Each packet is represented by a series of small I/O buffers in a
		chain.  This setting determines the data payload each preallocated
		I/O buffer.

config IOB_ALIGNMENT
	int "Alignment size of each I/O buffer"
	default 4
	---help---
		The member io_data of all I/O buffers is aligned to the value
		specified by this configuration.

config IOB_SECTION
	string "The section where iob buffer is located"
	---help---
		The section where iob buffer is located.
		The section must be zero-initialized on system boot.

config IOB_NCHAINS
	int "Number of pre-allocated I/O buffer chain heads"
	default 0 if !NET_READAHEAD
	default IOB_NBUFFERS if NET_READAHEAD
	---help---
		These tiny nodes are used as "containers" to support queueing of
		I/O buffer chains.  This will limit the number of I/O transactions
		that can be "in-flight" at any give time.  The default value of
		zero disables this features.

		These generic I/O buffer chain containers are not currently used
		by any logic in NuttX.  That is because their other specialized
		I/O buffer chain containers that also carry a payload of usage
		specific information.

		Note: TCP doesn't use this.
		Note: UDP and CAN use this.

config IOB_THROTTLE
	int "I/O buffer throttle value"
	default 0 if !NET_WRITE_BUFFERS || !NET_READAHEAD
	default 8 if NET_WRITE_BUFFERS && NET_READAHEAD
	---help---
		TCP write buffering and read-ahead buffer use the same pool of free
		I/O buffers.  In order to prevent uncontrolled incoming TCP packets
		from hogging all of the available, pre-allocated I/O buffers, a
		throttling value is required.  This throttle value assures that
		I/O buffers will be denied to the read-ahead logic before TCP writes
		are halted.

config IOB_NOTIFIER
	bool "Support IOB notifications"
	default n
	depends on SCHED_WORKQUEUE
	select WQUEUE_NOTIFIER
	---help---
		Enable building of IOB notifier logic that will execute a worker
		function on the high priority work queue when an IOB is available.
		This is is a general purpose notifier, but was developed specifically to
		support poll() logic where the poll must wait for an IOB to become
		available.

config IOB_NOTIFIER_DIV
	int "Notification divider"
	default 4
	range 1 64
	depends on IOB_NOTIFIER
	---help---
		IOBs may become available at very high rates and the resulting
		notification processing can be substantial even if there is nothing
		waiting for a free IOB.  This divider will reduce that rate of
		notification.  This must be an even power of two.  Supported values
		include:  1, 2, 4, 8, 16, 32, 64.  The default value of 4 means that
		a notification will be sent only when there are a multiple of 4 IOBs
		available.

config IOB_DEBUG
	bool "Force I/O buffer debug"
	default n
	depends on DEBUG_FEATURES && !SYSLOG_BUFFER
	---help---
		This option will force debug output from I/O buffer logic.  This
		is not normally something that would want to do but is convenient
		if you are debugging the I/O buffer logic and do not want to get
		overloaded with other un-related debug output.

		NOTE that this selection is not available if IOBs are being used
		to syslog buffering logic (CONFIG_SYSLOG_BUFFER=y)!

endif # MM_IOB
endmenu # Common I/O buffer support
```

## mm/kasan/Kconfig
```kconfig
#
# For a description of the syntax of this configuration file,
# see the file kconfig-language.txt in the NuttX tools repository.
#

config MM_KASAN
	bool "Kernel Address Sanitizer"
	default n
	---help---
		KASan is a fast compiler-based tool for detecting memory
		bugs in native code. After turn on this option, Please
		add -fsanitize=kernel-address to CFLAGS/CXXFLAGS too.

config MM_KASAN_INSTRUMENT
    bool

if MM_KASAN

choice
	prompt "KAsan Mode"
	default MM_KASAN_GENERIC

config MM_KASAN_NONE
	bool "KAsan disable"
	---help---
		Disable KASan check

config MM_KASAN_GENERIC
	bool "KAsan generic mode"
	select MM_KASAN_INSTRUMENT
	---help---
		KASan generic mode that does not require hardware support at all

config MM_KASAN_SW_TAGS
	bool "KAsan SW tags"
	select ARM64_TBI
	select MM_KASAN_INSTRUMENT
	depends on ARCH_ARM64
	---help---
		KAsan based on software tags

endchoice

config MM_KASAN_INSTRUMENT_ALL
	bool "Enable KASan for the entire image"
	depends on MM_KASAN_INSTRUMENT
	default y
	---help---
		This option activates address sanitizer for the entire image.
		If you don't enable this option, you have to explicitly specify
		"-fsanitize=kernel-address" for the files/directories you want
		to check. Enabling this option will get image size increased
		and performance decreased significantly.

config MM_KASAN_REGIONS
	int "Kasan region count"
	default 8

config MM_KASAN_WATCHPOINT
	int "Kasan watchpoint maximum number"
	default 0
	---help---
		The maximum number of watchpoints that can be set by KASan.

config MM_KASAN_DISABLE_NULL_POINTER_CHECK
	bool "Disable null pointer access check"
	default n
	---help---
		This option enables KASan check null pointer access.

config MM_KASAN_DISABLE_READS_CHECK
	bool "Disable reads check"
	default n
	---help---
		This option disables kasan reads check. It speeds up performance
		compared with default read/write check. Only disable it when you are
		sure there's no need to do so. Or performance is too bad and only focus
		on writes check.

config MM_KASAN_DISABLE_WRITES_CHECK
	bool "Disable writes check"
	default n
	---help---
		This option disables kasan writes check.

config MM_KASAN_DISABLE_READ_PANIC
	bool "Disable panic on kasan read error"
	default n
	---help---
		This option disables panic on kasan read error. It will print error info
		and continue to run.

config MM_KASAN_DISABLE_WRITE_PANIC
	bool "Disable panic on kasan write error"
	default n
	---help---
		This option disables panic on kasan write error. It will print error info
		and continue to run.

config MM_KASAN_SKIP_ZERO_TAGS
	bool "Enable skip check zero tags"
	default LIBC_MODLIB
	---help---
		This option disables checking for zero tags.

config MM_KASAN_GLOBAL
	bool "Enable global data check"
	depends on MM_KASAN_INSTRUMENT_ALL
	default n
	---help---
		This option enables KASan global data check.
		It's used to extract segments in the linker script.
		Two new segments need to be created, one being
		".kasan.unused: { *(.data..LASANLOC*) }",
		used to eliminate excess data generated.
		One is ".kasan.global:{
		KEEP ( *(. data.. LASAN0))
		KEEP ( *(. data. rel. local.. LASAN0))
		}", used to extract data generated by the compiler

config MM_KASAN_GLOBAL_ALIGN
	int "KASan global alignment"
	default 1
	depends on MM_KASAN_GLOBAL
	---help---
		It is recommended to use 1, 2, 4, 8, 16, 32.
		The maximum value is 32.

endif # MM_KASAN
```

## net/6lowpan/Kconfig
```kconfig
#
# For a description of the syntax of this configuration file,
# see the file kconfig-language.txt in the NuttX tools repository.
#

menuconfig NET_6LOWPAN
	bool "IEEE 802.15.4 6LoWPAN support"
	default n
	depends on EXPERIMENTAL && NET_IPv6
	---help---
		Enable support for IEEE 802.15.4 Low power Wireless Personal Area
		Networking (6LoWPAN).

if NET_6LOWPAN

config NET_6LOWPAN_MTU
	int "6LoWPAN packet buffer size (MTU)"
	default 1294
	range 590 1518
	---help---
		Packet buffer size.  This size includes the TCP/UDP payload plus the
		size of TCP/UDP header, the IP header, and data link layer headers.
		This value is normally referred to as the MTU (Maximum Transmission
		Unit); the payload is the MSS (Maximum Segment Size).

		IPv6 hosts are required to be able to handle an MSS of 1220 octets,
		resulting in a minimum buffer size of of 1220+20+40+xx = xx. REVISIT!

config NET_6LOWPAN_TCP_RECVWNDO
	int "6LoWPAN TCP receive window size"
	default 1220
	depends on NET_TCP
	---help---
		The size of the advertised receiver's window.   Should be set low
		(i.e., to the size of the MSS) if the application is slow to process
		incoming data, or high (32768 bytes) if the application processes
		data quickly. REVISIT!

endif # NET_6LOWPAN
```
