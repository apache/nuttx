## net/icmpv6/Kconfig
```kconfig
#
# For a description of the syntax of this configuration file,
# see the file kconfig-language.txt in the NuttX tools repository.
#

menu "ICMPv6 Networking Support"

config NET_ICMPv6
	bool "Enable ICMPv6 networking"
	default n
	depends on NET
	---help---
		Enable minimal ICMPv6 support. Includes built-in support
		for sending replies to received ECHO (ping) requests.

config NET_ICMPv6_NO_STACK
	bool "Disable ICMPv6 stack"
	default n
	select NET_ICMPv6
	---help---
		Build without ICMPv6 stack even if ICMPv6 networking support enabled.

if NET_ICMPv6 && !NET_ICMPv6_NO_STACK

config NET_ICMPv6_PMTU_ENTRIES
	int "PMTUD ICMPv6 pmtu entry"
	default 0
	---help---
		The number of the ICMPv6 pmtu entry

config NET_ICMPv6_PMTU_TIMEOUT
	int "PMTUD ICMPv6 pmtu entry timeout (Time Unit:minute)"
	default 10
	depends on NET_ICMPv6_PMTU_ENTRIES != 0
	---help---
		The timout of the ICMPv6 pmtu entry

config NET_ICMPv6_SOCKET
	bool "IPPROTO_ICMP6 socket support"
	default n
	select MM_IOB
	---help---
		Enable support for IPPROTO_ICMP6 sockets.  These sockets are needed
		for application level support for sending ICMPv7 ECHO requests and
		receiving associated ICMPv6 ECHO replies.

config NET_ICMPv6_NEIGHBOR
	bool "Solicit destination addresses"
	default n
	---help---
		Enable logic to send ICMPv6 neighbor solicitation requests if
		the target IPv6 address mapping does not appear in the Neighbor
		table.

if NET_ICMPv6_NEIGHBOR

config ICMPv6_NEIGHBOR_MAXTRIES
	int "ICMPv6 neighbor solicitation retries"
	default 5
	---help---
		Send the Neighbor solicitation this number of times before giving
		up and deciding that the target IP6 address is non reachable.

config ICMPv6_NEIGHBOR_DELAYMSEC
	int "ICMPv6 neighbor re-solicit delay"
	default 20
	---help---
		Wait this number of milliseconds after sending the Neighbor
		Solicitation before checking if the IPv6 address mapping is present
		in the Neighbor Table.  This time should be related to the maximum
		round trip time on the network since it is basically the time from
		when an Neighbor Solicitation is sent until the Neighbor
		Advertisement is received.

endif # NET_ICMPv6_NEIGHBOR

config NET_ICMPv6_AUTOCONF
	bool "ICMPv6 auto-configuration"
	default n
	---help---
		Enable ioctl() logic that implements ICMPv6 auto configuration.
		ICMPv6 auto configuration is an alternative to DHCPv6 for obtaining
		an IPv6 address from a router.

if NET_ICMPv6_AUTOCONF

config ICMPv6_AUTOCONF_MAXTRIES
	int "ICMPv6 router solicitation retries"
	default 5
	---help---
		Send the Router solicitation this number of times before giving
		up and deciding that no router is going to provide an IP address.

config ICMPv6_AUTOCONF_DELAYMSEC
	int "ICMPv6 router re-solicit delay"
	default 20
	---help---
		Wait this number of milliseconds before re-sending the Router
		Solicitation.  This time should be related to the maximum
		round trip time on the network since it is basically the time from
		when an Router Solicitation is sent until the Router
		Advertisement is received.

config ICMPv6_AUTOCONF_RDNSS
	bool "ICMPv6 handle RDNSS field in router advertise"
	default n
	---help---
		Handle the RDNSS field in the Router Advertisement and add it to
		netdb DNS Server.

endif # NET_ICMPv6_AUTOCONF

config NET_ICMPv6_ROUTER
	bool "Router Advertisement"
	default n
	---help---
		In a router-less environment, NuttX can be configured to provide a
		response to Router Solicitation messages and, hence, providing
		addressing to IPv6 nodes on the network.

if NET_ICMPv6_ROUTER

config NET_ICMPv6_ROUTER_MANUAL
	bool "Manual router prefix"
	default n
	---help---
		Select this to set the advertised router prefix manually. Otherwise, it
		will be derived from the device IPv6 address and prefix length set in
		the netdev structure.

if NET_ICMPv6_ROUTER_MANUAL

config NET_ICMPv6_PREFLEN
	int "Prefix length"
	default 64
	range 0 128
	---help---
		The length (in bits) of the IPv6 address prefix.  This is the number
		of MS bits under the network mask.  The default of 64 would
		correspond to a network mask of:

			0xffff:0xffff:0xffff:0xffff:0x0000:0x0000:0x0000:0x0000.

comment "Router Prefix"

config NET_ICMPv6_PREFIX_1
	hex "[0]"
	default 0xfc00
	range 0x0 0xffff
	---help---
		This the IPv6 address prefix that will be provided in the IPv6 Router
		Advertisement message.  This is the first of the 8-values.  The
		default for all eight values is fc00::0.

config NET_ICMPv6_PREFIX_2
	hex "[1]"
	default 0x0000
	range 0x0 0xffff
	---help---
		This the IPv6 address prefix that will be provided in the IPv6 Router
		Advertisement message.  This is the second of the 8-values.  The
		default for all eight values is fc00::0.

config NET_ICMPv6_PREFIX_3
	hex "[2]"
	default 0x0000
	range 0x0 0xffff
	---help---
		This the IPv6 address prefix that will be provided in the IPv6 Router
		Advertisement message.  This is the third of the 8-values.  The
		default for all eight values is fc00::0.

config NET_ICMPv6_PREFIX_4
	hex "[3]"
	default 0x0000
	range 0x0 0xffff
	---help---
		This the IPv6 address prefix that will be provided in the IPv6 Router
		Advertisement message.  This is the fourth of the 8-values.  The
		default for all eight values is fc00::0.

config NET_ICMPv6_PREFIX_5
	hex "[4]"
	default 0x0000
	range 0x0 0xffff
	---help---
		This the IPv6 address prefix that will be provided in the IPv6 Router
		Advertisement message.  This is the fifth of the 8-values.  The
		default for all eight values is fc00::0.

config NET_ICMPv6_PREFIX_6
	hex "[5]"
	default 0x0000
	range 0x0 0xffff
	---help---
		This the IPv6 address prefix that will be provided in the IPv6 Router
		Advertisement message.  This is the sixth of the 8-values.  The
		default for all eight values is fc00::0.

config NET_ICMPv6_PREFIX_7
	hex "[6]"
	default 0x0000
	range 0x0 0xffff
	---help---
		This the IPv6 address prefix that will be provided in the IPv6 Router
		Advertisement message.  This is the seventh of the 8-values.  The
		default for all eight values is fc00::0.

config NET_ICMPv6_PREFIX_8
	hex "[7]"
	default 0x0000
	range 0x0 0xffff
	---help---
		This the IPv6 address prefix that will be provided in the IPv6 Router
		Advertisement message.  This is the last of the 8-values.  The
		default for all eight values is fc00::0.

config NET_ICMPv6_ROUTER_RDNSS
	bool "Fill the RDNSS into Router Advertisement"
	default n
	---help---
		Fill the RDNSS from the netdb DNS Server into the Router
		Advertisement.

endif # NET_ICMPv6_ROUTER_MANUAL
endif # NET_ICMPv6_ROUTER

if NET_ICMPv6_SOCKET

config NET_ICMPv6_PREALLOC_CONNS
	int "Preallocated ICMPv6 packet sockets"
	default 4
	---help---
		Number of ICMPv6 connections (all tasks).

		This number of connections will be pre-allocated during system boot.
		If dynamic connections allocation is enabled, more connections may
		be allocated at a later time, as the system needs them. Else this
		will be the maximum number of connections available to the system
		at all times.

		Set to 0 to disable (and rely only on dynamic allocations).

config NET_ICMPv6_ALLOC_CONNS
	int "Dynamic ICMPv6 connections allocation"
	default 0
	---help---
		Dynamic memory allocations for ICMPv6.

		When set to 0 all dynamic allocations are disabled.

		When set to 1 a new connection will be allocated every time,
		and it will be free'd when no longer needed.

		Setting this to 2 or more will allocate the connections in
		batches (with batch size equal to this config). When a
		connection is no longer needed, it will be returned to the
		free connections pool, and it will never be deallocated!

config NET_ICMPv6_MAX_CONNS
	int "Maximum number of ICMPv6 connections"
	default 0
	depends on NET_ICMPv6_ALLOC_CONNS > 0
	---help---
		If dynamic connections allocation is selected (NET_ICMPv6_ALLOC_CONNS > 0)
		this will limit the number of connections that can be allocated.

		This is useful in case the system is under very heavy load (or
		under attack), ensuring that the heap will not be exhausted.

config NET_ICMPv6_NPOLLWAITERS
	int "Number of ICMPv6 poll waiters"
	default 1

endif # NET_ICMPv6_SOCKET

endif # NET_ICMPv6 && !NET_ICMPv6_NO_STACK
endmenu # ICMPv6 Networking Support
```

## net/ieee802154/Kconfig
```kconfig
#
# For a description of the syntax of this configuration file,
# see the file kconfig-language.txt in the NuttX tools repository.
#

menu "IEEE 802.15.4 socket support"

config NET_IEEE802154
	bool "IEEE 802.15.4 socket support"
	default n
	depends on WIRELESS_IEEE802154
	select NETDEV_IOCTL
	---help---
		Enable support for raw, IEEE 802.15.4 sockets.

		Raw sockets allow receiving and transmitting IEEE 802.15.4 radio
		frames without a layer2 protocol such as 6LoWPAN in between. Frames
		received are copied into a IEEE 802.15.4 socket tap before they
		enter the network. Frames written into a IEEE 802.15.4 socket will
		bypass the network altogether and will be sent directly to the
		IEEE 802.15.4 MAC network interface driver outgoing frame queue.

if NET_IEEE802154

config NET_IEEE802154_FRAMELEN
	int "IEEE 802.15.4 Frame Length"
	default 127
	range 1 999999
	---help---
		For standard IEEE 802.15.4 radios, this should always be 127 bytes.
		However, some IEEE 802.15.4 radios may non-standard frame lengths.

		This setting is currently used only for detection data transfers
		that would exceed the radio frame length.

config NET_IEEE802154_PREALLOC_CONNS
	int "Preallocated IEEE 802.15.4 sockets"
	default 4
	---help---
		Number of IEEE 802.15.4 connections (all tasks).

		This number of connections will be pre-allocated during system boot.
		If dynamic connections allocation is enabled, more connections may
		be allocated at a later time, as the system needs them. Else this
		will be the maximum number of connections available to the system
		at all times.

		Set to 0 to disable (and rely only on dynamic allocations).

config NET_IEEE802154_ALLOC_CONNS
	int "Dynamic IEEE 802.15.4 connections allocation"
	default 0
	---help---
		Dynamic memory allocations for IEEE 802.15.4.

		When set to 0 all dynamic allocations are disabled.

		When set to 1 a new connection will be allocated every time,
		and it will be free'd when no longer needed.

		Setting this to 2 or more will allocate the connections in
		batches (with batch size equal to this config). When a
		connection is no longer needed, it will be returned to the
		free connections pool, and it will never be deallocated!

config NET_IEEE802154_MAX_CONNS
	int "Maximum number of IEEE 802.15.4 connections"
	default 0
	depends on NET_IEEE802154_ALLOC_CONNS > 0
	---help---
		If dynamic connections allocation is selected (NET_IEEE802154_ALLOC_CONNS > 0)
		this will limit the number of connections that can be allocated.

		This is useful in case the system is under very heavy load (or
		under attack), ensuring that the heap will not be exhausted.

config NET_IEEE802154_NCONTAINERS
	int "Number of pre-allocated frame containers"
	default 8
	---help---
		This specifies the total number of preallocated frame containers.
		One must be allocated with each incoming frame.

config NET_IEEE802154_BACKLOG
	int "Maximum frame backlog"
	default 8
	range 0 255
	---help---
		As frames are received, then are help in an RX queue.  They remain
		in the RX queue until application logic reads the queue frames.  To
		prevent overrun, the maximum backlog may be set to a nonzero value.
		What the backlog of queue frames reaches that count, the olds frame
		will be freed, preventing overrun at the cost of losing the oldest
		frames.

		NOTE: The special value of zero will disable all backlog checks.

endif # NET_IEEE802154
endmenu # IEEE 802.15.4 Socket Support
```

## net/igmp/Kconfig
```kconfig
#
# For a description of the syntax of this configuration file,
# see the file kconfig-language.txt in the NuttX tools repository.
#

config NET_IGMP
	bool "IGMPv2 client support"
	default n
	depends on NET_IPv4
	select NET_MCASTGROUP
	select NETDEV_IFINDEX
	---help---
		Enable IGMPv2 client support.

config NET_IGMP_CHECKSUMS
	bool "IGMP checksums"
	default y
	---help---
		Enable/disable IGMP checksum support.

if NET_IGMP

endif # NET_IGMP
```

## net/inet/Kconfig
```kconfig
#
# For a description of the syntax of this configuration file,
# see the file kconfig-language.txt in the NuttX tools repository.
#

config NET_IPV4_CHECKSUMS
	bool "IPV4 checksums"
	default y
	---help---
		Enable/disable IPV4 checksum support.
```

## net/iob/Kconfig
```kconfig
#
# For a description of the syntax of this configuration file,
# see the file kconfig-language.txt in the NuttX tools repository.
#

menu "Network I/O Buffer Support"

config NET_IOB
	bool "Enable generic network I/O buffer support"
	default n
	---help---
		This setting will build the networking I/O buffer (IOB) support
		library.

if NET_IOB

config IOB_NBUFFERS
	int "Number of pre-allocated network I/O buffers"
	default 24 if (NET_TCP_WRITE_BUFFERS && !NET_TCP_READAHEAD) || (!NET_TCP_WRITE_BUFFERS && NET_TCP_READAHEAD)
	default 36 if NET_TCP_WRITE_BUFFERS && NET_TCP_READAHEAD
	default 8 if !NET_TCP_WRITE_BUFFERS && !NET_TCP_READAHEAD
	---help---
		Each packet is represented by a series of small I/O buffers in a
		chain.  This setting determines the number of preallocated I/O
		buffers available for packet data.

config IOB_BUFSIZE
	int "Payload size of one network I/O buffer"
	default 196
	---help---
		Each packet is represented by a series of small I/O buffers in a
		chain.  This setting determines the data payload each preallocated
		I/O buffer.

config IOB_NCHAINS
	int "Number of pre-allocated I/O buffer chain heads"
	default 0 if !NET_TCP_READAHEAD && !NET_UDP_READAHEAD
	default 8 if NET_TCP_READAHEAD || NET_UDP_READAHEAD
	---help---
		These tiny nodes are used as "containers" to support queueing of
		I/O buffer chains.  This will limit the number of I/O transactions
		that can be "in-flight" at any give time.  The default value of
		zero disables this features.

		These generic I/O buffer chain containers are not currently used
		by any logic in NuttX.  That is because their other other specialized
		I/O buffer chain containers that also carry a payload of usage
		specific information.

config IOB_THROTTLE
	int "I/O buffer throttle value"
	default 0 if !NET_TCP_WRITE_BUFFERS || !NET_TCP_READAHEAD
	default 8 if NET_TCP_WRITE_BUFFERS && NET_TCP_READAHEAD
	depends on NET_TCP_WRITE_BUFFERS && NET_TCP_READAHEAD
	---help---
		TCP write buffering and read-ahead buffer use the same pool of free
		I/O buffers.  In order to prevent uncontrolled incoming TCP packets
		from hogging all of the available, pre-allocated I/O buffers, a
		throttling value is required.  This throttle value assures that
		I/O buffers will be denied to the read-ahead logic before TCP writes
		are halted.

config IOB_DEBUG
	bool "Force I/O buffer debug"
	default n
	depends on DEBUG
	---help---
		This option will force debug output from I/O buffer logic,
		even without network debug output.  This is not normally something
		that would want to do but is convenient if you are debugging the
		I/O buffer logic and do not want to get overloaded with other
		network-related debug output.

endif # NET_IOB
endmenu # Network I/O buffer support
```

## net/ipfilter/Kconfig
```kconfig
#
# For a description of the syntax of this configuration file,
# see the file kconfig-language.txt in the NuttX tools repository.
#

config NET_IPFILTER
	bool "Enable IP packet filter (firewall)"
	default n
	depends on NET_IPv4 || NET_IPv6
	---help---
		Enable this option to enable the IP packet filter (firewall).
		Our IP packet filter is a netfilter-like packet filter that
		operates on the IP (and transport) layer.  It is a stateless
		packet filter that can be used to filter packets based on
		source and destination IP addresses, source and destination
		ports, protocol, and interface.
```
