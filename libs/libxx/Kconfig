## net/bluetooth/Kconfig
```kconfig
#
# For a description of the syntax of this configuration file,
# see the file kconfig-language.txt in the NuttX tools repository.
#

menu "Bluetooth socket support"

config NET_BLUETOOTH
	bool "Bluetooth socket support"
	default n
	depends on WIRELESS_BLUETOOTH
	select NETDEV_IOCTL
	---help---
		Enable support for raw, Bluetooth sockets.

		Raw sockets allow receiving and transmitting Bluetooth radio
		frames without a layer2 protocol such as 6LoWPAN in between. Frames
		received are copied into a Bluetooth socket tap before they
		enter the network. Frames written into a Bluetooth socket will
		bypass the network altogether and will be sent directly to the
		Bluetooth MAC network interface driver outgoing frame queue.

if NET_BLUETOOTH

config NET_BLUETOOTH_PREALLOC_CONNS
	int "Preallocated Bluetooth sockets"
	default 4
	---help---
		Number of Bluetooth connections (all tasks).
		
		This number of connections will be pre-allocated during system boot.
		If dynamic connections allocation is enabled, more connections may
		be allocated at a later time, as the system needs them. Else this
		will be the maximum number of connections available to the system
		at all times.

		Set to 0 to disable (and rely only on dynamic allocations).

config NET_BLUETOOTH_ALLOC_CONNS
	int "Dynamic Bluetooth connections allocation"
	default 0
	---help---
		Dynamic memory allocations for Bluetooth.

		When set to 0 all dynamic allocations are disabled.

		When set to 1 a new connection will be allocated every time,
		and it will be free'd when no longer needed.

		Setting this to 2 or more will allocate the connections in
		batches (with batch size equal to this config). When a
		connection is no longer needed, it will be returned to the
		free connections pool, and it will never be deallocated!

config NET_BLUETOOTH_MAX_CONNS
	int "Maximum number of Bluetooth connections"
	default 0
	depends on NET_BLUETOOTH_ALLOC_CONNS > 0
	---help---
		If dynamic connections allocation is selected (NET_BLUETOOTH_ALLOC_CONNS > 0)
		this will limit the number of connections that can be allocated.
		
		This is useful in case the system is under very heavy load (or
		under attack), ensuring that the heap will not be exhausted.

config NET_BLUETOOTH_NCONTAINERS
	int "Number of pre-allocated frame containers"
	default 8
	---help---
		This specifies the total number of preallocated frame containers.
		One must be allocated with each incoming frame.

config NET_BLUETOOTH_BACKLOG
	int "Maximum frame backlog"
	default 8
	range 0 255
	---help---
		As frames are received, they are held in an RX queue.  They remain
		in the RX queue until application logic reads the queue frames.  To
		prevent overrun, the maximum backlog may be set to a nonzero value.
		When the backlog of queue frames reaches that count, the old frame
		will be freed, preventing overrun at the cost of losing the oldest
		frames.

		NOTE: The special value of zero will disable all backlog checks.

endif # NET_BLUETOOTH
endmenu # Bluetooth Socket Support
```

## net/can/Kconfig
```kconfig
#
# For a description of the syntax of this configuration file,
# see the file kconfig-language.txt in the NuttX tools repository.
#

menu "SocketCAN Support"

config NET_CAN
	bool "SocketCAN support"
	default n
	select NET_READAHEAD
	depends on NET
	---help---
		Enable support for SocketCAN sockets.

		This requires a lower-half driver compatible with the SocketCAN
		API.

if NET_CAN

config NET_CAN_HAVE_TX_DEADLINE
	bool
	default n

config NET_CAN_HAVE_CANFD
	bool
	default n

config NET_CAN_HAVE_ERRORS
	bool
	default n

config CAN_CONNS
	int "Max number of CAN socket connections"
	default 4
	---help---
		Maximum number of CAN connections (all tasks).

config NET_CAN_EXTID
	bool "Enable CAN extended IDs"
	default n
	---help---
		Enables support for the 29-bit extended ID in SocketCAN stack.
		Default Standard 11-bit IDs.

config NET_CAN_CANFD
	bool "Enable CAN FD support"
	default y
	depends on NET_CAN_HAVE_CANFD
	---help---
		Enable CAN FD support in SocketCAN stack

config NET_CAN_ERRORS
	bool "Enable CAN errors support"
	default n
	depends on NET_CAN_HAVE_ERRORS
	---help---
		Enable CAN errors support in SocketCAN stack

config NET_CAN_SOCK_OPTS
	bool "sockopt support"
	default n
	select NET_SOCKOPTS
	select NET_CANPROTO_OPTIONS
	---help---
		Enable support for the CAN socket options

config NET_CAN_RAW_TX_DEADLINE
	bool "TX deadline sockopt"
	default n
	depends on NET_CAN_SOCK_OPTS && NET_CAN_HAVE_TX_DEADLINE
	---help---
		Note: Non-standard SocketCAN sockopt, but this options helps us in
		real-time use cases.

		When the CAN_RAW_TX_DEADLINE sockopt is enabled. The user can send
		CAN frames using sendmsg() function and add a deadline timespec
		value in the CMSG data. When the deadline has been passed and the
		CAN frame is still in the HW TX mailbox then the CAN driver will
		discard the CAN frame automatically.

config NET_CAN_RAW_DEFAULT_TX_DEADLINE
	int "Default TX deadline when no deadline is given (us)"
	default 0
	depends on NET_CAN_RAW_TX_DEADLINE
	---help---
		Some applications may not use the NET_CAN_RAW_TX_DEADLINE flag.
		By default their deadline becomes 0 which means it becomes infinite.
		This would mean that packets from applications without the
		NET_CAN_RAW_TX_DEADLINE flag, can block the TX mailboxes forever.
		This config can set the default deadline when no deadline has been
		given.

config NET_CAN_RAW_FILTER_MAX
	int "CAN_RAW_FILTER max filter count"
	default 32
	depends on NET_CANPROTO_OPTIONS
	---help---
		Maximum number of CAN_RAW filters that can be set per CAN connection.

config NET_CAN_NOTIFIER
	bool "Support CAN notifications"
	default n
	depends on SCHED_WORKQUEUE
	select WQUEUE_NOTIFIER
	---help---
		Enable building of CAN notifier logic that will execute a worker
		function on the low priority work queue when read-ahead data
		is available or when a CAN connection is lost.  This is is a general
		purpose notifier, but was developed specifically to support poll()
		logic where the poll must wait for these events.

endif # NET_CAN
endmenu # CAN Socket Support
```

## net/icmp/Kconfig
```kconfig
#
# For a description of the syntax of this configuration file,
# see the file kconfig-language.txt in the NuttX tools repository.
#

menu "ICMP Networking Support"

config NET_ICMP
	bool "Enable ICMP networking"
	default n
	---help---
		Enable minimal ICMP support. Includes built-in support
		for sending replies to received ECHO (ping) requests.

config NET_ICMP_NO_STACK
	bool "Disable ICMP stack"
	default n
	select NET_ICMP
	---help---
		Build without ICMP stack even if ICMP networking support enabled.

if NET_ICMP && !NET_ICMP_NO_STACK

config NET_ICMP_SOCKET
	bool "IPPROTO_ICMP socket support"
	default n
	select MM_IOB
	---help---
		Enable support for IPPROTO_ICMP sockets.  These sockets are needed
		for application level support for sending ECHO (ping) requests and
		receiving associated ECHO replies.

if NET_ICMP_SOCKET

config NET_ICMP_PREALLOC_CONNS
	int "Preallocated ICMP packet sockets"
	default 4
	---help---
		Number of ICMP connections (all tasks).
		
		This number of connections will be pre-allocated during system boot.
		If dynamic connections allocation is enabled, more connections may
		be allocated at a later time, as the system needs them. Else this
		will be the maximum number of connections available to the system
		at all times.

		Set to 0 to disable (and rely only on dynamic allocations).

config NET_ICMP_ALLOC_CONNS
	int "Dynamic ICMP connections allocation"
	default 0
	---help---
		Dynamic memory allocations for ICMP.

		When set to 0 all dynamic allocations are disabled.

		When set to 1 a new connection will be allocated every time,
		and it will be free'd when no longer needed.

		Setting this to 2 or more will allocate the connections in
		batches (with batch size equal to this config). When a
		connection is no longer needed, it will be returned to the
		free connections pool, and it will never be deallocated!

config NET_ICMP_MAX_CONNS
	int "Maximum number of ICMP connections"
	default 0
	depends on NET_ICMP_ALLOC_CONNS > 0
	---help---
		If dynamic connections allocation is selected (NET_ICMP_ALLOC_CONNS > 0)
		this will limit the number of connections that can be allocated.
		
		This is useful in case the system is under very heavy load (or
		under attack), ensuring that the heap will not be exhausted.

config NET_ICMP_NPOLLWAITERS
	int "Number of ICMP poll waiters"
	default 1

endif # NET_ICMP_SOCKET
endif # NET_ICMP && !NET_ICMP_NO_STACK
endmenu # ICMP Networking Support
```
