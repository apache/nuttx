## net/ipforward/Kconfig
```kconfig
#
# For a description of the syntax of this configuration file,
# see the file kconfig-language.txt in the NuttX tools repository.
#

config NET_IPFORWARD
	bool "Enable L2 forwarding"
	default n
	---help---
		Enable forwarding of packets.  Packets received with IP addresses
		that are not supported by this platform will be forwarded to the
		appropriate network device.  Routing table support may be required.

config NET_IPFORWARD_BROADCAST
	bool "Forward broadcast/multicast packets"
	default n
	depends on NET_IPFORWARD
	---help---
		If selected, broadcast packets received on one network device will
		be forwarded though other network devices.

config NET_IPFORWARD_NSTRUCT
	int "Number of pre-allocated forwarding structures"
	default 4
	depends on NET_IPFORWARD
	---help---
		When packets are forwarded from on device to another, a structure
		must be allocated to hold the state of forwarding across several
		asynchronous events.  Those structures are pre-allocated for
		minimal, deterministic performance and to prevent hogging of memory
		(of course, that means that this value must be carefully selected
		for your application).  This setting defines the number of such pre-
		allocated structures.

		NOTE: This setting effectively puts a maximum on the number of
		packets that may be waiting to be forwarded from one network device
		to another.  CONFIG_IOB_NBUFFERS also limits the forward because the
		payload of the packet (up to the MSS) is retain in IOBs.

		WARNING: DO NOT set this setting to a value greater than or equal to
		CONFIG_IOB_NBUFFERS, otherwise it may consume all the IOB and let
		netdev fail to work.
```

## net/ipfrag/Kconfig
```kconfig
#
# For a description of the syntax of this configuration file,
# see the file kconfig-language.txt in the NuttX tools repository.
#

config NET_IPFRAG
	bool "IP fragmentation support"
	default n
	depends on (NET_IPv4 || NET_IPv6)
	---help---
		Enable support IP packet fragmentation and IP packet reassembly of
		fragmented IP packets.

if NET_IPFRAG

config NET_IPFRAG_REASS_MAXAGE
	int "IP fragmentation timeout"
	default 20
	---help---
		The maximum time an IP fragment should wait in the reassembly buffer
		before it is dropped.  Units are deci-seconds. Default: 2 seconds.

endif # NET_IPFRAG
```

## net/ipv6/Kconfig
```kconfig
#
# For a description of the syntax of this configuration file,
# see misc/tools/kconfig-language.txt.
#

config NET_IPv6
	bool "IPv6"
	default n
	depends on EXPERIMENTAL
	---help---
		Build in support for IPv6.  Not fully implemented.

if NET_IPv6

config NET_IPV6_NCONF_ENTRIES
	int "Number of neighbors"
	default 8

#config NET_IPV6_NEIGHBOR_ADDRTYPE

endif # NET_IPv6
```

## net/local/Kconfig
```kconfig
#
# For a description of the syntax of this configuration file,
# see the file kconfig-language.txt in the NuttX tools repository.
#

menu "Unix Domain Socket Support"
	depends on NET && !DISABLE_PSEUDOFS_OPERATIONS

config NET_LOCAL
	bool "Unix domain (local) sockets"
	default n
	select PIPES
	---help---
		Enable or disable Unix domain (aka Local) sockets.

if NET_LOCAL

config NET_LOCAL_VFS_PATH
	string "Path prefix to Unix domain sockets"
	default "/var/run"
	---help---
		The path prefix to where Unix domain sockets will exist in the VFS namespace.

config NET_LOCAL_STREAM
	bool "Unix domain stream sockets"
	default y
	---help---
		Enable support for Unix domain SOCK_STREAM type sockets

config NET_LOCAL_DGRAM
	bool "Unix domain datagram sockets"
	default y
	---help---
		Enable support for Unix domain SOCK_DGRAM type sockets

config NET_LOCAL_SCM
	bool "Unix domain socket control message"
	default n
	---help---
		Enable support for Unix domain socket control message

endif # NET_LOCAL

endmenu # Unix Domain Sockets
```

## net/mld/Kconfig
```kconfig
#
# For a description of the syntax of this configuration file,
# see the file kconfig-language.txt in the NuttX tools repository.
#

if NET_ICMPv6

menuconfig NET_MLD
	bool "Multicast Listener Discovery (MLD)"
	default n
	select NET_MCASTGROUP
	select NETDEV_IFINDEX
	---help---
		Enable Multicast Listener Discovery (MLD) support.

if NET_MLD

config NET_MLD_ROUTER
	bool "MLD Router support"
	default n
	---help---
		Enables a few hooks that will be needed for router support in the
		future. Use IPv6 multicast routers to discover the presence of multicast
		listeners (nodes configured to receive IPv6 multicast packets)
		on its directly attached links and to discover which multicast packets
		are of interest to neighboring nodes. All IPv6 multicast routers that
		run MLD on the same subnet can monitor MLD listener report messages
		(often called reports) from hosts. However, only one router can act as
		the MLD querier to send MLD query messages (often called queries).
		A querier election mechanism determines which router acts as the MLD
		querier on the subnet.

config NET_MLD_DEBUG
	bool "Force MLD debug"
	default n
	depends on DEBUG_ERROR
	---help---
		Normally, MLD debug output is controlled by CONFIG_DEBUG_NET_*.
		This option will force debug output from MLD files even if network
		debug is not enabled.  This feature does still depend on global
		debug output CONFIG_DEBUG_INFO, CONFIG_DEBUG_WARN, and
		CONFIG_DEBUG_ERROR.

config NET_MLD_TXDUMP
	bool "Enable TX Packet Dump"
	default n
	---help---
		Dump the content of all outgoing packets.

endif # NET_MLD
endif # NET_ICMPv6
```

## net/nat/Kconfig
```kconfig
#
# For a description of the syntax of this configuration file,
# see the file kconfig-language.txt in the NuttX tools repository.
#

config NET_NAT
	bool "Network Address Translation (NAT)"
	default n
	depends on NET_IPFORWARD
	---help---
		Enable or disable Network Address Translation (NAT) function.

		Note: When forwarding IPv4 packet and applying NAT, NAT may be
		applied directly on a single I/O buffer containing L3 packet header,
		and NAT may need a continuous buffer of at least 68 Bytes
		(IPv4 20B + ICMP 8B + IPv4 20B + TCP 20B). And 108 Bytes for IPv6.

config NET_NAT44
	bool "IPv4-to-IPv4 NAT (NAT44)"
	default y
	depends on NET_IPv4 && NET_NAT
	depends on IOB_BUFSIZE >= 68

choice
	prompt "NAT44 Type"
	default NET_NAT44_FULL_CONE
	depends on NET_NAT44

config NET_NAT44_FULL_CONE
	bool "Full Cone NAT"
	---help---
		Full Cone NAT is easier to traverse than Symmetric NAT, and uses
		less resources than Symmetric NAT.

config NET_NAT44_SYMMETRIC
	bool "Symmetric NAT"
	---help---
		Symmetric NAT will be safer than Full Cone NAT, be more difficult
		to traverse, and has more entries which may lead to heavier load.

endchoice

config NET_NAT66
	bool "IPv6-to-IPv6 NAT (NAT66)"
	default y
	depends on NET_IPv6 && NET_NAT
	depends on IOB_BUFSIZE >= 108

choice
	prompt "NAT66 Type"
	default NET_NAT66_FULL_CONE
	depends on NET_NAT66

config NET_NAT66_FULL_CONE
	bool "Full Cone NAT"
	---help---
		Full Cone NAT is easier to traverse than Symmetric NAT, and uses
		less resources than Symmetric NAT.

config NET_NAT66_SYMMETRIC
	bool "Symmetric NAT"
	---help---
		Symmetric NAT will be safer than Full Cone NAT, be more difficult
		to traverse, and has more entries which may lead to heavier load.

endchoice

config NET_NAT_HASH_BITS
	int "The bits of NAT entry hashtable"
	default 5
	range 1 10
	depends on NET_NAT
	---help---
		The hashtable of NAT entries will have (1 << bits) buckets.

config NET_NAT_TCP_EXPIRE_SEC
	int "TCP NAT entry expiration seconds"
	default 86400
	depends on NET_NAT
	---help---
		The expiration time for idle TCP entry in NAT.

		Note: The default value 86400 is suggested by RFC2663, Section 2.6,
		Page 5.

config NET_NAT_UDP_EXPIRE_SEC
	int "UDP NAT entry expiration seconds"
	default 240
	depends on NET_NAT
	---help---
		The expiration time for idle UDP entry in NAT.

		Note: RFC2663 (Section 2.6, Page 5) suggests that non-TCP sessions
		that have not been used for a couple of minutes can be assumed to be
		terminated.

config NET_NAT_ICMP_EXPIRE_SEC
	int "ICMP NAT entry expiration seconds"
	default 60
	depends on NET_NAT
	---help---
		The expiration time for idle ICMP entry in NAT.

		Note: The default value 60 is suggested by RFC5508, Section 3.2,
		Page 8.

config NET_NAT_ICMPv6_EXPIRE_SEC
	int "ICMPv6 NAT entry expiration seconds"
	default 60
	depends on NET_NAT
	---help---
		The expiration time for idle ICMPv6 entry in NAT.

config NET_NAT_ENTRY_RECLAIM_SEC
	int "The time to auto reclaim all expired entries"
	default 3600
	depends on NET_NAT
	---help---
		The time to auto reclaim all expired entries. A value of zero will
		disable auto reclaiming.

		Note: Expired entries will be automatically reclaimed when matching
		inbound/outbound entries, so this config does not have significant
		impact when NAT is normally used, but very useful when the hashtable
		is big and there are only a few connections using NAT (which will
		only trigger reclaiming on a few chains in hashtable).
```

## net/neighbor/Kconfig
```kconfig
#
# For a description of the syntax of this configuration file,
# see the file kconfig-language.txt in the NuttX tools repository.
#

if NET_IPv6

config NET_IPv6_NCONF_ENTRIES
	int "Number of IPv6 neighbors"
	default 8

endif # NET_IPv6
```

## net/netdev/Kconfig
```kconfig
#
# For a description of the syntax of this configuration file,
# see the file kconfig-language.txt in the NuttX tools repository.
#

menu "Network Device Operations"

config NETDEV_IOCTL
	bool
	default n

config NETDEV_PHY_IOCTL
	bool "Enable PHY ioctl()"
	default n
	select NETDEV_IOCTL
	---help---
		Enable support for ioctl() commands to access PHY registers

config NETDEV_CAN_BITRATE_IOCTL
	bool "Enable CAN bitrate ioctl()"
	default n
	select NETDEV_IOCTL
	depends on NET_CAN
	---help---
		Enable support for ioctl() commands to change CAN bitrate

config NETDEV_CAN_FILTER_IOCTL
	bool "Enable CAN filter ioctl()"
	default n
	select NETDEV_IOCTL
	depends on NET_CAN
	---help---
		Enable support for ioctl() commands to add/remove CAN hardware-level
		filters (NOTE: Not supported by all drivers)

config NETDEV_CAN_STATE_IOCTL
	bool "Enable CAN state ioctl()"
	default n
	select NETDEV_IOCTL
	depends on NET_CAN
	---help---
		Enable support for ioctl() commands to set/see CAN or LIN controller-state
		(NOTE: Not supported by all drivers)

config NETDEV_WIRELESS_IOCTL
	bool "Enable Wireless ioctl()"
	default n
	select NETDEV_IOCTL
	depends on DRIVERS_WIRELESS
	---help---
		Enable support for wireless device ioctl() commands

config NETDEV_MODEM_LTE_IOCTL
	bool "Enable LTE ioctl()"
	default n
	select NETDEV_IOCTL
	depends on MODEM
	---help---
		Enable support for modem device ioctl() commands

config NETDEV_IFINDEX
	bool "Enable IF index support"
	default n
	---help---
		Enable support for references devices by an interface index.

		This feature is automatically enabled when raw, PACKET sockets
		are enabled.

		When enabled, these option also enables the user interfaces:
		if_nametoindex() and if_indextoname().

config NETDEV_MULTIPLE_IPv6
	bool "Enable multiple IPv6 addresses support"
	default n
	select NETDEV_IFINDEX
	depends on NET_IPv6
	---help---
		Enable support for multiple IPv6 addresses per network device.

config NETDEV_MAX_IPv6_ADDR
	int "Maximum number of IPv6 addresses per network device"
	range 2 255
	default 2
	depends on NETDEV_MULTIPLE_IPv6
	---help---
		Maximum number of IPv6 addresses that can be assigned to a single
		network device. Normally a link-local address and a global address
		are needed.

config NETDOWN_NOTIFIER
	bool "Support network down notifications"
	default n
	depends on SCHED_WORKQUEUE
	select WQUEUE_NOTIFIER
	---help---
		Enable building of logic that will execute on the low priority work
		thread when the network is taken down.  This is is a general purpose
		notifier, but was developed specifically to support SIGHUP poll()
		logic.

endmenu # Network Device Operations
```
