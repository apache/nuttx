## net/netfilter/Kconfig
```kconfig
#
# For a description of the syntax of this configuration file,
# see the file kconfig-language.txt in the NuttX tools repository.
#

config NET_IPTABLES
	bool "Iptables & Ip6tables Interface"
	default y
	depends on NET_IPv4 || NET_IPv6
	depends on NET_SOCKOPTS
	depends on NET_NAT || NET_IPFILTER
	---help---
		Enable or disable iptables compatible interface (for NAT).
```

## net/netlink/Kconfig
```kconfig
#
# For a description of the syntax of this configuration file,
# see the file kconfig-language.txt in the NuttX tools repository.
#

menu "Netlink Socket Support"

config NET_NETLINK
	bool "Netlink socket support"
	default n
	depends on SCHED_WORKQUEUE
	select WQUEUE_NOTIFIER
	---help---
		Enable support for Netlink-like IPC sockets that will permit user-
		space applications to interact with network services.

		This logic is a WIP.  Currently only fragmentary support is
		available, not enough to actually do anything of consequence.
		Only the following features are implemented at this time:

		  NETLINK_ROUTE capability to read the ARP table.

if NET_NETLINK

config NETLINK_PREALLOC_CONNS
	int "Preallocated Netlink connections"
	default 4
	---help---
		Number of Netlink connections (all tasks).
		
		This number of connections will be pre-allocated during system boot.
		If dynamic connections allocation is enabled, more connections may
		be allocated at a later time, as the system needs them. Else this
		will be the maximum number of connections available to the system
		at all times.

		Set to 0 to disable (and rely only on dynamic allocations).

config NETLINK_ALLOC_CONNS
	int "Dynamic Netlink connections allocation"
	default 0
	---help---
		Dynamic memory allocations for Netlink.

		When set to 0 all dynamic allocations are disabled.

		When set to 1 a new connection will be allocated every time,
		and it will be free'd when no longer needed.

		Setting this to 2 or more will allocate the connections in
		batches (with batch size equal to this config). When a
		connection is no longer needed, it will be returned to the
		free connections pool, and it will never be deallocated!

config NETLINK_MAX_CONNS
	int "Maximum number of Netlink connections"
	default 0
	depends on NETLINK_ALLOC_CONNS > 0
	---help---
		If dynamic connections allocation is selected (NETLINK_ALLOC_CONNS > 0)
		this will limit the number of connections that can be allocated.
		
		This is useful in case the system is under very heavy load (or
		under attack), ensuring that the heap will not be exhausted.

menu "Netlink Protocols"

config NETLINK_ROUTE
	bool "Netlink Route protocol"
	default n
	---help---
		Support the NETLINK_ROUTE protocol option.

if NETLINK_ROUTE

config NETLINK_DISABLE_GETLINK
	bool "Disable RTM_GETLINK support"
	default n
	---help---
		RTM_GETLINK is used to enumerate network devices.

config NETLINK_DISABLE_GETNEIGH
	bool "Disable RTM_GETNEIGH support"
	default n
	---help---
		RTM_GETNEIGH is used to retrieve Neighbor/ARP tables.

config NETLINK_DISABLE_GETROUTE
	bool "Disable RTM_GETROUTE support"
	default n
	---help---
		RTM_GETROUTE is used to retrieve routing tables.

endif # NETLINK_ROUTE
endmenu # Netlink Protocols
endif # NET_NETLINK
endmenu # Netlink Socket Support
```

## net/pkt/Kconfig
```kconfig
#
# For a description of the syntax of this configuration file,
# see the file kconfig-language.txt in the NuttX tools repository.
#

menu "Raw Socket Support"

config NET_PKT
	bool "Socket packet socket support"
	default n
	select NETDEV_IFINDEX
	---help---
		Enable or disable support for packet sockets.

		Packet sockets allow receiving and transmitting frames without
		a transport protocol in between. Frames received are copied into
		a packet socket tap before they enter the network. Data written into
		a packet socket will bypass the network altogether and be placed in
		the transmission buffer of the network interface driver.

		REVISIT: Currently only implemented for Ethernet.

if NET_PKT

config NET_PKT_PREALLOC_CONNS
	int "Preallocated packet sockets"
	default 1
	---help---
		Number of packet connections (all tasks).
		
		This number of connections will be pre-allocated during system boot.
		If dynamic connections allocation is enabled, more connections may
		be allocated at a later time, as the system needs them. Else this
		will be the maximum number of connections available to the system
		at all times.

		Set to 0 to disable (and rely only on dynamic allocations).

config NET_PKT_ALLOC_CONNS
	int "Dynamic packet connections allocation"
	default 0
	---help---
		Dynamic memory allocations for packet sockets.

		When set to 0 all dynamic allocations are disabled.

		When set to 1 a new connection will be allocated every time,
		and it will be free'd when no longer needed.

		Setting this to 2 or more will allocate the connections in
		batches (with batch size equal to this config). When a
		connection is no longer needed, it will be returned to the
		free connections pool, and it will never be deallocated!

config NET_PKT_MAX_CONNS
	int "Maximum number of packet connections"
	default 0
	depends on NET_PKT_ALLOC_CONNS > 0
	---help---
		If dynamic connections allocation is selected (NET_PKT_ALLOC_CONNS > 0)
		this will limit the number of connections that can be allocated.
		
		This is useful in case the system is under very heavy load (or
		under attack), ensuring that the heap will not be exhausted.

endif # NET_PKT
endmenu # Raw Socket Support
```

## net/route/Kconfig
```kconfig
#
# For a description of the syntax of this configuration file,
# see the file kconfig-language.txt in the NuttX tools repository.
#

menu "Routing Table Configuration"

config NET_ROUTE
	bool "Routing table support"
	default n
	depends on NET_IPv4 || NET_IPv6
	---help---
		Build in support for a routing table.  See include/net/route.h

if NET_ROUTE

choice
	prompt "IPv4 routing table"
	default ROUTE_IPv4_RAMROUTE
	depends on NET_IPv4

config ROUTE_IPv4_RAMROUTE
	bool "In-memory"
	---help---
		Select to used a IPv4 routing table RAM.

config ROUTE_IPv4_ROMROUTE
	bool "Read-only"
	---help---
		Select to used a fixed read-only IPv4 routing table in FLASH or ROM.
		In this case, the board-specific logic must provide a routing table
		of the form of a simple array:

			FAR const struct net_route_ipv4_s g_ipv4_routes[];
			const unsigned int g_ipv4_nroutes;

		NOTE:  The read-only variable g_ipv4_nroutes must be set to the
		actual number of valid entries in the array.

config ROUTE_IPv4_FILEROUTE
	bool "File"
	---help---
		Select to used a IPv4 routing table in a file in a mounted file system.

endchoice # IPv4 routing table

config ROUTE_MAX_IPv4_RAMROUTES
	int "Preallocated IPv4 routing table entries"
	default 4
	depends on ROUTE_IPv4_RAMROUTE
	---help---
		The number of preallocated of the IPv4 routing table entries.  This
		eliminates dynamica memory allocations, but limits the maximum size
		of the in-memory routing table to this number.

config ROUTE_IPv4_CACHEROUTE
	bool "In-memory IPv4 cache"
	default n
	depends on ROUTE_IPv4_FILEROUTE
	---help---
		Accessing a routing table on a file system before each packet is sent
		can harm performance.  This option will cache a few of the most
		frequently used routing table entries in memory to reduce performance
		issues.

config ROUTE_MAX_IPv4_CACHEROUTES
	int "IPv4 cache size"
	default 4
	depends on ROUTE_IPv4_CACHEROUTE
	---help---
		This determines the maxium number of routes that can be cached in
		memory.

choice
	prompt "IPv6 routing table"
	default ROUTE_IPv6_RAMROUTE
	depends on NET_IPv6

config ROUTE_IPv6_RAMROUTE
	bool "In-memory"
	---help---
		Select to use a IPv6 routing table RAM.

config ROUTE_IPv6_ROMROUTE
	bool "Read-only"
	---help---
		Select to use a fixed read-only IPv6 routing table in FLASH or ROM.
		In this case, the board-specific logic must provide a routing table
		of the form of simply array:

			FAR const struct net_route_ipv6_s g_ipv6_routes[];
			const unsigned int g_ipv6_nroutes;

		NOTE:  The read-only variable g_ipv6_nroutes must be set to the
		actual number of valid entries in the array.

config ROUTE_IPv6_FILEROUTE
	bool "File"
	---help---
		Select to use a IPv6 routing table in a file in a mounted file system.

endchoice # IPv6 routing table

config ROUTE_MAX_IPv6_RAMROUTES
	int "Preallocated IPv6 routing table entries"
	default 4
	depends on ROUTE_IPv6_RAMROUTE
	---help---
		The number of preallocated of the IPv6 routing table entries.  This
		eliminates dynamica memory allocations, but limits the maximum size
		of the in-memory routing table to this number.

config ROUTE_FILEDIR
	string "Routing table directory"
	default /tmp
	depends on ROUTE_IPv4_FILEROUTE || ROUTE_IPv6_FILEROUTE
	---help---
		Provides the full path to location in the file system where routing
		table will be accessed.  This is a string and should not include
		any traling '/'.

config ROUTE_IPv6_CACHEROUTE
	bool "In-memory IPv6 cache"
	default n
	depends on ROUTE_IPv6_FILEROUTE
	---help---
		Accessing a routing table on a file system before each packet is sent
		can harm performance.  This option will cache a few of the most
		frequently used routing table entries in memory to reduce performance
		issues.

config ROUTE_MAX_IPv6_CACHEROUTES
	int "IPv6 cache size"
	default 4
	depends on ROUTE_IPv6_CACHEROUTE
	---help---
		This determines the maxium number of routes that can be cached in
		memory.

endif # NET_ROUTE
endmenu # ARP Configuration
```

## net/rpmsg/Kconfig
```kconfig
#
# For a description of the syntax of this configuration file,
# see the file kconfig-language.txt in the NuttX tools repository.
#

menu "RPMSG Socket Support"
	depends on NET

config NET_RPMSG
	bool "RPMSG domain (remote) sockets"
	depends on RPMSG
	default n
	---help---
		Enable or disable RPMSG (aka remote) sockets.

if NET_RPMSG

config NET_RPMSG_RXBUF_SIZE
	int "RPMSG socket rx buffer size"
	default 1024
	---help---
		Socket RPMSG rx buffer size, for recv slowly

config NET_RPMSG_NPOLLWAITERS
	int "RPMSG socket number of poll waiters"
	default 4
	---help---
		Socket RPMSG number of poll waiters

endif # NET_RPMSG

endmenu # Rpmsg Domain Sockets
```
