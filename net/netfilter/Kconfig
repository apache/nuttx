## net/utils/Kconfig
```kconfig
#
# For a description of the syntax of this configuration file,
# see the file kconfig-language.txt in the NuttX tools repository.
#

config NET_ARCH_INCR32
	bool "Architecture-specific net_incr32()"
	default n
	---help---
		Define if you architecture provided an optimized version of
		net_incr32() with prototype:

			void net_incr32(FAR uint8_t *op32, uint16_t op16)

config NET_ARCH_CHKSUM
	bool "Architecture-specific net_chksum()"
	default n
	---help---
		Define if you architecture provided an optimized version of
		functions with the following prototypes:

			uint16_t chksum(uint16_t sum, FAR const uint8_t *data, uint16_t len)
			uint16_t net_chksum(FAR uint16_t *data, uint16_t len)
			uint16_t ipv4_chksum(FAR struct ipv4_hdr_s *ipv4)
			uint16_t ipv4_upperlayer_chksum(FAR struct net_driver_s *dev, uint8_t proto)
			uint16_t ipv6_upperlayer_chksum(FAR struct net_driver_s *dev, uint8_t proto, unsigned int iplen)

config NET_SNOOP_BUFSIZE
	int "Snoop buffer size for interrupt"
	default 4096

config NET_RECV_PACK
	bool "Enable TCP/IP receive data in a continuous poll"
	default y
	---help---
		This option will enable TCP/IP receive data into a continuous iob chain.
		Fragmentation of network data will intensify iob consumption, if
		the device receives a message storm of fragmented packets, the iob
		cache will not be effectively used, this is not allowed on iot devices
		since the resources of such devices are limited. Of course, this
		also takes some disadvantages: data needs to be copied.
		This option will brings some balance on resource-constrained devices,
		enable this config to reduce the consumption of iob, the received iob
		buffers will be merged into the contiguous iob chain.
```

## net/vsock/Kconfig
```kconfig
#
# For a description of the syntax of this configuration file,
# see misc/tools/kconfig-language.txt.
#

menu "Virtual Socket networking stack API"

config NET_VSOCK
	bool

if NET_VSOCK

config NET_VSOCK_RX_BUFSIZE
	int "Virtual Socket rx buffer size"
	default 2048

config NET_VSOCK_NPOLLWAITERS
	int "Virtual Socket poll waiter number"
	default 4

config NET_VSOCK_PKT_BUFSIZE
	int "Virtual Socket packet tx buffer size"
	default 2048

config NET_VSOCK_PKT_BUFCOUNT
	int "Virtual Socket packet virtqueue buf count"
	default 16

config NET_VSOCK_WORK_PRIORITY
	int "Virtual Socket work priority"
	default 223

config NET_VSOCK_WORK_STACKSIZE
	int "Virtual Socket work stack size"
	default DEFAULT_TASK_STACKSIZE

config NET_VSOCK_VQ_BUFCOUNT
	int "Virtual Socket virtqueue max number"
	default 64

endif # NET_VSOCK

config NET_VSOCK_VIRTIO
	bool "Virtual Socket Virtio Transport Layer Support"
	default n
	select DRIVERS_VIRTIO
	select NET_VSOCK

config NET_VSOCK_VHOST
	bool "Virtual Socket Vhost Transport Layer Support"
	default n
	select DRIVERS_VHOST
	select NET_VSOCK

endmenu # Virtual Socket networking stack API
```

## nn/Kconfig
```kconfig
#
# For a description of the syntax of this configuration file,
# see the file kconfig-language.txt in the NuttX tools repository.
#

config NN
	bool "Neural Network support"
	default n
	---help---
		Enable or disable support for Neural Network features

if NN

source "nn/libnnablart/Kconfig"

endif # NN
```

## nn/libnnablart/Kconfig
```kconfig
#
# For a description of the syntax of this configuration file,
# see the file kconfig-language.txt in the NuttX tools repository.
#

config NNABLA_RT
	bool "NNABLA Runtime Libraries"
	default n
	---help---
		This is a runtime library for inference Neural Networks
		created by Neural Network Libraries.
		https://github.com/sony/nnabla-c-runtime

if NNABLA_RT

config NNABLA_RT_VER
	string "Default NNABLA Runtime version"
	default 1.24.0

endif # NNABLA_RT
```

## openamp/Kconfig
```kconfig
#
# For a description of the syntax of this configuration file,
# see the file kconfig-language.txt in the NuttX tools repository.
#

config OPENAMP
	bool
	default n
	---help---
		Enable or disable Open Asymmetric Multi Processing features

if OPENAMP

config OPENAMP_CACHE
	bool "Enable OpenAMP Cache support"
	default n
	---help---
		Enable or disable OpenAMP Cache support (VIRTIO_CACHED_BUFFERS and
		VIRTIO_CACHED_VRINGS)

config OPENAMP_DEBUG
	bool "Enable OpenAMP Debug"
	default n

config OPENAMP_VIRTIO_DEVICE_SUPPORT
	bool "Enable VIRTIO_DEVICE_SUPPORT"
	default y

config OPENAMP_VIRTIO_DRIVER_SUPPORT
	bool "Enable VIRTIO_DRIVER_SUPPORT"
	default y

endif # OPENAMP
```

## syscall/Kconfig
```kconfig
#
# For a description of the syntax of this configuration file,
# see the file kconfig-language.txt in the NuttX tools repository.
#

menuconfig LIB_SYSCALL
	bool "System call support"
	default n
	---help---
		Build in support for "system calls".  System calls are used to
		implement a call gate mechanism that can be be used to call from
		user code into the kernel.  This is only useful for user code that
		lies outside of the kernel such as when the BUILD_PROTECTED or
		BUILD_KERNEL builds are selected.

		This permits calls from user-mode code into kernel mode; the call
		gate will change the mode of operation from user to supervisor mode,
		then call into the OS code on behalf of the user-mode application.

		If if there are no privilege issues preventing the call, system
		calls may also be of value because it can eliminate the need for
		symbol tables when linking external modules to the NuttX base code.
		The selection will build libsyscall.  External modules can then link
		with libsyscall when they are built and they can call into the OS
		with no knowledge of the actual address in the OS.  In this case,
		they call into a proxy that is link with the external code; that
		proxy then marshals the call parameter and invokes the system call
		to accomplish the interface.

if LIB_SYSCALL

config SYS_NNEST
	int "Number of nested system calls"
	default 2
	---help---
		This is architecture dependent.  Most architectures allocate
		resources to manage a fixed, maximum number of nested system calls.
		A nested system call occurs in the following scenario:  (1) A non-
		privileged user thread executes a system call, (2) part of the
		system call processing cause a call back into the user space code,
		and (3) the user space code performs another system call.

		I don't believe that any nested system calls will occur in the
		current design so the default maximum nesting level of 2 should be
		more than sufficient.

endif # LIB_SYSCALL
```

## video/Kconfig
```kconfig
#
# For a description of the syntax of this configuration file,
# see the file kconfig-language.txt in the NuttX tools repository.
#

comment "Video subsystem"

config VIDEO
	bool "Video Support"
	default n
	---help---
		Enables overall support for Video library.

if VIDEO

config VIDEO_DEV_PATH
	string "video device path"
	default "/dev/video"

source "video/videomode/Kconfig"

endif # VIDEO
```

## video/videomode/Kconfig
```kconfig
#
# For a description of the syntax of this configuration file,
# see the file kconfig-language.txt in the NuttX tools repository.
#

config VIDEO_EDID
	bool "EDID / Videomode Support"
	default n
	---help---
		Enable support for managing EDID data EDID (Extended Display
		Identification Data).
```

## wireless/Kconfig
```kconfig
#
# For a description of the syntax of this configuration file,
# see the file kconfig-language.txt in the NuttX tools repository.
#

config WIRELESS
	bool "Wireless Support"
	default n
	---help---
		Enables overall support for Wireless library.

if WIRELESS

source wireless/bluetooth/Kconfig
source wireless/ieee802154/Kconfig
source wireless/pktradio/Kconfig

endif # WIRELESS
```

## wireless/bluetooth/Kconfig
```kconfig
#############################################################################
# wireless/bluetooth/Kconfig
# Bluetooth LE stack configuration options
#
#   Copyright (C) 2018 Gregory Nutt. All rights reserved.
#   Author: Gregory Nutt <gnutt@nuttx.org>
#
# Ported from the Intel/Zephyr arduino101_firmware_source-v1.tar package
# where the code was released with a compatible 3-clause BSD license:
#
#   Copyright (c) 2016, Intel Corporation
#   All rights reserved.
#
# Redistribution and use in source and binary forms, with or without
# modification, are permitted provided that the following conditions are met:
#
# 1. Redistributions of source code must retain the above copyright notice,
#    this list of conditions and the following disclaimer.
#
# 2. Redistributions in binary form must reproduce the above copyright notice,
#    this list of conditions and the following disclaimer in the documentation
#    and/or other materials provided with the distribution.
#
# 3. Neither the name of the copyright holder nor the names of its
#    contributors may be used to endorse or promote products derived from this
#    software without specific prior written permission.
#
# THIS SOFTWARE IS PROVIDED BY THE COPYRIGHT HOLDERS AND CONTRIBUTORS "AS IS"
# AND ANY EXPRESS OR IMPLIED WARRANTIES, INCLUDING, BUT NOT LIMITED TO, THE
# IMPLIED WARRANTIES OF MERCHANTABILITY AND FITNESS FOR A PARTICULAR PURPOSE
# ARE DISCLAIMED. IN NO EVENT SHALL THE COPYRIGHT HOLDER OR CONTRIBUTORS BE
# LIABLE FOR ANY DIRECT, INDIRECT, INCIDENTAL, SPECIAL, EXEMPLARY, OR
# CONSEQUENTIAL DAMAGES (INCLUDING, BUT NOT LIMITED TO, PROCUREMENT OF
# SUBSTITUTE GOODS OR SERVICES; LOSS OF USE, DATA, OR PROFITS; OR BUSINESS
# INTERRUPTION) HOWEVER CAUSED AND ON ANY THEORY OF LIABILITY, WHETHER IN
# CONTRACT, STRICT LIABILITY, OR TORT (INCLUDING NEGLIGENCE OR OTHERWISE)
# ARISING IN ANY WAY OUT OF THE USE OF THIS SOFTWARE, EVEN IF ADVISED OF THE
# POSSIBILITY OF SUCH DAMAGE.
#
#############################################################################

menuconfig WIRELESS_BLUETOOTH
	bool "Bluetooth LE support"
	default n
	depends on ALLOW_BSD_COMPONENTS
	select MM_IOB
	select SCHED_HPWORK
	select SCHED_LPWORK
	---help---
		This option enables Bluetooth Low Energy support.

if WIRELESS_BLUETOOTH

menuconfig WIRELESS_BLUETOOTH_HOST
	bool "BLE Host Layer"
	default y
	---help---
		This enables support for BLE host layer implementation. This can be
		used to interface to a BLE controller via HCI protocol (either to a local
		BLE link-layer or to an external device over HCI UART).

if WIRELESS_BLUETOOTH_HOST
config DEVICE_APPEARANCE
	int "Appearance sub-category value"
	default 0
	range 0 5188
	---help---
		This value comes from the "Appearance sub-category"
		section (2.6.3) in the Bluetooth Assigned Numbers document.

config DEVICE_NAME
	string "Device name"
	default "Apache NuttX"
	---help---
		The device name.

config DEVICE_LOCAL_NAME
	string "Device local name"
	default "NuttX"
	---help---
		The device name used for advertising.

endif # WIRELESS_BLUETOOTH_HOST

config BLUETOOTH_MAX_CONN
	int "Maximum number of simultaneous connections"
	default 1
	range 1 16
	---help---
		Maximum number of simultaneous Bluetooth connections
		supported. The minimum (and default) number is 1.

config BLUETOOTH_MAX_PAIRED
	int "Maximum number of paired devices"
	default 1
	range 1 32
	---help---
		Maximum number of paired Bluetooth devices. The minimum (and
		default) number is 1.

config BLUETOOTH_MAXSCANDATA
	int "Max scan data size"
	default 64
	range 1 255
	---help---
		Scan results will be buffered in memory until the user requests the
		scan results.  This parameter specifies the maximum size of the
		advertiser data that accompanies the scan result.

		This contributes to a static memory allocation that will be greater
		than CONFIG_BLUETOOTH_MAXSCANDATA * CONFIG_BLUETOOTH_MAXSCANRESULT

config BLUETOOTH_MAXSCANRESULT
	int "Max scan results"
	default 8
	range 1 255
	---help---
		Scan results will be buffered in memory until the user requests the
		scan results.  This parameter specifies the maximum number of
		results that can be buffered before scan results are lost.

		This contributes to a static memory allocation that will be greater
		than CONFIG_BLUETOOTH_MAXSCANDATA * CONFIG_BLUETOOTH_MAXSCANRESULT

config BLUETOOTH_MAXDISCOVER
	int "Max GATT discovery results"
	default 8
	range 1 255
	---help---
		GATT discovery results will be buffered in memory until the user
		requests the results.  This parameter specifies the maximum results
		that can be buffered before discovery results are lost.

config BLUETOOTH_BUFFER_PREALLOC
	int "Number of pre-allocated buffer structures"
	default 20
	---help---
		This specifies the total number of preallocated buffer structures.
		This is for performance optimization.  If additional buffer structures
		are needed, they will be allocated dynamically at some loss of
		performance.

config BLUETOOTH_BUFFER_IRQRESERVE
	int "Reserved pre-allocated primitive structures"
	default 0
	---help---
		If buffer structures can be allocated from interrupt handlers, then
		this specifies the number of pre-allocated structures that are
		reserved for for use only by interrupt handlers.  This may be set
		zero to reserve no buffers for interrupt handlers. In that case,
		the allocation will fail if tasking logic has allocated them all.

		Interrupt logic will first attempt to allocate from the general,
		pre-allocated buffer pool that will contain up to (size
		CONFIG_BLUETOOTH_BUFFER_PREALLOC - BLUETOOTH_BUFFER_IRQRESERVE)
		entries.  If that fails, then it will try to take a buffer from
		the reserve (size CONFIG_BLUETOOTH_BUFFER_IRQRESERVE).

		Non-interrupt logic will also first attempt to allocate from the
		general, pre-allocated buffer pool.  If that fails, it will
		dynamically allocate the buffer with an additional cost in
		performance.

		NOTE:  The Bluetooth stack never allocates buffers from the
		interrupt level.  This setting only needs to be non-zero if your
		low-level Bluetooth driver needs to do such allocations.

menu "Kernel Thread Configuration"

config BLUETOOTH_TXCMD_STACKSIZE
	int "Tx command thread stack size"
	default DEFAULT_TASK_STACKSIZE

config BLUETOOTH_TXCMD_PRIORITY
	int "Tx command thread priority"
	default 100
	range 1 255

config BLUETOOTH_TXCMD_NMSGS
	int "Tx command thread mqueue size"
	default 16

config BLUETOOTH_TXCONN_STACKSIZE
	int "Tx connection thread stack size"
	default DEFAULT_TASK_STACKSIZE

config BLUETOOTH_TXCONN_PRIORITY
	int "Tx connection thread priority"
	default 100
	range 1 255

config BLUETOOTH_TXCONN_NMSGS
	int "Tx connection thread mqueue size"
	default 16

endmenu # Kernel Thread Configuration

config BLUETOOTH_SMP_SELFTEST
	bool "Bluetooth SMP self tests executed on init"
	default n
	---help---
		This option enables SMP self-tests executed on startup
		to verify security and crypto functions.

endif # WIRELESS_BLUETOOTH
```
