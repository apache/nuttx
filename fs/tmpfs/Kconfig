## libc/unistd/Kconfig
```kconfig
#
# For a description of the syntax of this configuration file,
# see the file kconfig-language.txt in the NuttX tools repository.
#

menu "Program Execution Options"

config LIBC_EXECFUNCS
	bool "Enable exec[l|v] / posix_spawn() Support"
	default n
	depends on !BINFMT_DISABLE
	---help---
		Enable support for the exec[l|v] family of functions that can be
		used to start other programs, terminating the current program and
		the posix_spawn() familty of functions that can be used start other
		programs without terminating the current program.  The typical
		usage of the exec[l|v] functions is (1) first call vfork() to create
		a new thread, then (2) call exec[l|v] to replace the new thread with
		a program from the file system.

		NOTE 1: This two step process start is completely unnecessary in
		NuttX and is provided only for compatibily with Unix systems.  These
		functions are essentially just wrapper functions that (1) call the
		non-standard binfmt function 'exec', and then (2) exit(0).  Since
		the new thread will be terminated by the exec[l|v] call, it really
		served no purpose other than to suport Unix compatility.

		The posix_spawn() functions do not have this inefficiency.

		NOTE 2: Support for exec[l|v] and posix_spawn() is conditional
		because they require additional support for symbol tables that
		will not be available in the typical system.

if LIBC_EXECFUNCS

config EXECFUNCS_HAVE_SYMTAB
	bool "Have symbol table"
	default n if BUILD_KERNEL
	default y if !BUILD_KERNEL
	---help---
		If you have a system symbol table, then you must select this
		option in order to use it.  Symbol tables are required in most
		cases in order to like executable programs to the base code.

if EXECFUNCS_HAVE_SYMTAB
config EXECFUNCS_SYMTAB
	string "Symbol table used by exec[l|v]"
	default "g_symtab"
	---help---
		The exec[l|v] and posix_spawn() functions are wrapper functions that
		call the non-standard binfmt function 'exec').  The binfmt
		function 'exec' needs to have (1) a symbol table that provides the
		list of symbols exported by the base code, and (2) the number of
		symbols in that table.  This selection provides the name of that
		symbol table.

config EXECFUNCS_NSYMBOLS
	int "Number of Symbols in the Table"
	default 0
	---help---
		The exec[l|v] and posix_spawn() functions are wrapper functions that
		call the non-standard binfmt function 'exec').  The binfmt
		function 'exec' needs to have (1) a symbol table that provides the
		list of symbols exported by the base code, and (2) the number of
		symbols in that table.  This selection provides the number of
		symbols in the symbol table.

endif # EXECFUNCS_HAVE_SYMTAB
endif # LIBC_EXECFUNCS

config POSIX_SPAWN_PROXY_STACKSIZE
	int "Spawn Stack Size"
	default 1024
	---help---
		If posix_spawn[p]() and task_spawn() use I/O redirection options,
		they will require an intermediary/proxy task to muck with the file
		descriptors.  This configuration item specifies the stack size
		used for the proxy. Default: 1024 bytes.

config TASK_SPAWN_DEFAULT_STACKSIZE
	int "Default task_spawn Stack Size"
	default 2048
	depends on !ARCH_ADDRENV
	---help---
		The actual size to use for the child task's stack can be set with
		task_spawnattr_setstacksize().  This value specifies the default
		stack size to use if task_spawnattr_setstacksize() is not used.
		Default: 2048.

endmenu # Program Execution Options
```

## libnx/Kconfig
```kconfig
#
# For a description of the syntax of this configuration file,
# see the file kconfig-language.txt in the NuttX tools repository.
#

source libnx/nx/Kconfig
source libnx/nxfonts/Kconfig
source libnx/nxglib/Kconfig
source libnx/nxmu/Kconfig
source libnx/nxtk/Kconfig
```

## libnx/nxglib/Kconfig
```kconfig
#
# For a description of the syntax of this configuration file,
# see the file kconfig-language.txt in the NuttX tools repository.
#

config NXGLIB
	bool
	default y if NX || NXFONTS
	default n if !NX && !NXFONTS
```

## libs/libbuiltin/Kconfig
```kconfig
#
# For a description of the syntax of this configuration file,
# see the file kconfig-language.txt in the NuttX tools repository.
#

comment "Toolchain Library Support"

config LIB_BUILTIN
	bool

config LIB_COMPILER_RT
	bool

choice
	prompt "Builtin toolchain support"
	default BUILTIN_TOOLCHAIN
	---help---
		Select the builtin library

config BUILTIN_COMPILER_RT
	bool "Builtin LLVM libclang_rt.builtins"
	depends on ARCH_TOOLCHAIN_GNU
	select LIB_BUILTIN
	select LIB_COMPILER_RT
	---help---
		Compile the LLVM Compiler-rt library into the OS.

config BUILTIN_TOOLCHAIN
	bool "Link toolchain builtin library to the OS"

endchoice

choice
	prompt "Code coverage analysis support"
	default COVERAGE_NONE
	---help---
		Select the code coverage analysis library

config COVERAGE_COMPILER_RT
	bool "Builtin libclang_rt.profile"
	depends on ARCH_TOOLCHAIN_CLANG
	select LIB_BUILTIN
	select LIB_COMPILER_RT
	---help---
		Compile the LLVM Compiler-rt library into the OS.
		Support adding native rich compilation options "-fprofile-xxx"

config COVERAGE_MINI
	bool "Builtin code coverage analysis mini library"
	select LIB_BUILTIN
	---help---
		This is a mini version of the library, which is
		used for code coverage analysis. If the toolchain
		is clang, only support the compilation option
		"-fprofile-instr-generate -fcoverage-mapping"

config COVERAGE_TOOLCHAIN
	bool "Link toolchain gcov library to the OS"
	depends on ARCH_TOOLCHAIN_GCC
	---help---
		Link the toolchain coverage library to the OS.

config COVERAGE_NONE
	bool "Disable coverage function"

endchoice

choice
	prompt "Builtin profile support"
	default PROFILE_NONE
	---help---
		Select the profile library

config PROFILE_MINI
	bool "Enable mini gprof profiling"
	select LIB_BUILTIN
	---help---
		Enable gprof profiling support.  This will cause the compiler to
		generate additional code to support profiling.  This will also
		cause the linker to include the gmon.out file in the final
		executable.
		Add the "-pg" parameter to the Makefile when compiling to obtain
		the function call graph of the specified module. If you do this,
		please enable "CONFIG_FRAME_POINTER"

config PROFILE_NONE
	bool "None profile support"

endchoice

config COVERAGE_ALL
	bool "Enable code coverage for all module"
	depends on !COVERAGE_NONE
	default n
	---help---
		Enable code coverage for all code, it will instrument
		all code, which will cause a large performance penalty for the code.
		If use GCC, it will add the '-fprofile-generate
		-ftest-coverage' parameter to all module.
		If use Clang, it will add the '-fprofile-instr-generate
		-fcoverage-mapping' parameter to all module.
		The data can then be printed nsh run "gcov dump -d /xxx/xxx"


config PROFILE_ALL
	bool "Enable gprof call graph for all modules"
	depends on FRAME_POINTER && !PROFILE_NONE
	default n
	---help---
		Enable gprof profiling for all code, it will instrument
		all code, which will cause a large performance penalty for the code.
		You can add the '-pg' parameter to the specified module in the
		makefile to only analyze the content of the module.

config LIB_COMPILER_RT_VERSION
	string "Select LLVM Compiler-rt version"
	depends on LIB_COMPILER_RT
	default "17.0.1"

config LIB_COMPILER_RT_HAS_BFLOAT16
	bool "Enable support for bfloat16 in Compiler-rt"
	depends on LIB_COMPILER_RT
	default n
```
