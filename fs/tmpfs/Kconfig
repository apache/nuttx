## fs/tmpfs/Kconfig
```kconfig
#
# For a description of the syntax of this configuration file,
# see the file kconfig-language.txt in the NuttX tools repository.
#

config FS_TMPFS
	bool "TMPFS file system"
	default n
	depends on !DISABLE_MOUNTPOINT
	---help---
		Enable TMPFS filesystem support

if FS_TMPFS

config FS_TMPFS_BLOCKSIZE
	int "Reported block size"
	default 512
	---help---
		Various queries expect the file system to report resources in units
		of blocks.  There are, of course, no blocks with the TMPFS.  This
		options is available to control how sizes are reported.  For very
		small TMPFS systems, you might want to set this to something smaller
		the usual 512 bytes.

config FS_TMPFS_DIRECTORY_ALLOCGUARD
	int "Directory object over-allocation"
	default 64
	---help---
		In order to avoid frequent reallocations, a little more memory than
		needed is always allocated.  This permits the directory to grow
		without so many reallocations.

config FS_TMPFS_DIRECTORY_FREEGUARD
	int "Directory under free"
	default 128
	---help---
		In order to avoid frequent reallocations, a lot of free memory has
		to be available before a directory entry shrinks (via reallocation)
		little more memory than needed is always allocated.  This permits
		the directory to shrink without so many reallocations.

config FS_TMPFS_FILE_ALLOCGUARD
	int "Directory object over-allocation"
	default 512
	---help---
		In order to avoid frequent reallocations, a little more memory than
		needed is always allocated.  This permits the file to grow without
		so many reallocations.

		You will probably want to use smaller value than the default on tiny
		TMFPS systems.

config FS_TMPFS_FILE_FREEGUARD
	int "Directory under free"
	default 1024
	---help---
		In order to avoid frequent reallocations, a lot of free memory has
		to be available before a directory entry shrinks (via reallocation)
		little more memory than needed is always allocated.  This permits
		the file to shrink without so many reallocations.

endif
```

## fs/unionfs/Kconfig
```kconfig
#
# For a description of the syntax of this configuration file,
# see misc/tools/kconfig-language.txt.
#

config FS_UNIONFS
	bool "Union File System"
	default n
	---help---
		The Union file system is provides a mechanism to overlay two
		different, mounted file systems so that they appear as one.  In
		general this works like this:

			1) Mount file system 1 at some location, say /mnt/file1
			2) Mount file system 2 at some location, say /mnt/file2
			3) Call unionfs_mount() to combine and overly /mnt/file1 and
			mnt/file2 as a new mount point, say /mnt/unionfs.

		/mnt/file1 and /mnt/file2 will disappear and be replaced by the
		single mountpoint /mnut/unionfs.  The previous contents under
		/mnt/file1 and /mnt/file2 will appear merged under /mnt/unionfs.
		Files at the same relative path in file system1 will take presence.
		If another file of the same name and same relative location exists
		in file system 2, it will not be visible because it will be occluded
		by the file in file system1.

		See include/nutts/unionfs.h for additional information.
```

## fs/userfs/Kconfig
```kconfig
#
# For a description of the syntax of this configuration file,
# see the file kconfig-language.txt in the NuttX tools repository.
#

config FS_USERFS
	bool "User file system"
	default n
	depends on NET_IPv4 && NET_UDP && NET_LOOPBACK
	---help---
		Enable support for user file system.  See include/nuttx/fs/userfs.h

if FS_USERFS
endif
```

## fs/v9fs/Kconfig
```kconfig
#
# For a description of the syntax of this configuration file,
# see the file kconfig-language.txt in the NuttX tools repository.
#

config FS_V9FS
	bool "V9FS file system"
	default n
	depends on !DISABLE_MOUNTPOINT
	---help---
		Enable V9FS filesystem support

if FS_V9FS

config V9FS_DEFAULT_MSIZE
	int "V9FS Default message max size"
	default 65536

config V9FS_VIRTIO_9P
	bool "Virtio 9P support"
	depends on DRIVERS_VIRTIO
	default n

config V9FS_SOCKET_9P
	bool "Socket 9P support"
	depends on NET_TCP
	default n

endif
```

## fs/vfs/Kconfig
```kconfig
#
# For a description of the syntax of this configuration file,
# see the file kconfig-language.txt in the NuttX tools repository.
#

config EVENT_FD
	bool "EventFD"
	default n
	---help---
		Create a file descriptor for event notification

if EVENT_FD

config EVENT_FD_POLL
	bool "EventFD poll support"
	default y
	---help---
		Poll support for file descriptor based events

config EVENT_FD_NPOLLWAITERS
	int "Number of eventFD poll waiters"
	default 2
	depends on EVENT_FD_POLL
	---help---
		Maximum number of threads that can be waiting on poll()

endif # EVENT_FD

config TIMER_FD
	bool "TimerFD"
	default n
	---help---
		Create a file descriptor for timer notification

if TIMER_FD

config TIMER_FD_POLL
	bool "TimerFD poll support"
	default y
	---help---
		Poll support for file descriptor based timers

config TIMER_FD_NPOLLWAITERS
	int "Number of timerFD poll waiters"
	default 2
	depends on TIMER_FD_POLL
	---help---
		Maximum number of threads that can be waiting on poll()

endif # TIMER_FD

config SIGNAL_FD
	bool "SignalFD"
	default n
	---help---
		Create a file descriptor for accepting signals

if SIGNAL_FD

config SIGNAL_FD_NPOLLWAITERS
	int "Number of signalFD poll waiters"
	default 2
	---help---
		Maximum number of threads that can be waiting on poll()

endif # SIGNAL_FD
```

## fs/yaffs/Kconfig
```kconfig
#
# For a description of the syntax of this configuration file,
# see the file kconfig-language.txt in the NuttX tools repository.
#

config FS_YAFFS
	bool "YAFFS File System"
	default n
	depends on !DISABLE_MOUNTPOINT
	---help---
		Build the YAFFS file system. https://yaffs.net/documents/yaffs-direct-interface

if FS_YAFFS
config FS_YAFFS_RESERVED_BLOCKS
	int "YAFFS Reserved blocks"
	default 5
	---help---
		Number of good blocks blocks reserved for garbage collection etc.
		Needs to be at least 2, but 5 would be a more typical number.

config FS_YAFFS_CHUNK_CACHE
	int "YAFFS Chunk cache is used for short read/write operations"
	default 20
	---help---
		Number of chunks to store in the short operation cache.
		Zero disables caching. Typical value is 10 to 20 or so.
		Caching is required for inband tags.

config FS_YAFFS_REFRESH_PERIOD
	int "How often Yaffs should do a block refresh"
	default 1000
	---help---
		Values less than 10 disable block refreshing.

config FS_YAFFS_CACHE_BYPASS_ALIGNED
	bool "YAFFS Bypass the cache for aligned writes"
	default n
	---help---
		Flag to by pass the cache for aligned writes.

config FS_YAFFS_SKIP_READ_CHECKPOINT
	bool "YAFFS Skip reading checkpoint"
	default n
	---help---
		Flag to skip reading checkpoint on mount.
		If set then a re-scan is forced.

config FS_YAFFS_SKIP_WRITE_CHECKPOINT
	bool "YAFFS Skip writing checkpoint"
	default n
	---help---
		Flag to skip writing checkpoint on sync or unmount.

config FS_YAFFS_EMPTY_LOST_FOUND
	bool "YAFFS Auto-empty lost+found directory"
	default n
	---help---
		Flag to delete all files in lost and found on mount.
endif
```

## fs/zipfs/Kconfig
```kconfig
#
# For a description of the syntax of this configuration file,
# see the file kconfig-language.txt in the NuttX tools repository.
#

config FS_ZIPFS
	bool "ZIPFS File System"
	default n

if FS_ZIPFS

config ZIPFS_SEEK_BUFSIZE
	int "zipfs seek buffer size"
	default 256
	---help---
		this option will influences seek speed

endif # FS_ZIPFS
```
