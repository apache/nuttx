## graphics/vnc/Kconfig
```kconfig
#
# For a description of the syntax of this configuration file,
# see the file kconfig-language.txt in the NuttX tools repository.
#

source "graphics/vnc/server/Kconfig"
source "graphics/vnc/client/Kconfig"
```

## graphics/vnc/client/Kconfig
```kconfig
#
# For a description of the syntax of this configuration file,
# see the file kconfig-language.txt in the NuttX tools repository.
#

menuconfig VNCCLIENT
	bool "VNC client"
	default n
	depends on NET_TCP && !NX_LCDDRIVER && !VNC_SERVER && EXPERIMENTAL
	---help---
		Enable support for a VNC Remote Frame Buffer (RFB) client

if VNCCLIENT

endif # VNCCLIENT
```

## graphics/vnc/server/Kconfig
```kconfig
#
# For a description of the syntax of this configuration file,
# see the file kconfig-language.txt in the NuttX tools repository.
#

menuconfig VNCSERVER
	bool "VNC server"
	default n
	depends on NET_TCP && !NX_LCDDRIVER
	select NET_TCP_READAHEAD
	select NX_UPDATE
	---help---
		Enable support for a VNC Remote Frame Buffer (RFB) server.

if VNCSERVER

choice
	prompt "VNC server protocol"
	default VNCSERVER_PROTO3p8

config VNCSERVER_PROTO3p3
	bool "Version 3.3"
	depends on EXPERIMENTAL

config VNCSERVER_PROTO3p8
	bool "Version 3.8"

endchoice # VNC server protocol

config VNCSERVER_NDISPLAYS
	int "Number of displays"
	default 1
	range 1 99
	---help---
		Specifies the number of RFB displays supported by the server.
		Normally this should be one.

config VNCSERVER_NAME
	string "VNC display name"
	default "NuttX"

config VNCSERVER_PRIO
	int "VNC server task priority"
	default 100

config VNCSERVER_STACKSIZE
	int "VNC server stack size"
	default 2048

config VNCSERVER_UPDATER_PRIO
	int "VNC updater thread priority"
	default 100

config VNCSERVER_UPDATER_STACKSIZE
	int "VNC updater thread stack size"
	default 2048

choice
	prompt "VNC color format"
	default VNCSERVER_COLORFMT_RGB16

config VNCSERVER_COLORFMT_RGB8
	bool "RGB8 3:3:2"

config VNCSERVER_COLORFMT_RGB16
	bool "RGB16 5:6:5"

config VNCSERVER_COLORFMT_RGB32
	bool "RGB32 8:8:8"

endchoice # VNC color format

config VNCSERVER_SCREENWIDTH
	int "Framebuffer width (pixels)"
	default 320
	---help---
		This setting defines the width in pixels of the local framebuffer.

			Memory usage: PixelWidth * ScreenWidth * ScreenHeight

		So, for example, a 320x240 screen with RGB16 pixels would require
		2x320x240 = 150 KB of RAM.

config VNCSERVER_SCREENHEIGHT
	int "Framebuffer height (rows)"
	default 240
	---help---
		This setting defines the height in rows of the local framebuffer.

			Memory usage: PixelWidth * ScreenWidth * ScreenHeight

		So, for example, a 320x240 screen with RGB16 pixels would require
		2x320x240 = 150 KB of RAM.

config VNCSERVER_NUPDATES
	int "Number of pre-allocate update structures"
	default 48
	---help---
		This setting provides the number of pre-allocated update structures
		that will be used.  Dynamic memory allocations are never made.  In
		the likely event that we run out of update structures, the graphics
		subsystem will pause and wait for the next structures to be released.

		Overhead is 12-bytes per update structure.

config VNCSERVER_UPDATE_BUFSIZE
	int "Max update buffer size (bytes)"
	default 1024
	---help---
		A single buffer is pre-allocated for rendering updates.  This
		setting specifies the maximum in bytes of that update buffer.  For
		example, an update buffers of 32 pixels at 8-bits per pixel and
		32-rows would yield a buffer size of 1024!

		Ideally, this buffer should fit in one network packet to avoid
		accessive re-assembly of partial TCP packets.

config VNCSERVER_KBDENCODE
	bool "Encode keyboard input"
	default n
	depends on LIB_KBDCODEC
	---help---
		Use a special encoding of keyboard characters as defined in
		include/nuttx/input/kbd_coded.h.

config VNCSERVER_INBUFFER_SIZE
	int "Input buffer size"
	default 80

config VNCSERVER_DEBUG
	bool "VNC Server debug"
	default n
	depends on DEBUG_FEATURES && !DEBUG_GRAPHICS
	---help---
		Normally VNC debug output is selected with DEBUG_GRAPHICS.  The VNC
		server server support this special option to enable GRAPHICS debug
		output for the VNC server while GRAPHICS debug is disabled.  This
		provides an cleaner, less cluttered output when you only wish to
		debug the VNC server versus enabling DEBUG_GRAPHICS globally.

config VNCSERVER_UPDATE_DEBUG
	bool "Detailed updater debug"
	default n
	depends on DEBUG_GRAPHICS || VNCSERVER_DEBUG

endif # VNCSERVER
```

## libc/Kconfig
```kconfig
#
# For a description of the syntax of this configuration file,
# see the file kconfig-language.txt in the NuttX tools repository.
#

comment "Standard C Library Options"

source libc/stdio/Kconfig
source libc/math/Kconfig
source libc/machine/Kconfig
source libc/stdlib/Kconfig
source libc/unistd/Kconfig
source libc/string/Kconfig
source libc/dllfcn/Kconfig
source libc/modlib/Kconfig
source libc/wchar/Kconfig
source libc/locale/Kconfig
source libc/time/Kconfig
source libc/tls/Kconfig
source libc/net/Kconfig
source libc/netdb/Kconfig
source libc/misc/Kconfig
source libc/wqueue/Kconfig
source libc/hex2bin/Kconfig
```

## libc/dllfcn/Kconfig
```kconfig
#
# For a description of the syntax of this configuration file,
# see the file kconfig-language.txt in the NuttX tools repository.
#

# menu "Shared Library Support"

config LIBC_DLLFCN
	bool "Shared library support"
	default n
	select LIBC_ARCH_ELF
	select LIBC_MODLIB if !BUILD_KERNEL
	select MODULE if BUILD_FLAT
	depends on EXPERIMENTAL || !BUILD_KERNEL
	---help---
		Enabled support for user-space shared libraries.

		A work in progress, hence, marked EXPERIMENTAL

# endmenu # Shared Library Support
```

## libc/locale/Kconfig
```kconfig
#
# For a description of the syntax of this configuration file,
# see the file kconfig-language.txt in the NuttX tools repository.
#

#menu "Locale Support"

config LIBC_LOCALE
	bool "Enable I18N (LOCALE) support"
	default n
	---help---
		By default, i18n (locale) support is disabled.

#endmenu # Locale Support
```

## libc/lzf/Kconfig
```kconfig
#
# For a description of the syntax of this configuration file,
# see the file kconfig-language.txt in the NuttX tools repository.
#

config LIBC_LZF
	bool "LZF compression"
	default n
	---help---
		Enable the LZF compression library from Marc Alexander Lehmann

if LIBC_LZF

choice
	prompt "Compression options"
	default LIBC_LZF_SMALL
	---help---
		Trade-offs between faster and smaller compression.  These sections
		have no effect on decompression.

config LIBC_LZF_SMALL
	bool "Better compression"

config LIBC_LZF_FAST
	bool "Faster compression"

config LIBC_LZF_FASTEST
	bool "Fastest compression"

endchoice # Compression options

config LIBC_LZF_HLOG
	int "Log2 Hash table size"
	default 13
	range 1 22
	---help---
		Size of hashtable is (1 << HLOG) * sizeof (char *).  Decompression is
		independent of the hash table size the difference between 15 and 14 is
		very small for small blocks (and 14 is usually a bit faster).  For a
		low-memory/faster configuration, use HLOG == 13;  For best compression,
		use 15 or 16 (or more, up to 22).

		Memory usage for the hash table will be approximately:

			4 * (1 << CONFIG_LIBC_LZF_HLOG)

		For the default setting of 13, this is 32Kb.  A setting of 12 would
		be half that or about 16Kb.

		The application calling lzf_compress() must provide the hash table to
		the compressor and may allocate that memory in the most efficient way
		for the application.  The hash table is not necessary if your application
		only decompresses.

config LIBC_LZF_ALIGN
	bool "Strict alignment"
	default y
	---help---
		Unconditionally aligning does not cost very much, so do it if unsure.

endif # LIBC_LZF
```

## libc/machine/Kconfig
```kconfig
#
# For a description of the syntax of this configuration file,
# see the file kconfig-language.txt in the NuttX tools repository.
#

# These are library functions that may be overriden by architecture-
# specific implementations.  Not all architectures support implementations
# for every library function.

config LIBC_ARCH_MEMCPY
	bool
	default n

config LIBC_ARCH_MEMCMP
	bool
	default n

config LIBC_ARCH_MEMMOVE
	bool
	default n

config LIBC_ARCH_MEMSET
	bool
	default n

config LIBC_ARCH_STRCHR
	bool
	default n

config LIBC_ARCH_STRCMP
	bool
	default n

config LIBC_ARCH_STRCPY
	bool
	default n

config LIBC_ARCH_STRNCPY
	bool
	default n

config LIBC_ARCH_STRLEN
	bool
	default n

config LIBC_ARCH_STRNLEN
	bool
	default n

config LIBC_ARCH_BZERO
	bool
	default n

config LIBC_ARCH_ELF
	bool
	default n

config LIBM_ARCH_CEIL
	bool
	default n
	depends on LIBM && ARCH_CORTEXM33

config LIBM_ARCH_FLOOR
	bool
	default n
	depends on LIBM && ARCH_CORTEXM33

config LIBM_ARCH_NEARBYINT
	bool
	default n
	depends on LIBM && ARCH_CORTEXM33

config LIBM_ARCH_RINT
	bool
	default n
	depends on LIBM && ARCH_CORTEXM33

config LIBM_ARCH_ROUND
	bool
	default n
	depends on LIBM && ARCH_CORTEXM33

config LIBM_ARCH_TRUNC
	bool
	default n
	depends on LIBM && ARCH_CORTEXM33

config LIBM_ARCH_CEILF
	bool
	default n
	depends on LIBM && ARCH_CORTEXM33

config LIBM_ARCH_FLOORF
	bool
	default n
	depends on LIBM && ARCH_CORTEXM33

config LIBM_ARCH_NEARBYINTF
	bool
	default n
	depends on LIBM && ARCH_CORTEXM33

config LIBM_ARCH_RINTF
	bool
	default n
	depends on LIBM && ARCH_CORTEXM33

config LIBM_ARCH_ROUNDF
	bool
	default n
	depends on LIBM && ARCH_CORTEXM33

config LIBM_ARCH_TRUNCF
	bool
	default n
	depends on LIBM && ARCH_CORTEXM33

# One or more the of above may be selected by architecture specific logic

if ARCH_ARM
source libc/machine/arm/Kconfig
endif
```

## libc/machine/arm/armv7-a/Kconfig
```kconfig
#
# For a description of the syntax of this configuration file,
# see the file kconfig-language.txt in the NuttX tools repository.
#

config ARMV7A_MEMCPY
	bool "Enable optimized memcpy() for ARMv7-A"
	select LIBC_ARCH_MEMCPY
	depends on ARCH_TOOLCHAIN_GNU
	---help---
		Enable optimized ARMv7-A specific memcpy() library function
```

## libc/machine/armv7-a/Kconfig
```kconfig
#
# For a description of the syntax of this configuration file,
# see the file kconfig-language.txt in the NuttX tools repository.
#

config ARMV7A_MEMCPY
	bool "Enable optimized memcpy() for ARMv7-A"
	select LIBC_ARCH_MEMCPY
	depends on ARM_TOOLCHAIN_GNU && EXPERIMENTAL
	---help---
		Enable optimized ARMv7-A specific memcpy() library function

		Marked EXPERIMENTAL because it did not build for me the last time I
		tried.
```

## libc/net/Kconfig
```kconfig
#
# For a description of the syntax of this configuration file,
# see the file kconfig-language.txt in the NuttX tools repository.
#

menu "Network-Related Options"

config LIBC_IPv4_ADDRCONV
	bool "IPv4 address conversions"
	default n
	depends on !NET_IPv4

config LIBC_IPv6_ADDRCONV
	bool "IPv6 address conversions"
	default n
	depends on !NET_IPv6

endmenu # Network-Related Options
```

## libc/symtab/Kconfig
```kconfig
#
# For a description of the syntax of this configuration file,
# see the file kconfig-language.txt in the NuttX tools repository.
#

config LIBC_SYMTAB
	bool "Include canned symtab for applications and shell"
	default n
	depends on EXECFUNCS_HAVE_SYMTAB
	---help---
		Build and include default symbol table in the NuttX library.
		The symbol table is selected by call canned_symtab_initialize().
		The table libc/symtab/canned_symtab.inc has to be generated
		by mksymtab manually before this option is selected.
```

## libc/tls/Kconfig
```kconfig
#
# For a description of the syntax of this configuration file,
# see the file kconfig-language.txt in the NuttX tools repository.
#

config ARCH_HAVE_TLS
	bool
	default n
	---help---
		Selected by the configuration system if the current architecture
		supports TLS.

menu "Thread Local Storage (TLS)"
	depends on ARCH_HAVE_TLS

config TLS
	bool "Thread Local Storage (TLS)"
	default n
	---help---
		Build in support for stack based thread local storage (TLS).

if TLS

config TLS_LOG2_MAXSTACK
	int "Maximum stack size (log2)"
	default 13
	range 11 24
	---help---
		Stack based TLS works by fetch thread information from the beginning
		of the stack memory allocation.  In order to do this, the memory
		must be aligned in such a way that the executing logic can simply
		masking the current stack pointer to get the beginning of the stack
		allocation.

		This setting specifies the alignment of the stack as a power of 2:
		11=2KB, 12=4KB, 13=8KB, etc.  The exact alignment is not so critical
		except that (1) a very large value can cause you to run out of
		alignable memory (and fail memory allocations), and (2) smaller
		values will limit the maximum size of the stack (hence the naming
		of this configuration value).

config TLS_NELEM
	int "Number of TLS elements"
	default 1
	---help---
		The number of unique TLS elements.  These can be accessed with
		the user library functions tls_get_element() and tls_set_element().

endif # TLS
endmenu # Thread Local Storage (TLS)
```
