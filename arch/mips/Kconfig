## arch/mips/Kconfig
```kconfig
#
# For a description of the syntax of this configuration file,
# see the file kconfig-language.txt in the NuttX tools repository.
#

if ARCH_MIPS
choice
	prompt "MIPS chip selection"
	default ARCH_CHIP_PIC32MX

config ARCH_CHIP_PIC32MX
	bool "PIC32MX"
	select ARCH_MIPS32
	select ARCH_HAVE_EIC
	select ARCH_HAVE_IRQPRIO
	select ARCH_VECNOTIRQ
	select ARCH_HAVE_RAMFUNCS
	select ARCH_HAVE_SERIAL_TERMIOS
	---help---
		Microchip PIC32MX (MIPS32)

config ARCH_CHIP_PIC32MZ
	bool "PIC32MZ"
	select ARCH_MIPS32
	select ARCH_HAVE_EIC
	select ARCH_HAVE_IRQPRIO
	select ARCH_VECNOTIRQ
	select ARCH_HAVE_RAMFUNCS
	select ARCH_HAVE_SERIAL_TERMIOS
	---help---
		Microchip PIC32MZ (MIPS32)

config ARCH_CHIP_MIPS_CUSTOM
	bool "Custom MIPS chip"
	select ARCH_CHIP_CUSTOM
	---help---
		Select this option if there is no directory for the chip under arch/mips/src/.

endchoice

config ARCH_MIPS32
	bool
	default n
	select ARCH_HAVE_VFORK

config ARCH_MIPS_M4K
	bool
	default n

config ARCH_MIPS_MICROAPTIV
	bool
	default n
	select ARCH_HAVE_MICROMIPS

config ARCH_MIPS_M5150
	bool
	default n
	select ARCH_HAVE_MICROMIPS

config ARCH_HAVE_EIC
  bool
  default n

config ARCH_HAVE_MICROMIPS
	bool
	default n

config MIPS_MICROMIPS
	bool "Use microMIPS ISA"
	default n
	depends on ARCH_HAVE_MICROMIPS
	---help---
		The processor supports both the MIPS32 ISA and the microMIPS ISA.
		If this option is selected, the microMIPS ISA will be used.
		Otherwise, the MIPS32 ISA will be used.

config ARCH_FAMILY
	string
	default "mips32"	if ARCH_MIPS32

config ARCH_CHIP
	string
	default "pic32mx"	if ARCH_CHIP_PIC32MX
	default "pic32mz"	if ARCH_CHIP_PIC32MZ

source "arch/mips/src/common/Kconfig"
source "arch/mips/src/mips32/Kconfig"
source "arch/mips/src/pic32mx/Kconfig"
source "arch/mips/src/pic32mz/Kconfig"

endif
```

## arch/mips/src/jz4780/Kconfig
```kconfig
#
# For a description of the syntax of this configuration file,
# see the file kconfig-language.txt in the NuttX tools repository.
#

if ARCH_CHIP_JZ4780
comment "JZ4780 Configuration Options"

menu "JZ4780 Peripheral Support"
config JZ4780_LCD
	bool "LCD controller"
	default n

config JZ4780_OHCI
	bool "Full/low speed OHCI support"
	default n
	select SCHED_HPWORK
	select USBHOST
	select USBHOST_HAVE_ASYNCH
	select USBHOST_ASYNCH
	select USBHOST_WAITER
	---help---
		Build support for the JZ4780 USB full speed Open Host Controller
		Interface (OHCI).


if JZ4780_OHCI
config JZ4780_OHCI_NEDS
	int "Number of endpoint descriptors"
	default 6

config JZ4780_OHCI_NTDS
	int "Number of transfer descriptors"
	default 9

config JZ4780_OHCI_TDBUFFERS
	int "Number of transfer descriptor buffers"
	default 6

config JZ4780_OHCI_TDBUFSIZE
	int "Size of one transfer descriptor buffer"
	default 128
	---help---
		The size of one transfer descriptor (TD) buffer in bytes.  The TD
		buffer size must be an even number of 32-bit words

config JZ4780_OHCI_REGDEBUG
	bool "Enable low-level OHCI register debug"
	default n
	depends on DEBUG_USB_INFO

endif # JZ4780_OHCI

config JZ4780_EHCI
	bool "High speed EHCI support"
	default n
	select USBHOST
	select USBHOST_HAVE_ASYNCH
	select USBHOST_WAITER
	---help---
		Build support for the JZ4780 USB high speed Enhanced Host Controller
		Interface (EHCI).  If low/full speed is needed too, then you must
		also enable the OHCI controller.

if JZ4780_EHCI

config JZ4780_EHCI_NQHS
	int "Number of Queue Head (QH) structures"
	default 8
	---help---
		Configurable number of Queue Head (QH) structures.  The default is
		one per Root hub port plus one for EP0 (4).

config JZ4780_EHCI_NQTDS
	int "Number of Queue Element Transfer Descriptor (qTDs)"
	default 10
	---help---
		Configurable number of Queue Element Transfer Descriptor (qTDs).
		The default is one per root hub plus three from EP0 (6).

config JZ4780_EHCI_BUFSIZE
	int "Size of one request/descriptor buffer"
	default 1024
	---help---
		The size of one request/descriptor buffer in bytes.  The TD buffe
		size must be an even number of 32-bit words and must be large enough
		to hangle the largest transfer via a SETUP request.

config JZ4780_EHCI_PREALLOCATE
	bool "Preallocate descriptor pool"
	default y
	---help---
		Select this option to pre-allocate EHCI queue and descriptor
		structure pools in .bss.  Otherwise, these pools will be
		dynamically allocated using kmm_memalign().

config JZ4780_EHCI_REGDEBUG
	bool "Enable low-level EHCI register debug"
	default n
	depends on DEBUG_USB_INFO

endif # JZ4780_EHCI
endmenu # JZ4780 Peripheral Support

endif
```

## arch/mips/src/mips32/Kconfig
```kconfig
#
# For a description of the syntax of this configuration file,
# see the file kconfig-language.txt in the NuttX tools repository.
#

if ARCH_MIPS32
comment "MIPS32 Configuration Options"

choice
	prompt "Toolchain Selection"
	default MIPS32_TOOLCHAIN_MICROCHIPW_LITE if TOOLCHAIN_WINDOWS
	default MIPS32_TOOLCHAIN_GNU_ELF if !TOOLCHAIN_WINDOWS

config MIPS32_TOOLCHAIN_GNU_ELF
	bool "Generic GNU ELF toolchain"
	select ARCH_TOOLCHAIN_GNU
	---help---
		This option should work for any modern GNU toolchain (GCC 4.5 or newer)
		configured for mips32-elf.

config MIPS32_TOOLCHAIN_MICROCHIPL_XC32
	bool "Microchip XC32 toolchain under Linux"
	depends on HOST_LINUX
	select ARCH_TOOLCHAIN_GNU

config MIPS32_TOOLCHAIN_MICROCHIPL
	bool "Microchip C32 toolchain under Linux"
	depends on HOST_LINUX
	select ARCH_TOOLCHAIN_GNU

config MIPS32_TOOLCHAIN_MICROCHIPL_LITE
	bool "Microchip C32 toolchain under Linux (Lite edition)"
	depends on HOST_LINUX
	select ARCH_TOOLCHAIN_GNU

config MIPS32_TOOLCHAIN_MICROCHIPW_XC32
	bool "Microchip XC32 toolchain under Windows"
	depends on TOOLCHAIN_WINDOWS
	select CYGWIN_WINTOOL if WINDOWS_CYGWIN
	select ARCH_TOOLCHAIN_GNU

config MIPS32_TOOLCHAIN_MICROCHIPW
	bool "Microchip C32 toolchain under Windows"
	depends on TOOLCHAIN_WINDOWS
	select CYGWIN_WINTOOL if WINDOWS_CYGWIN
	select ARCH_TOOLCHAIN_GNU

config MIPS32_TOOLCHAIN_MICROCHIPW_LITE
	bool "Microchip C32 toolchain under Windows (Lite edition)"
	depends on TOOLCHAIN_WINDOWS
	select CYGWIN_WINTOOL if WINDOWS_CYGWIN
	select ARCH_TOOLCHAIN_GNU

config MIPS32_TOOLCHAIN_MICROCHIPOPENL
	bool "microchipOpen toolchain under Linux"
	depends on HOST_LINUX
	select ARCH_TOOLCHAIN_GNU

config MIPS32_TOOLCHAIN_PINGUINOW
	bool "Pinguino mips-elf toolchain under Windows"
	depends on TOOLCHAIN_WINDOWS
	select CYGWIN_WINTOOL if WINDOWS_CYGWIN
	select ARCH_TOOLCHAIN_GNU

config MIPS32_TOOLCHAIN_PINGUINOL
	bool "Pinguino mips-elf toolchain under macOS or Linux"
	depends on HOST_LINUX || HOST_MACOS
	select ARCH_TOOLCHAIN_GNU

config MIPS32_TOOLCHAIN_SOURCERY_CODEBENCH_LITE
	bool "Sourcery CodeBench Lite for MIPS ELF toolchain under Linux"
	depends on HOST_LINUX
	select ARCH_TOOLCHAIN_GNU

endchoice

config MIPS32_TOOLCHAIN_MICROCHIP_XC32_LICENSED
	bool "Licensed Microchip XC32 toolchain"
	default n
	depends on MIPS32_TOOLCHAIN_MICROCHIPL_XC32 || MIPS32_TOOLCHAIN_MICROCHIPW_XC32
	---help---
		The free, unlicensed XC32 compiler will not support either
		optimization or the microMIPs ISA.  If you are using a licensed,
		XC32 compiler then select this option so that the build system will
		support higher levels of optimization.

config MIPS32_FRAMEPOINTER
	bool "ABI Uses Frame Pointer"
	default n
	depends on ARCH_HAVE_VFORK
	---help---
		Register r30 may be a frame pointer in some ABIs.  Or may just be
		saved register s8.  It makes a difference for vfork handling.

config MIPS32_HAVE_ICACHE
	bool
	default n

config MIPS32_HAVE_DCACHE
	bool
	default n

config MIPS32_ICACHE
	bool "Use I-Cache"
	default n
	depends on MIPS32_HAVE_ICACHE
	select ARCH_ICACHE
	---help---
		Enable K0 I-Cache

config MIPS32_ICACHE_SIZE
	int "I-Cache Size"
	default 16384
	depends on MIPS32_ICACHE && !MIPS32_CACHE_AUTOINFO
	---help---
		Instruction cache size in bytes.

config MIPS32_ILINE_SIZE
	int "I-Cache Line Size"
	default 16
	depends on MIPS32_ICACHE && !MIPS32_CACHE_AUTOINFO
	---help---
		Instruction cache line size.

config MIPS32_KSEG0_IBASE
	hex "Instruction base address"
	default 0x9d000000
	depends on MIPS32_ICACHE
	---help---
		Instruction base address in KSEG0

config MIPS32_DCACHE
	bool "Use D-Cache"
	default n
	depends on MIPS32_HAVE_DCACHE
	select ARCH_DCACHE
	---help---
		Enable K0 D-Cache

config MIPS32_DCACHE_SIZE
	int "D-Cache Size"
	default 4096
	depends on MIPS32_DCACHE && !MIPS32_CACHE_AUTOINFO
	---help---
		Data cache size in bytes.

config MIPS32_DLINE_SIZE
	int "D-Cache Line Size"
	default 16
	depends on MIPS32_DCACHE && !MIPS32_CACHE_AUTOINFO
	---help---
		Data cache line size.

config MIPS32_KSEG0_DBASE
	hex "Data base address"
	default 0x80000000
	depends on MIPS32_DCACHE
	---help---
		Data base address in KSEG0

config MIPS32_CACHE_AUTOINFO
	bool "Auto detect cache size"
	depends on MIPS32_ICACHE || MIPS32_DCACHE
	default n

endif
```
