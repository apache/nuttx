## arch/risc-v/src/bl602/Kconfig
```kconfig
#
# For a description of the syntax of this configuration file,
# see the file kconfig-language.txt in the NuttX tools repository.
#

comment "BL602 Configuration Options"

menu "BL602 Peripheral Support"

config BL602_DMA
	bool "DMA"
	default n
	select ARCH_DMA

config BL602_HAVE_UART0
	bool "UART0"
	select BL602_UART0
	select ARCH_HAVE_UART0
	select UART0_SERIALDRIVER
	select ARCH_HAVE_SERIAL_TERMIOS
	select ARCH_HAVE_PWM_MULTICHAN

config BL602_UART0
	bool
	default n

config BL602_HAVE_UART1
	bool "UART1"
	select BL602_UART1
	select ARCH_HAVE_UART1
	select UART1_SERIALDRIVER
	select ARCH_HAVE_SERIAL_TERMIOS

config BL602_UART1
	bool
	default n

config BL602_TIMER0
	bool "TIMER0"

config BL602_TIMER1
	bool "TIMER1"

config BL602_PWM0
	bool "PWM0"

config BL602_I2C0
	bool "I2C0"

config BL602_I2C_DMA
	bool "I2C DMA support"
	default n
	depends on BL602_DMA
	---help---
		Select to enable DMA SPI transfers

config BL602_SPI0
	bool "SPI0"

config BL602_SPI_DMA
	bool "SPI DMA support"
	default n
	depends on BL602_DMA
	---help---
		Select to enable DMA SPI transfers

config BL602_RTC
	bool "RTC"

config BL602_RTC_USE_XTAL32K
	bool "Select enable RTC XTAL32K clock source, otherwise use internal RC32K"
	default n
	depends on BL602_RTC

config BL602_SPIFLASH
	bool "SPI Flash"
	default n
	select MTD
	select MTD_PARTITION

menu "SPI Flash configuration"
	depends on BL602_SPIFLASH

config BL602_MTD_OFFSET
	hex "MTD base address in SPI Flash"
	default 0x001c5000
	---help---
		MTD base address in SPI Flash.

config BL602_MTD_SIZE
	hex "MTD size in SPI Flash"
	default 0x30000
	---help---
		MTD size in SPI Flash.

endmenu # BL602_SPIFLASH

config BL602_WIRELESS
	bool "Wireless & WiFi Support"
	depends on SCHED_WORKQUEUE
	default n

config BL602_WIRELESS_DEBUG
	bool "Wireless Debug Log"
	depends on BL602_WIRELESS
	default n

config BL602_WIRELESS_CONTRY_CODE
	string "WiFi Contry Code"
	depends on BL602_WIRELESS
	default "CN"

config BL602_NET_MULTI_INTERFACE
	bool "STA and AP as independent interfaces"
	depends on BL602_WIRELESS
	default n

config BL602_BLE_CONTROLLER
	bool "ble controller support"
	default n
	depends on !DISABLE_MQUEUE
	depends on SCHED_WORKQUEUE
	depends on BL602_WIRELESS
endmenu
```

## arch/risc-v/src/bl60x/Kconfig
```kconfig
#
# For a description of the syntax of this configuration file,
# see the file kconfig-language.txt in the NuttX tools repository.
#

comment "BL60x Configuration Options"

menu "BL60x Peripheral Support"

# These "hidden" settings determine whether a peripheral option is available
# for the selected MCU

config BL_HAVE_UART0
	bool
	default y
	select BL_SERIALDRIVER
	select ARCH_HAVE_SERIAL_TERMIOS

# These are the peripheral selections proper

config BL_UART0
	bool "UART0"
	default y
	select ARCH_HAVE_UART0
	select ARCH_HAVE_SERIAL_TERMIOS
	select BL_UART

endmenu
```

## arch/risc-v/src/bl808/Kconfig
```kconfig
#
# For a description of the syntax of this configuration file,
# see the file kconfig-language.txt in the NuttX tools repository.
#

comment "BL808 Configuration Options"

menu "BL808 Peripheral Support"

config BL808_GPADC
	bool "GPADC"
	default n

menu "BL808 GPADC Options"
	depends on BL808_GPADC

choice BL808_GPADC_RES
	prompt "GPADC Resolution"
	default BL808_GPADC_RES_12
	depends on BL808_GPADC

config BL808_GPADC_RES_12
	bool "12 bits"

config BL808_GPADC_RES_14
	bool "14 bits"

config BL808_GPADC_RES_16
	bool "16 bits"

endchoice

config BL808_GPADC_NCHANNELS
	int "Number of channels"
	default 12
	range 1 12

comment "Channel scanning order - set the channel number for each scanning position"
comment "Only positions smaller than the number of channels will be used."
comment "Channel codes:"
comment "0-11: External channels"
comment "12 or 13: DAC output A or B"
comment "16: VREF"
comment "18: VBAT\/2"
comment "23: GND"

config BL808_GPADC_SCAN_ORD0
	int "Position 0"
	default 0
	range 0 23

config BL808_GPADC_SCAN_ORD1
	int "Position 1"
	default 1
	range 0 23

config BL808_GPADC_SCAN_ORD2
	int "Position 2"
	default 2
	range 0 23

config BL808_GPADC_SCAN_ORD3
	int "Position 3"
	default 3
	range 0 23

config BL808_GPADC_SCAN_ORD4
	int "Position 4"
	default 4
	range 0 23

config BL808_GPADC_SCAN_ORD5
	int "Position 5"
	default 5
	range 0 23

config BL808_GPADC_SCAN_ORD6
	int "Position 6"
	default 6
	range 0 23

config BL808_GPADC_SCAN_ORD7
	int "Position 7"
	default 7
	range 0 23

config BL808_GPADC_SCAN_ORD8
	int "Position 8"
	default 8
	range 0 23

config BL808_GPADC_SCAN_ORD9
	int "Position 9"
	default 9
	range 0 23

config BL808_GPADC_SCAN_ORD10
	int "Position 10"
	default 10
	range 0 23

config BL808_GPADC_SCAN_ORD11
	int "Position 11"
	default 11
	range 0 23

endmenu

menuconfig BL808_I2C0
	bool "I2C 0"
	default n
	select I2C
	select I2C_DRIVER
	select ARCH_HAVE_I2CRESET

if BL808_I2C0

comment "Refer to datasheet for valid pin assignments"

config BL808_I2C0_SCL
	int "SCL Pin"
	default 6
	range 0 45

config BL808_I2C0_SDA
	int "SDA Pin"
	default 7
	range 0 45

endif

menuconfig BL808_I2C1
	bool "I2C 1"
	default n
	select I2C
	select I2C_DRIVER
	select ARCH_HAVE_I2CRESET

if BL808_I2C1

comment "Refer to datasheet for valid pin assignments"

config BL808_I2C1_SCL
	int "SCL Pin"
	default 6
	range 0 45

config BL808_I2C1_SDA
	int "SDA Pin"
	default 7
	range 0 45

endif

menuconfig BL808_I2C2
	bool "I2C 2"
	default n
	select I2C
	select I2C_DRIVER
	select ARCH_HAVE_I2CRESET

if BL808_I2C2

comment "Refer to datasheet for valid pin assignments"

config BL808_I2C2_SCL
	int "SCL Pin"
	default 6
	range 0 45

config BL808_I2C2_SDA
	int "SDA Pin"
	default 7
	range 0 45

endif

menuconfig BL808_I2C3
	bool "I2C 3"
	default n
	select I2C
	select I2C_DRIVER
	select ARCH_HAVE_I2CRESET

if BL808_I2C3

comment "Refer to datasheet for valid pin assignments"

config BL808_I2C3_SCL
	int "SCL Pin"
	default 6
	range 0 45

config BL808_I2C3_SDA
	int "SDA Pin"
	default 7
	range 0 45

endif

config BL808_UART0
	bool "UART 0"
	default n
	select UART0_SERIALDRIVER
	select ARCH_HAVE_SERIAL_TERMIOS

config BL808_UART1
	bool "UART 1"
	default n
	select UART1_SERIALDRIVER
	select ARCH_HAVE_SERIAL_TERMIOS

config BL808_UART2
	bool "UART 2"
	default n
	select UART2_SERIALDRIVER
	select ARCH_HAVE_SERIAL_TERMIOS

config BL808_UART3
	bool "UART 3"
	default n
	select UART3_SERIALDRIVER
	select ARCH_HAVE_SERIAL_TERMIOS

menuconfig BL808_SPI0
	bool "SPI 0"
	default n
	select SPI

if BL808_SPI0

config BL808_SPI0_DEG_ENABLE
	bool "Deglitch enable"
	default y

config BL808_SPI0_CONT_ENABLE
	bool "Continuous transfer mode"
	default y

config BL808_SPI0_BYTE_INV
	bool "Invert byte transfer order"
	default n

config BL808_SPI0_BIT_INV
	bool "Invert bit transfer order"
	default n

comment "Refer to datasheet for valid pin assignments"

config BL808_SPI0_MISO
	int "MISO Pin"
	default 14
	range 0 45

config BL808_SPI0_MOSI
	int "MOSI Pin"
	default 13
	range 0 45

config BL808_SPI0_SCLK
	int "SCLK Pin"
	default 15
	range 0 45

config BL808_SPI0_SS
	int "SS Pin"
	default 12
	range 0 45

endif

menuconfig BL808_SPI1
	bool "SPI 1"
	default n
	select SPI

if BL808_SPI1

config BL808_SPI1_DEG_ENABLE
	bool "Deglitch enable"
	default y

config BL808_SPI1_CONT_ENABLE
	bool "Continuous transfer mode"
	default y

config BL808_SPI1_BYTE_INV
	bool "Invert byte transfer order"
	default n

config BL808_SPI1_BIT_INV
	bool "Invert bit transfer order"
	default n

comment "Refer to datasheet for valid pin assignments"

config BL808_SPI1_MISO
	int "MISO Pin"
	default 14
	range 0 45

config BL808_SPI1_MOSI
	int "MOSI Pin"
	default 13
	range 0 45

config BL808_SPI1_SCLK
	int "SCLK Pin"
	default 15
	range 0 45

config BL808_SPI1_SS
	int "SS Pin"
	default 12
	range 0 45

endif

config BL808_TIMERS
	bool "Timers"
	default n
	select TIMER

config BL808_WDT
	bool "Watchdog Timers"
	default n
	select WATCHDOG

endmenu
```

## arch/risc-v/src/c906/Kconfig
```kconfig
#
# For a description of the syntax of this configuration file,
# see the file kconfig-language.txt in the NuttX tools repository.
#

comment "C906 Configuration Options"

config C906_ENABLE_DPFPU
	bool "C906 DP_FPU Support"
	default n
	select ARCH_HAVE_FPU
	select ARCH_HAVE_DPFPU
	---help---
		Enable the RISC-V Double-Precision Floating Point Unit (DP-FPU).

menu "C906 Peripheral Support"

# These "hidden" settings determine whether a peripheral option is available
# for the selected MCU

config C906_HAVE_UART0
	bool
	default y
	select UART0_SERIALDRIVER
	select ARCH_HAVE_SERIAL_TERMIOS

# These are the peripheral selections proper

config C906_UART0
	bool "UART0"
	default y
	select ARCH_HAVE_UART0
	select ARCH_HAVE_SERIAL_TERMIOS
	select C906_UART

endmenu

menu "C906 Others"

config C906_WITH_QEMU
	bool "qemu support"
	default n

endmenu
```

## arch/risc-v/src/ch32v/Kconfig
```kconfig
#
# For a description of the syntax of this configuration file,
# see the file kconfig-language.txt in the NuttX tools repository.
#

comment "CH32V Configuration Options"

menu "CH32V Peripheral Support"
endmenu
```

## arch/risc-v/src/common/Kconfig
```kconfig
#
# For a description of the syntax of this configuration file,
# see the file kconfig-language.txt in the NuttX tools repository.
#

comment "RISC-V Common Options"

choice
	prompt "Toolchain Selection"
	default RISCV_TOOLCHAIN_GNU_RVGW if TOOLCHAIN_WINDOWS
	default RISCV_TOOLCHAIN_GNU_RVGL if !TOOLCHAIN_WINDOWS

config RISCV_TOOLCHAIN_GNU_RVGL
	bool "Generic GNU RVG toolchain under Linux (or other POSIX environment)"
	select ARCH_TOOLCHAIN_GNU
	---help---
		This option should work for any modern GNU toolchain (GCC 5.2 or newer)
		configured for riscv64-unknown-elf.

config RISCV_TOOLCHAIN_GNU_RVGW
	bool "Generic GNU RVG toolchain under Windows"
	depends on TOOLCHAIN_WINDOWS
	select CYGWIN_WINTOOL if WINDOWS_CYGWIN
	select ARCH_TOOLCHAIN_GNU
	---help---
		This option should work for any modern GNU toolchain (GCC 5.2 or newer)
		configured for riscv64-unknown-elf.

endchoice
```

## arch/risc-v/src/esp32c3/Kconfig
```kconfig
#
# For a description of the syntax of this configuration file,
# see the file kconfig-language.txt in the NuttX tools repository.
#

if ARCH_CHIP_ESP32C3_GENERIC

source "arch/risc-v/src/common/espressif/Kconfig"

endif # ARCH_CHIP_ESP32C3_GENERIC
```
