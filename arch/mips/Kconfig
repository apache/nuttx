## arch/renesas/src/sh1/Kconfig
```kconfig
#
# For a description of the syntax of this configuration file,
# see the file kconfig-language.txt in the NuttX tools repository.
#

if ARCH_SH1
comment "SH-1 Configuration Options"

menu "SH-1 Peripheral Selections"

config SH1_DMAC0
	bool "DMAC0"
	default n

config SH1_DMAC1
	bool "DMAC1"
	default n

config SH1_DMAC2
	bool "DMAC2"
	default n

config SH1_DMAC3
	bool "DMAC3"
	default n

config SH1_ITU1
	bool "ITU2"
	default n

config SH1_ITU2
	bool "ITU2"
	default n

config SH1_ITU3
	bool "ITU3"
	default n

config SH1_ITU4
	bool "ITU4"
	default n

config SH1_SCI0
	bool "SCI0"
	default n
	select SCI0_SERIALDRIVER

config SH1_SCI1
	bool "SCI1"
	default n
	select SCI1_SERIALDRIVER

config SH1_PCU
	bool "PCU"
	default n

config SH1_AD
	bool "AD"
	default n

config SH1_WDT
	bool "WDT"
	default n

config SH1_CMI
	bool "CMI"
	default n

endmenu # SH-1 Peripheral Selections
endif
```

## arch/rgmp/Kconfig
```kconfig
#
# For a description of the syntax of this configuration file,
# see the file kconfig-language.txt in the NuttX tools repository.
#

if ARCH_RGMP
comment "RGMP Configuration Options"

choice
	prompt "RGMP Architecture"
	default RGMP_SUBARCH_X86

config RGMP_SUBARCH_ARM
	bool "ARM"
	---help---
		RGMP ARM architecture"

config RGMP_SUBARCH_X86
	bool "x86"
	---help---
		RGMP x86 architecture"

endchoice # RGMP Architecture

config RGMP_SUBARCH
	string
	default "arm"		if RGMP_SUBARCH_ARM
	default "x86"		if RGMP_SUBARCH_X86

menu "x86 Peripheral Selections"
	depends on RGMP_SUBARCH_X86

config COM1
	bool "COM1"

config COM2
	bool "COM1"

config COM3
	bool "COM1"

config COM4
	bool "COM1"

endmenu # x86 Peripheral Selections
endif # ARCH_RGMP
```
