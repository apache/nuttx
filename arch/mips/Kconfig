## arch/misoc/Kconfig
```kconfig
#
# For a description of the syntax of this configuration file,
# see the file kconfig-language.txt in the NuttX tools repository.
#

if ARCH_MISOC

choice
	prompt "Misoc Chip Selection"
	default ARCH_CHIP_LM32

config ARCH_CHIP_LM32
	bool "LM32"
	select MISOC_HAVE_UART1
	---help---
		LM32 Chip Selected

config ARCH_CHIP_MINERVA
	bool "MINERVA"
	select MISOC_HAVE_UART1
	---help---
		LambdaConcept MINERVAL Chip Selected

config ARCH_CHIP_MISOC_CUSTOM
	bool "Custom MISOC chip"
	select ARCH_CHIP_CUSTOM
	---help---
		Select this option if there is no directory for the chip under arch/misoc/src/.

endchoice # Misoc Chip Selection

config ARCH_CHIP
	string
	default "lm32"		if ARCH_CHIP_LM32
	default "minerva"	if ARCH_CHIP_MINERVA

menu "MISOC Peripheral Support"

# These "hidden" settings determine whether a peripheral option is available
# for the selected MCU

config MISOC_HAVE_UART1
	bool
	default n
	select UART1_SERIALDRIVER

config MISOC_UART1
	bool "UART1"
	default n
	select ARCH_HAVE_UART1
	select MISOC_UART

config MISOC_ETHERNET
	bool "Ethernet"
	default n
	select NETDEVICES
	select ARCH_HAVE_PHY
	select ARCH_HAVE_NETDEV_STATISTICS

endmenu # MISOC Peripheral Support

config MISOC_UART
	bool

config MISOC_UART_RX_BUF_SIZE
	int "UART RX Buffer size"
	default 64
	depends on MISOC_UART
	---help---
		Size of RX buffers for MISOC UARTs

config MISOC_UART_TX_BUF_SIZE
	int "UART TX Buffer size"
	default 64
	depends on MISOC_UART
	---help---
		Size of TX buffers for MISOC UARTs

if ARCH_CHIP_LM32
source arch/misoc/src/lm32/Kconfig
endif
if ARCH_CHIP_MINERVA
source arch/misoc/src/minerva/Kconfig
endif

endif # ARCH_MISOC
```

## arch/misoc/src/lm32/Kconfig
```kconfig
#
# For a description of the syntax of this configuration file,
# see the file kconfig-language.txt in the NuttX tools repository.
#

if ARCH_CHIP_LM32

choice
	prompt "Toolchain Selection"
	default LM32_TOOLCHAIN_GNU

config LM32_TOOLCHAIN_BUILDROOT
	bool "Buildroot (Cygwin or Linux)"
	depends on !WINDOWS_NATIVE
	select ARCH_TOOLCHAIN_GNU

config LM32_TOOLCHAIN_GNU
	bool "Generic GNU toolchain"
	select ARCH_TOOLCHAIN_GNU
	---help---
		This option should work for any modern GNU toolchain (GCC 4.5 or newer)
		configured for lm32-elf-.

endchoice # Toolchain Selection

endif # ARCH_CHIP_LM32
```

## arch/misoc/src/minerva/Kconfig
```kconfig
#
# For a description of the syntax of this configuration file,
# see the file kconfig-language.txt in the NuttX tools repository.
#

if ARCH_CHIP_MINERVA

choice
	prompt "Toolchain Selection"
	default MINERVA_TOOLCHAIN_GNU

config MINERVA_TOOLCHAIN_BUILDROOT
	bool "Buildroot (Cygwin or Linux)"
	depends on !WINDOWS_NATIVE
	select ARCH_TOOLCHAIN_GNU

config MINERVA_TOOLCHAIN_GNU
	bool "Generic GNU toolchain"
	select ARCH_TOOLCHAIN_GNU
	---help---
		This option should work for any modern GNU toolchain (GCC 4.5 or newer)
		configured for risc64-elf-.

endchoice # Toolchain Selection

endif # ARCH_CHIP_MINERVA
```

## arch/or1k/Kconfig
```kconfig
#
# For a description of the syntax of this configuration file,
# see the file kconfig-language.txt in the NuttX tools repository.
#

if ARCH_OR1K
comment "OpenRISC Options"

choice
	prompt "OpenRISC chip selection"
	default ARCH_CHIP_MOR1KX

config ARCH_CHIP_MOR1KX
	bool "mor1kx"

config ARCH_CHIP_OR1K_CUSTOM
	bool "Custom OpenRISC chip"
	select ARCH_CHIP_CUSTOM
	---help---
		Select this option if there is no directory for the chip under arch/or1k/src/.

endchoice

config ARCH_CHIP
	string
	default "mor1kx"	if ARCH_CHIP_MOR1KX

source arch/or1k/src/mor1kx/Kconfig

endif # ARCH_OR1K
```

## arch/or1k/src/mor1kx/Kconfig
```kconfig
#
# For a description of the syntax of this configuration file,
# see the file kconfig-language.txt in the NuttX tools repository.
#

comment "OpenRISC Configuration Options"

choice
	prompt "Toolchain Selection"
	default OR1K_TOOLCHAIN_GNU_ELF

config OR1K_TOOLCHAIN_GNU_ELF
	bool "OpenRISC GNU ELF toolchain under Linux (or other POSIX environment)"
	---help---
		OpenRISC GNU toolchain.

endchoice

menu "OpenRISC Options"

config OR1K_CPU_FREQUENCY
	int "CPU Clock Frequency"
	default 50000000

config OR1K_ICACHE
	bool "Enable Instruction Cache"
	default n

config OR1K_DCACHE
	bool "Enable Data Cache"
	default n

config OR1K_FPU
	bool "Enable Floating Point Unit"
	default n

config OR1K_MMU
	bool "Enable MMU"
	default n

endmenu # OpenRISC Options
```

## arch/pjrc-8051/defconfig
```kconfig
############################################################
# defconfig
#
#   Copyright (C) 2007 Gregory Nutt. All rights reserved.
#   Author: Gregory Nutt <spudmonkey@racsa.co.cr>
#
# Redistribution and use in source and binary forms, with or without
# modification, are permitted provided that the following conditions
# are met:
#
# 1. Redistributions of source code must retain the above copyright
#    notice, this list of conditions and the following disclaimer.
# 2. Redistributions in binary form must reproduce the above copyright
#    notice, this list of conditions and the following disclaimer in
#    the documentation and/or other materials provided with the
#    distribution.
# 3. Neither the name Gregory Nutt nor the names of its contributors may be
#    used to endorse or promote products derived from this software
#    without specific prior written permission.
#
# THIS SOFTWARE IS PROVIDED BY THE COPYRIGHT HOLDERS AND CONTRIBUTORS
# "AS IS" AND ANY EXPRESS OR IMPLIED WARRANTIES, INCLUDING, BUT NOT
# LIMITED TO, THE IMPLIED WARRANTIES OF MERCHANTABILITY AND FITNESS
# FOR A PARTICULAR PURPOSE ARE DISCLAIMED. IN NO EVENT SHALL THE
# COPYRIGHT OWNER OR CONTRIBUTORS BE LIABLE FOR ANY DIRECT, INDIRECT,
# INCIDENTAL, SPECIAL, EXEMPLARY, OR CONSEQUENTIAL DAMAGES (INCLUDING,
# BUT NOT LIMITED TO, PROCUREMENT OF SUBSTITUTE GOODS OR SERVICES; LOSS
# OF USE, DATA, OR PROFITS; OR BUSINESS INTERRUPTION) HOWEVER CAUSED
# AND ON ANY THEORY OF LIABILITY, WHETHER IN CONTRACT, STRICT
# LIABILITY, OR TORT (INCLUDING NEGLIGENCE OR OTHERWISE) ARISING IN
# ANY WAY OUT OF THE USE OF THIS SOFTWARE, EVEN IF ADVISED OF THE
# POSSIBILITY OF SUCH DAMAGE.
#
############################################################
#
# architecture selection
#
# CONFIG_ARCH - identifies the arch subdirectory
# CONFIG_ARCH_name - for use in C code
#
CONFIG_ARCH=pjrc-8051
CONFIG_ARCH_8051=y

#
# General OS setup
#
# CONFIG_EXAMPLE - identifies the subdirectory in examples
#   that will be used in the build
# CONFIG_DEBUG - enables built-in debug options
# CONFIG_DEBUG_VERBOSE - enables verbose debug output
# CONFIG_MM_REGIONS - If the architecture includes multiple
#   regions of memory to allocate from, this specifies the
#   number of memory regions that the memory manager must
#   handle and enables the API mm_addregion(start, end);
# CONFIG_HAVE_LOWPUTC - architecture supports low-level, boot
#   time console output
# CONFIG_RR_INTERVAL - The round robin timeslice will be set
#   this number of milliseconds;  Round robin scheduling can
#   be disabled by setting this value to zero.
# CONFIG_SCHED_INSTRUMENTATION - enables instrumentation in 
#   scheduler to monitor system performance
# CONFIG_TASK_NAME_SIZE - Spcifies that maximum size of a
#   task name to save in the TCB.  Useful if scheduler
#   instrumentation is selected.  Set to zero to disable.
# CONFIG_JULIAN_TIME - Enables Julian time conversions
# CONFIG_START_YEAR, CONFIG_START_MONTH, CONFIG_START_DAY -
#   Used to initialize the internal time logic.
# CONFIG_DEV_CONSOLE - Set if architecture-specific logic
#   provides /dev/console.  Enables stdout, stderr, stdin.
#
CONFIG_EXAMPLE=ostest
CONFIG_DEBUG=n
CONFIG_DEBUG_VERBOSE=n
CONFIG_MM_REGIONS=2
CONFIG_ARCH_LOWPUTC=y
CONFIG_RR_INTERVAL=0
CONFIG_SCHED_INSTRUMENTATION=n
CONFIG_TASK_NAME_SIZE=0
CONFIG_START_YEAR=2007
CONFIG_START_MONTH=2
CONFIG_START_DAY=21
CONFIG_JULIAN_TIME=n
CONFIG_DEV_CONSOLE=n

#
# The following can be used to disable categories of
# APIs supported by the OS.  If the compiler supports
# weak functions, then it should not be necessary to
# disable functions unless you want to restrict usage
# of those APIs.
#
# There are certain dependency relationships in these
# features.
#
# o mq_notify logic depends on signals to awaken tasks
#   waiting for queues to become full or empty.
# o pthread_condtimedwait() depends on signals to wake
#   up waiting tasks.
#
CONFIG_DISABLE_CLOCK=y
CONFIG_DISABLE_PTHREAD=y
CONFIG_DISABLE_SIGNALS=y
CONFIG_DISABLE_MQUEUE=y

#
# Misc libc settings
#
# CONFIG_NOPRINTF_FIELDWIDTH - sprintf-related logic is a
#   little smaller if we do not support fieldwidthes
#
CONFIG_NOPRINTF_FIELDWIDTH=y

#
# Allow for architecture optimized implementations
#
# The architecture can provide optimized versions of the
# following to improve sysem performance
#
CONFIG_ARCH_MEMCPY=n
CONFIG_ARCH_MEMCMP=n
CONFIG_ARCH_MEMMOVE=n
CONFIG_ARCH_MEMSET=n
CONFIG_ARCH_STRCMP=n
CONFIG_ARCH_STRCPY=n
CONFIG_ARCH_STRNCPY=n
CONFIG_ARCH_STRLEN=n
CONFIG_ARCH_BZERO=n
CONFIG_ARCH_KMALLOC=n
CONFIG_ARCH_KZMALLOC=n
CONFIG_ARCH_KFREE=n

#
# General build options
#
# CONFIG_RRLOAD_BINARY - make the rrload binary format used with
#   BSPs from www.ridgerun.com
#
CONFIG_RRLOAD_BINARY=n

#
# Sizes of configurable things (0 disables)
#
# CONFIG_MAX_TASKS - The maximum number of simultaneously
#   actived tasks.  This value must be a power of two.
# CONFIG_NPTHREAD_KEYS - The number of items of thread-
#   specific data that can be retained
# CONFIG_NFILE_DESCRIPTORS - The maximum number of file
#   descriptors (one for each open)
# CONFIG_NFILE_STREAMS - The maximum number of streams that
#   can be fopen'ed
# CONFIG_STDIO_BUFFER_SIZE - Size of the buffer to allocate
#   on fopen. (Only if CONFIG_NFILE_STREAMS > 0)
# CONFIG_NUNGET_CHARS - Number of characters that can be
#   buffered by ungetc() (Only if CONFIG_NFILE_STREAMS > 0)
# CONFIG_PREALLOC_MQ_MSGS - The number of pre-allocated message
#   structures.  The system manages a pool of preallocated
#   message structures to minimize dynamic allocations
# CONFIG_MQ_MAXMSGSIZE - Message structures are allocated with
#   a fixed payload size given by this settin (does not include
#   other message structure overhead.
# CONFIG_MAX_WDOGPARMS - Maximum number of parameters that
#   can be passed to a watchdog handler
# CONFIG_PREALLOC_WDOGS - The number of pre-allocated watchdog
#   structures.  The system manages a pool of preallocated
#   watchdog structures to minimize dynamic allocations
#
CONFIG_MAX_TASKS=8
CONFIG_NPTHREAD_KEYS=0
CONFIG_NFILE_DESCRIPTORS=0
CONFIG_NFILE_STREAMS=0
CONFIG_STDIO_BUFFER_SIZE=0
CONFIG_NUNGET_CHARS=0
CONFIG_PREALLOC_MQ_MSGS=0
CONFIG_MQ_MAXMSGSIZE=0
CONFIG_MAX_WDOGPARMS=2
CONFIG_PREALLOC_WDOGS=4

#
# Stack and heap information
#
# CONFIG_BOOT_FROM_FLASH - Some configurations support XIP
#   operation from FLASH.
# CONFIG_CUSTOM_STACK - The up_ implementation will handle
#   all stack operations outside of the nuttx model.
# CONFIG_STACK_POINTER - The initial stack pointer
# CONFIG_PROC_STACK_SIZE - The size of the initial stack
# CONFIG_PTHREAD_STACK_MIN - Minimum pthread stack size
# CONFIG_PTHREAD_STACK_DEFAULT - Default pthread stack size
# CONFIG_HEAP_BASE - The beginning of the heap
# CONFIG_HEAP_SIZE - The size of the heap
#
CONFIG_BOOT_FROM_FLASH=n
CONFIG_CUSTOM_STACK=y
CONFIG_PROC_STACK_SIZE=
CONFIG_PTHREAD_STACK_MIN=
CONFIG_PTHREAD_STACK_DEFAULT=
CONFIG_HEAP_BASE=
CONFIG_HEAP_SIZE=
```

## arch/renesas/Kconfig
```kconfig
#
# For a description of the syntax of this configuration file,
# see the file kconfig-language.txt in the NuttX tools repository.
#

if ARCH_RENESAS

choice
	prompt "Renesas chip selection"
	default ARCH_CHIP_SH7032

config ARCH_CHIP_SH7032
	bool "SH7032"
	select ARCH_SH1
	---help---
		Hitachi/Renesas SH7032 (SH1)

config ARCH_CHIP_M30262F8
	bool "M30262F8"
	select ARCH_M16C
	select MM_SMALL
	---help---
		Renesas M30262F8 (M16C)

config ARCH_CHIP_R5F565NEDDFC
	bool "R5F565NEDDFC"
	select ARCH_RX65N_RSK1MB
	select ARCH_RX65N
	---help---
		Renesas RX65N on RSKRX65N-1MB

config ARCH_CHIP_R5F565NEHDFC
	bool "R5F565NEHDFC"
	select ARCH_RX65N_RSK2MB
	select ARCH_HAVE_I2CRESET
	select ARCH_HAVE_SPI_BITORDER
	---help---
		Renesas RX65N on RSKRX65N-2MB

config ARCH_CHIP_R5F565NEHDFP
	bool "R5F565NEHDFP"
	select ARCH_RX65N_GRROSE
	select ARCH_HAVE_I2CRESET
	select ARCH_HAVE_SPI_BITORDER
	---help---
		Renesas RX65N on GR-ROSE

config ARCH_CHIP_RENESAS_CUSTOM
	bool "Custom Renesas chip"
	select ARCH_CHIP_CUSTOM
	---help---
		Select this option if there is no directory for the chip under arch/renesas/src/.

endchoice

config ARCH_SH1
	bool
	default n

config ARCH_RENESAS_RX
	bool
	default n
	select ARCH_HAVE_SETJMP
	select CYGWIN_WINTOOL if WINDOWS_CYGWIN

config ARCH_RX65N
	bool
	default n
	select ARCH_RENESAS_RX

config ARCH_RX65N_RSK1MB
	bool
	default n
	select ARCH_RENESAS_RX

config ARCH_RX65N_RSK2MB
	bool
	default n
	select ARCH_RENESAS_RX

config ARCH_RX65N_GRROSE
	bool
	default n
	select ARCH_RENESAS_RX

config ARCH_M16C
	bool
	default n

config ARCH_CHIP
	string
	default "sh1"		if ARCH_SH1
	default "m16c"		if ARCH_M16C
	default "rx65n"		if ARCH_RENESAS_RX

source "arch/renesas/src/common/Kconfig"
source "arch/renesas/src/m16c/Kconfig"
source "arch/renesas/src/sh1/Kconfig"
source "arch/renesas/src/rx65n/Kconfig"

endif # ARCH_RENESAS
```
