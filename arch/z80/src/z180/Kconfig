## arch/z80/src/z8/Kconfig
```kconfig
#
# For a description of the syntax of this configuration file,
# see the file kconfig-language.txt in the NuttX tools repository.
#

if ARCH_CHIP_Z8

config ARCH_CHIP_Z8F640X
	bool

config ARCH_CHIP_Z8F642X
	bool

choice
	prompt "z8 Chip Selection"
	default ARCH_CHIP_Z8F6403

config ARCH_CHIP_Z8F6403
	bool "Z8F6403"
	select ARCH_CHIP_Z8F640X
	---help---
		ZiLOG Z8F6403 (z8 Encore)

config ARCH_CHIP_Z8F6423
	bool "Z8F6423"
	select ARCH_CHIP_Z8F642X
	---help---
		ZiLOG Z8F6423 (z8 Encore)

endchoice

# UART0/1 always enabled

config Z8_UART0
	bool
	default y
	select UART0_SERIALDRIVER

config Z8_UART1
	bool
	default y
	select UART1_SERIALDRIVER

# The ZiLOG ZDS-II Windows toolchain is the only toolchain available for
# the ez80.
#

config Z8_TOOLCHAIN_ZDSII
	bool
	default y if ARCH_CHIP_Z8
	default n if !ARCH_CHIP_Z8

choice
	prompt "ZDS-II Toolchain version"
	default Z8_ZDSII_V522

config Z8_ZDSII_V500
	bool "ZDS-II 5.0.0"

config Z8_ZDSII_V522
	bool "ZDS-II 5.2.2"

endchoice # ZDS-II Toolchain version
endif # ARCH_CHIP_Z8
```

## audio/Kconfig
```kconfig
#
# For a description of the syntax of this configuration file,
# see the file kconfig-language.txt in the NuttX tools repository.
#

config AUDIO
	bool "Audio Support"
	default n
	---help---
		Enables overall support for Audio library.

if AUDIO

config AUDIO_COMP
	bool "Support audio composition"
	default n
	---help---
		Composite several lower level audio devices into big one.

config AUDIO_MULTI_SESSION
	bool "Support multiple sessions"
	default n
	---help---
		Some audio devices, such as USB attached sound cards, may support more
		than one streaming session at a time (each with one or more audio channels).
		Selecting this feature adds support for tracking multiple concurrent
		sessions with the lower-level audio devices.

menu "Audio Buffer Configuration"

config AUDIO_LARGE_BUFFERS
	bool "Support Audio Buffers with greater than 65K samples"
	default n
	---help---
		By default, the Audio Pipeline Buffers use a 16-bit max sample count, limiting
		the number of samples per buffer to 65K.  Enable this option to specify a
		32-bit max sample count for increased samples / buffer capability.
		channel capability.

config AUDIO_NUM_BUFFERS
	int "Number of buffers for audio processing"
	default 2
	---help---
		Specifies the number of buffers to allocate for audio processing.
		If Driver Specified buffer sizes is enabled (below), then the
		low-level drivers will have the opportunity to override this
		value.

config AUDIO_BUFFER_NUMBYTES
	int "Size of each audio buffer for audio processing"
	default 8192
	---help---
		Specifies the allocation size for each audio buffer
		If Driver Specified buffer sizes is enabled (below), then the
		low-level drivers will have the opportunity to override this
		value.

config AUDIO_DRIVER_SPECIFIC_BUFFERS
	bool "Support for Driver specified buffer sizes"
	default n
	---help---
		By default, the Audio system uses the same size and number of buffers
		regardless of the specific audio device in use.  Specifying 'y' here
		adds extra code which allows the lower-level audio device to specify
		a particular size and number of buffers.

endmenu # Audio Buffer Configuration

menu "Supported Audio Formats"

config AUDIO_FORMAT_AC3
	bool "AC3 Format"
	default n
	---help---
		Build in support for AC3 (Dolby Digital) Audio format.

config AUDIO_FORMAT_DTS
	bool "DTS Format"
	default n
	---help---
		Add in support for DTS format.

config AUDIO_FORMAT_PCM
	bool "PCM Audio"
	default y
	---help---
		Build in support for PCM Audio format.

config AUDIO_FORMAT_MP3
	bool "MPEG 3 Layer 1"
	default y
	---help---
		Build in support for MP3 Audio format.

config AUDIO_FORMAT_MIDI
	bool "Midi Format"
	default n
	---help---
		Add in support for MIDI format.

config AUDIO_FORMAT_WMA
	bool "WMA Format (see copyright notice)"
	default n
	---help---
		Add in support for Microsoft Windows Media format.

config AUDIO_FORMAT_OGG_VORBIS
	bool "Ogg Vorbis format"
	default n
	---help---
		Build in support for the Open Source Ogg Vorbis format.

endmenu

menu "Exclude Specific Audio Features"

config AUDIO_EXCLUDE_VOLUME
	bool "Exclude volume controls"
	default n
	---help---
		Exclude building support for changing the playback volume.

config AUDIO_EXCLUDE_BALANCE
	bool "Exclude balance controls"
	default n
	---help---
		Exclude building support for changing the balance.

config AUDIO_EXCLUDE_EQUALIZER
	bool "Exclude equalizer controls"
	default y
	---help---
		Exclude building support for setting equalization.

config AUDIO_EQUALIZER_NBANDS
	int "Number of equalizer bands"
	default 8
	depends on !AUDIO_EXCLUDE_EQUALIZER
	---help---
		If equalizer support is not excluded, then it will be necessary to
		provide the (maximum) number of equalization bands to be supported.

config AUDIO_EXCLUDE_TONE
	bool "Exclude tone (bass and treble) controls"
	default y if !AUDIO_EXCLUDE_EQUALIZER
	default n if AUDIO_EXCLUDE_EQUALIZER
	---help---
		Exclude building support for changing the bass and treble.  Normally
		you would not select both tone controls and equalizer support unless
		your underlying hardware supports both options.

config AUDIO_EXCLUDE_PAUSE_RESUME
	bool "Exclude pause and resume controls"
	default n
	---help---
		Exclude building support for pausing and resuming audio files
		once they are submitted.  If the sound system is being used to play
		short system notification or error type sounds that typically only
		last a second or two, then there is no need (or chance) to pause or
		resume sound playback once it has started.

config AUDIO_EXCLUDE_STOP
	bool "Exclude stop playback controls"
	default n
	---help---
		Exclude building support for stopping audio files once they are
		submitted.  If the sound system is being used to play short system
		notification or error type sounds that typically only last a second
		or two, then there is no need (or chance) to stop the sound
		playback once it has started.

config AUDIO_EXCLUDE_FFORWARD
	bool "Exclude fast forward controls"
	default n if !AUDIO_EXCLUDE_STOP
	default y if AUDIO_EXCLUDE_STOP
	---help---
		Exclude building support for fast forwarding through audio files
		once they are submitted.  Selecting this option would only make
		if the underlying audio decoding logic is capable of sub-sampling
		in the stream of audio data.

config AUDIO_EXCLUDE_REWIND
	bool "Exclude rewind controls"
	default y
	---help---
		Rewind may be supported by some audio devices, but not the typical
		device that receives a non-seekable, stream of audio buffers.

endmenu

config AUDIO_CUSTOM_DEV_PATH
	bool "Use custom device path"
	default n
	---help---
		By default, all audio devices on the target are are registered in the
		/dev/audio directory.  Select this option to change the default location
		for the device registration.

if AUDIO_CUSTOM_DEV_PATH

config AUDIO_DEV_ROOT
	bool "Place audio devices in /dev"
	default n
	---help---
		This option causes all device entries to appear in /dev with all the
		other device entries.  This option generates the smallest code and
		RAM footprint.

if !AUDIO_DEV_ROOT

config AUDIO_DEV_PATH
	string "Base path for Audio devices"
	default "/dev/audio"
	---help---
		The path on the target where audio devices are registered.  The default
		is to place all audio devices in the /dev/audio/ directory.

endif
endif


# These are here as placeholders of what could be added

if AUDIO_PLANNED

config AUDIO_MIXER
	bool "Planned - Enable support for the software based Audio Mixer"
	default n
	---help---
		The Audio mixer is a software-only based component that can be used
		to perform audio channel or device mixing.

config AUDIO_MIDI_SYNTH
	bool "Planned - Enable support for the software-based MIDI synthesizer"
	default n
	---help---
		Builds a simple MIDI synthesizer.

config AUDIO_OUTPUT_JACK_CONTROL
	bool "Planned - Enable support for output jack control"
	default n
	---help---
		Builds a simple MIDI synthesizer.

config AUDIO_FONT
	bool "Planned - Enable support for the Audio Font"
	default n
	---help---
		The Audio font provides common audio symbols.

endif

endif
```

## binfmt/libelf/Kconfig
```kconfig
#
# For a description of the syntax of this configuration file,
# see the file kconfig-language.txt in the NuttX tools repository.
#

config ELF_ALIGN_LOG2
	int "Log2 Section Alignment"
	default 2
	---help---
		Align all sections to this Log2 value:  0->1, 1->2, 2->4, etc.

config ELF_STACKSIZE
	int "ELF Stack Size"
	default DEFAULT_TASK_STACKSIZE
	---help---
		This is the default stack size that will be used when starting ELF binaries.

config ELF_BUFFERSIZE
	int "ELF I/O Buffer Size"
	default 32
	---help---
		This is an I/O buffer that is used to access the ELF file.  Variable length items
		will need to be read (such as symbol names).  This is really just this initial
		size of the buffer; it will be reallocated as necessary to hold large symbol
		names).  Default: 32

config ELF_BUFFERINCR
	int "ELF I/O Buffer Realloc Increment"
	default 32
	---help---
		This is an I/O buffer that is used to access the ELF file.  Variable length items
		will need to be read (such as symbol names).  This value specifies the size
		increment to use each time the buffer is reallocated.  Default: 32

config ELF_DUMPBUFFER
	bool "Dump ELF buffers"
	default n
	depends on DEBUG_INFO
	---help---
		Dump various ELF buffers for debug purposes

config ELF_EXIDX_SECTNAME
	string "ELF Section Name for Exception Index"
	default ".ARM.exidx"
	depends on CXX_EXCEPTION && ARCH_ARM
	---help---
		Set the name string for the exception index section on the ELF modules to
		be loaded by the ELF binary loader.

		This is needed to support exception handling on loadable ELF modules.

config ELF_RELOCATION_BUFFERCOUNT
	int "ELF Relocation Table Buffer Count"
	default 256
	---help---
		This is an relocation buffer that is used to store elf relocation table to
		reduce access fs. Default: 256

config ELF_SYMBOL_CACHECOUNT
	int "ELF SYMBOL Table Cache Count"
	default 256
	---help---
		This is an cache that is used to store elf symbol table to
		reduce access fs. Default: 256
```

## binfmt/libmodule/Kconfig
```kconfig
#
# For a description of the syntax of this configuration file,
# see the file kconfig-language.txt in the NuttX tools repository.
#

config MODULE_ALIGN_LOG2
	int "Log2 Section Alignment"
	default 2
	---help---
		Align all sections to this Log2 value:  0->1, 1->2, 2->4, etc.

config MODULE_BUFFERSIZE
	int "Module I/O Buffer Size"
	default 128
	---help---
		This is an I/O buffer that is used to access the module file.
		Variable length items will need to be read (such as symbol names).
		This is really just this initial size of the buffer; it will be
		reallocated as necessary to hold large symbol names).  Default: 128

config MODULE_BUFFERINCR
	int "Module I/O Buffer Realloc Increment"
	default 32
	---help---
		This is an I/O buffer that is used to access the module file.
		Variable length items will need to be read (such as symbol names).
		This value specifies the size increment to use each time the
		buffer is reallocated.  Default: 32

config MODULE_DUMPBUFFER
	bool "Dump module buffers"
	default n
	depends on DEBUG && DEBUG_VERBOSE
	---help---
		Dump various module buffers for debug purposes
```

## binfmt/libnxflat/Kconfig
```kconfig
#
# For a description of the syntax of this configuration file,
# see the file kconfig-language.txt in the NuttX tools repository.
#

config NXFLAT_DUMPBUFFER
	bool "Dump NXFLAT buffers"
	default n
	depends on DEBUG_INFO
```

## binfmt/libpcode/Kconfig
```kconfig
#
# For a description of the syntax of this configuration file,
# see misc/tools/kconfig-language.txt.
#

config PCODE_STACKSIZE
	int "P-code interpreter stack size"
	default 2048
	---help---
		This is the stack size that will be used when starting P-code interpreter.

config PCODE_PRIORITY
	int "P-code interpreter priority"
	default 100
	---help---
		This is the task_priority that will be used when starting P-code interpreter.

config PCODE_VARSTACKSIZE
	int "P-code variable stack size"
	default 1024
	---help---
		This size of the P-Code variable storage area to be allocated by the
		P-Code runtime.

config PCODE_STRSTACKSIZE
	int "P-code string stack size"
	default 128
	---help---
		This size of the P-Code string stack area to be allocated by the
		P-Code runtime.

config PCODE_TEST_FS
	bool "Mount a test file system"
	depends on FS_ROMFS && !DISABLE_MOUNTPOINT
	---help---
		Mount a test file system.  This test file system was used to verify the P-Code binary format.

if PCODE_TEST_FS

config PCODE_TEST_DEVMINOR
	int "Test file system minor device number"
	default 0
	---help---
		The minor device number of the ROMFS block. For example, the N in /dev/ramN.
		Used for registering the RAM block driver that will hold the ROMFS file system
		containing the P-code files to be tested.  Default: 0

config PCODE_TEST_DEVPATH
	string "Test file system device Path"
	default "/dev/ram0"
	---help---
		The path to the ROMFS block driver device.  This must match PCODE_TEST_DEVMINOR.
		Used for registering the RAM block driver that will hold the ROMFS file system
		containing the P-code files to be tested.  Default: "/dev/ram0"

config PCODE_TEST_MOUNTPOINT
	string "Test file system mount point"
	default "/bin"
	---help---
		Location where the test file system will be mounted

endif # PCODE_TEST_FS

config PCODE_DUMPBUFFER
	bool "Dump P-code buffers"
	default n
	depends on DEBUG && DEBUG_VERBOSE
	---help---
		Dump various P-code buffers for debug purposes
```

## boards/arm/am335x/beaglebone-black/Kconfig
```kconfig
#
# For a description of the syntax of this configuration file,
# see the file kconfig-language.txt in the NuttX tools repository.
#

if ARCH_BOARD_BEAGLEBONE_BLACK

config BEAGLEBONE_VIDEOMODE
	string "LCD Video Mode"
	default "640x480x60"
	depends on !LCD_TDA19988 || !AM335X_I2C2
	---help---
		If we are not using HDMI (via the TDA19988) then we must select a
		fixed LCD resolution.  The default, "640x480x60" is standard VGA
		which should be supported by all LCDs.

endif # ARCH_BOARD_BEAGLEBONE_BLACK
```

## boards/arm/at32/at32f437-mini/Kconfig
```kconfig
#
# For a description of the syntax of this configuration file,
# see the file kconfig-language.txt in the NuttX tools repository.
#

if ARCH_BOARD_AT32F437_MINI

config HAVE_LEDS
	bool "Have user leds"
	default y
	select ARCH_HAVE_LEDS

endif
```

## boards/arm/csk6/csk6011a-nano/Kconfig
```kconfig
#
# For a description of the syntax of this configuration file,
# see the file kconfig-language.txt in the NuttX tools repository.
#

if ARCH_BOARD_CSK6011A_NANO
choice
	prompt "Console Mode"
	default CSK6_CONSOLE_UART0

config CSK6_CONSOLE_UART0
	bool "USART0 is a console port"
	select USART0_SERIALDRIVER

#TODO add support other port
endchoice # USART0 Mode
endif
```

## boards/arm/cxd56xx/drivers/Kconfig
```kconfig
#
# For a description of the syntax of this configuration file,
# see the file kconfig-language.txt in the NuttX tools repository.
#

if SPECIFIC_DRIVERS
source "$BINDIR/drivers/platform/audio/Kconfig"
source "$BINDIR/drivers/platform/sensors/Kconfig"
endif
```

## boards/arm/cxd56xx/drivers/audio/Kconfig
```kconfig
#
# For a description of the syntax of this configuration file,
# see the file kconfig-language.txt in the NuttX tools repository.
#

comment "Audio Options"

config CXD56_AUDIO
	bool "CXD56 SDK Audio Driver"
	default n
```

## boards/arm/cxd56xx/drivers/camera/Kconfig
```kconfig
#
# For a description of the syntax of this configuration file,
# see the file kconfig-language.txt in the NuttX tools repository.
#

config VIDEO_ISX012
	bool "ISX012 Image sensor"
	default n
	select I2C
```
