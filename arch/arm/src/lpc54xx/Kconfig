## arch/arm/src/mcx-nxxx/Kconfig
```kconfig
#
# For a description of the syntax of this configuration file,
# see the file kconfig-language.txt in the NuttX tools repository.
#

if ARCH_CHIP_MCX_NXXX

menu "MCX NXXx Chip Selection"

choice
	prompt "MCX NXXx Core Configuration"
	default ARCH_CHIP_N236

config ARCH_CHIP_N236
	bool "MCXN236 Processor"
	select ARCH_HAVE_RESET
	select ARMV8M_HAVE_ICACHE

endchoice # MCX NXXx Chip Selection

endmenu # "MCX NXXx Chip Selection"

menu "NXXX Peripheral Selection"

config NXXX_GPIO_IRQ
	bool "GPIO Interrupt Support"
	default y

config NXXX_LPI2C
	bool "LPI2C support"
	default n

menu "LPUART"

config NXXX_LPUART
	bool
	default n
	select ARCH_HAVE_SERIAL_TERMIOS

config NXXX_LPUART1
	bool "LPUART1"
	default n
	select NXXX_LPUART
	select LPUART1_SERIALDRIVER

config NXXX_LPUART2
	bool "LPUART2"
	default n
	select NXXX_LPUART
	select LPUART2_SERIALDRIVER

config NXXX_LPUART3
	bool "LPUART3"
	default n
	select NXXX_LPUART
	select LPUART3_SERIALDRIVER

config NXXX_LPUART4
	bool "LPUART4"
	default n
	select NXXX_LPUART
	select LPUART4_SERIALDRIVER

config NXXX_LPUART5
	bool "LPUART5"
	default n
	select NXXX_LPUART
	select LPUART5_SERIALDRIVER

config NXXX_LPUART6
	bool "LPUART6"
	default n
	select NXXX_LPUART
	select LPUART6_SERIALDRIVER

config NXXX_LPUART7
	bool "LPUART7"
	default n
	select NXXX_LPUART
	select LPUART7_SERIALDRIVER

config NXXX_LPUART8
	bool "LPUART8"
	default n
	select NXXX_LPUART
	select LPUART8_SERIALDRIVER

config NXXX_LPUART9
	bool "LPUART9"
	default n
	select NXXX_LPUART
	select LPUART9_SERIALDRIVER
	
menu "LPUART Configuration"
	depends on NXXX_LPUART

config NXXX_LPUART_INVERT
	bool "Signal Invert Support"
	default n

config NXXX_LPUART_SINGLEWIRE
	bool "Signal Wire Support"
	default n

config NXXX_SERIAL_RXDMA_BUFFER_SIZE
	int "RX DMA buffer size"
	default 32
	depends on LPUART1_RXDMA || LPUART2_RXDMA || LPUART3_RXDMA || LPUART4_RXDMA || \
               LPUART5_RXDMA || LPUART6_RXDMA || LPUART7_RXDMA || LPUART8_RXDMA || \
               LPUART9_RXDMA

	---help---
		The DMA buffer size when using RX DMA to emulate a FIFO.

		When streaming data, the generic serial layer will be called
		every time the FIFO receives half this number of bytes.

		Value given here will be rounded up to next multiple of 32 bytes.

endmenu # LPUART Configuration

endmenu # LPUART

menu "LPI2C Peripherals"

menuconfig NXXX_LPI2C0
	bool "LPI2C0"
	default n
	select NXXX_LPI2C

if NXXX_LPI2C0

config NXXX_LPI2C0_BUSYIDLE
	int "Bus idle timeout period in clock cycles"
	default 0

config NXXX_LPI2C0_FILTSCL
	int "I2C master digital glitch filters for SCL input in clock cycles"
	default 0

config NXXX_LPI2C0_FILTSDA
	int "I2C master digital glitch filters for SDA input in clock cycles"
	default 0

endif # NXXX_LPI2C0

menuconfig NXXX_LPI2C1
	bool "LPI2C1"
	default n
	select NXXX_LPI2C

if NXXX_LPI2C1

config NXXX_LPI2C1_BUSYIDLE
	int "Bus idle timeout period in clock cycles"
	default 0

config NXXX_LPI2C1_DMA
	bool "Enable DMA for I2C1"
	default n
	depends on NXXX_LPI2C_DMA

config NXXX_LPI2C1_FILTSCL
	int "I2C master digital glitch filters for SCL input in clock cycles"
	default 0

config NXXX_LPI2C1_FILTSDA
	int "I2C master digital glitch filters for SDA input in clock cycles"
	default 0

endif # NXXX_LPI2C1

menuconfig NXXX_LPI2C2
	bool "LPI2C2"
	default n
	select NXXX_LPI2C

if NXXX_LPI2C2

config NXXX_LPI2C2_BUSYIDLE
	int "Bus idle timeout period in clock cycles"
	default 0

config NXXX_LPI2C2_DMA
	bool "Enable DMA for I2C2"
	default n
	depends on NXXX_LPI2C_DMA

config NXXX_LPI2C2_FILTSCL
	int "I2C master digital glitch filters for SCL input in clock cycles"
	default 0

config NXXX_LPI2C2_FILTSDA
	int "I2C master digital glitch filters for SDA input in clock cycles"
	default 0

endif # NXXX_LPI2C2

menuconfig NXXX_LPI2C3
	bool "LPI2C3"
	default n
	select NXXX_LPI2C

if NXXX_LPI2C3

config NXXX_LPI2C3_BUSYIDLE
	int "Bus idle timeout period in clock cycles"
	default 0

config NXXX_LPI2C3_DMA
	bool "Enable DMA for I2C3"
	default n
	depends on NXXX_LPI2C_DMA

config NXXX_LPI2C3_FILTSCL
	int "I2C master digital glitch filters for SCL input in clock cycles"
	default 0

config NXXX_LPI2C3_FILTSDA
	int "I2C master digital glitch filters for SDA input in clock cycles"
	default 0

endif # NXXX_LPI2C3

menuconfig NXXX_LPI2C4
	bool "LPI2C4"
	default n
	select NXXX_LPI2C

if NXXX_LPI2C4

config NXXX_LPI2C4_BUSYIDLE
	int "Bus idle timeout period in clock cycles"
	default 0

config NXXX_LPI2C4_DMA
	bool "Enable DMA for I2C4"
	default n
	depends on NXXX_LPI2C_DMA

config NXXX_LPI2C4_FILTSCL
	int "I2C master digital glitch filters for SCL input in clock cycles"
	default 0

config NXXX_LPI2C4_FILTSDA
	int "I2C master digital glitch filters for SDA input in clock cycles"
	default 0

endif # NXXX_LPI2C4

menuconfig NXXX_LPI2C5
	bool "LPI2C5"
	default n
	select NXXX_LPI2C

if NXXX_LPI2C5

config NXXX_LPI2C5_BUSYIDLE
	int "Bus idle timeout period in clock cycles"
	default 0

config NXXX_LPI2C5_FILTSCL
	int "I2C master digital glitch filters for SCL input in clock cycles"
	default 0

config NXXX_LPI2C5_FILTSDA
	int "I2C master digital glitch filters for SDA input in clock cycles"
	default 0

endif # NXXX_LPI2C5

menuconfig NXXX_LPI2C6
	bool "LPI2C6"
	default n
	select NXXX_LPI2C

if NXXX_LPI2C6

config NXXX_LPI2C6_BUSYIDLE
	int "Bus idle timeout period in clock cycles"
	default 0

config NXXX_LPI2C6_FILTSCL
	int "I2C master digital glitch filters for SCL input in clock cycles"
	default 0

config NXXX_LPI2C6_FILTSDA
	int "I2C master digital glitch filters for SDA input in clock cycles"
	default 0

endif # NXXX_LPI2C6

menuconfig NXXX_LPI2C7
	bool "LPI2C7"
	default n
	select NXXX_LPI2C

if NXXX_LPI2C7

config NXXX_LPI2C7_BUSYIDLE
	int "Bus idle timeout period in clock cycles"
	default 0

config NXXX_LPI2C7_FILTSCL
	int "I2C master digital glitch filters for SCL input in clock cycles"
	default 0

config NXXX_LPI2C7_FILTSDA
	int "I2C master digital glitch filters for SDA input in clock cycles"
	default 0

endif # NXXX_LPI2C7

endmenu # LPI2C Peripherals

menu "LPI2C Configuration"
	depends on NXXX_LPI2C

config NXXX_LPI2C_DMA
	bool "I2C DMA Support"
	default n
	depends on NXXX_LPI2C && NXXX_EDMA && !I2C_POLLED
	---help---
		This option enables the DMA for I2C transfers.
		Note: The user can define CONFIG_I2C_DMAPRIO: a custom priority value
		for the I2C dma streams, else the default priority level is set to
		medium.

config NXXX_LPI2C_DMA_MAXMSG
	int "Maximum number messages that will be DMAed"
	default 8
	depends on NXXX_LPI2C_DMA
	---help---
		This option sets the number of mesg that can be in a transfer.
		It is used to allocate space for the 16 bit LPI2C commands
		that will be DMA-ed to the LPI2C device.

config NXXX_LPI2C_DYNTIMEO
	bool "Use dynamic timeouts"
	default n
	depends on NXXX_LPI2C

config NXXX_LPI2C_DYNTIMEO_USECPERBYTE
	int "Timeout Microseconds per Byte"
	default 500
	depends on NXXX_LPI2C_DYNTIMEO

config NXXX_LPI2C_DYNTIMEO_STARTSTOP
	int "Timeout for Start/Stop (Milliseconds)"
	default 1000
	depends on NXXX_LPI2C_DYNTIMEO

config NXXX_LPI2C_TIMEOSEC
	int "Timeout seconds"
	default 0
	depends on NXXX_LPI2C

config NXXX_LPI2C_TIMEOMS
	int "Timeout Milliseconds"
	default 500
	depends on NXXX_LPI2C && !NXXX_LPI2C_DYNTIMEO

config NXXX_LPI2C_TIMEOTICKS
	int "Timeout for Done and Stop (ticks)"
	default 500
	depends on NXXX_LPI2C && !NXXX_LPI2C_DYNTIMEO

endmenu # LPI2C Configuration

endmenu # NXXX Peripheral Selection

endif # ARCH_CHIP_NXXX
```

## arch/arm/src/moxart/Kconfig
```kconfig
#
# For a description of the syntax of this configuration file,
# see the file kconfig-language.txt in the NuttX tools repository.
#

comment "MoxART Configuration Options"

config UART_MOXA_MODE_REG
	hex "16550 UART mode register address"
	default 0x982000E0

config UART_MOXA_IRQ_STATUS_REG
	hex "16550 UART shared IRQ status register address"
	default 0x982000C0

config UART_MOXA_SHARED_IRQ
	int "16550 UART shared IRQ number"
	default 31
```

## arch/arm/src/mps/Kconfig
```kconfig
#
# For a description of the syntax of this configuration file,
# see the file kconfig-language.txt in the NuttX tools repository.
#

if ARCH_CHIP_MPS

menu "MPS Chip Selection"

choice
	prompt "ARM MPS Configuration"
	default ARCH_CHIP_MPS3_AN547

config ARCH_CHIP_MPS2_AN386
	bool "MPS2 AN386 Processor Cortexm4"
	select ARCH_CORTEXM4
	select ARCH_HAVE_MPU
	select ARM_HAVE_MPU_UNIFIED
	select ARCH_HAVE_FPU
	select ARMV7M_HAVE_STACKCHECK

config ARCH_CHIP_MPS2_AN500
	bool "MPS2 AN500 Processor Cortexm7"
	select ARCH_CORTEXM7
	select ARCH_HAVE_MPU
	select ARM_HAVE_MPU_UNIFIED
	select ARCH_HAVE_FPU
	select ARMV7M_HAVE_STACKCHECK

config ARCH_CHIP_MPS2_AN521
	bool "MPS2 AN521 Processor Cortexm33"
	select ARCH_CORTEXM33
	select ARCH_HAVE_MPU
	select ARM_HAVE_MPU_UNIFIED

config ARCH_CHIP_MPS3_AN524
	bool "MPS3 AN524 Processor Cortexm33"
	select ARCH_CORTEXM33

config ARCH_CHIP_MPS3_AN547
	bool "MPS3 AN547 Processor Cortexm55"
	select ARCH_CORTEXM55
	select ARCH_HAVE_FPU
	select ARM_HAVE_MVE
	select ARCH_HAVE_TEXT_HEAP
	select ARCH_HAVE_DATA_HEAP

endchoice

endmenu

endif
```

## arch/arm/src/mx8mp/Kconfig
```kconfig
#
# For a description of the syntax of this configuration file,
# see the file kconfig-language.txt in the NuttX tools repository.
#

comment "i.MX8MP Configuration Options"

menu "i.MX8MP Peripheral Selection"

config MX8MP_UART1
	bool "UART1"
	default n
	select UART1_SERIALDRIVER
	select ARCH_HAVE_SERIAL_TERMIOS

config MX8MP_UART2
	bool "UART2"
	default n
	select UART2_SERIALDRIVER
	select ARCH_HAVE_SERIAL_TERMIOS

config MX8MP_UART3
	bool "UART3"
	default n
	select UART3_SERIALDRIVER
	select ARCH_HAVE_SERIAL_TERMIOS

config MX8MP_UART4
	bool "UART4"
	default n
	select UART4_SERIALDRIVER
	select ARCH_HAVE_SERIAL_TERMIOS

#####################################################################
#  I2C Configuration (Master)
#####################################################################

config MX8MP_I2C
	bool "I2C Master"
	select I2C
	---help---
		Build in support for I2C master mode.

if MX8MP_I2C

config MX8MP_I2C1
	bool "I2C1"
	default n
	select I2C

config MX8MP_I2C2
	bool "I2C2"
	default n
	select I2C

config MX8MP_I2C3
	bool "I2C3"
	default n
	select I2C

config MX8MP_I2C4
	bool "I2C4"
	default n
	select I2C

config MX8MP_I2C5
	bool "I2C5"
	default n
	select I2C

config MX8MP_I2C6
	bool "I2C6"
	default n
	select I2C

config MX8MP_I2C_DRIVER
	bool "I2C character driver"
	default n
	select I2C_DRIVER
	---help---
		Build in support for a character driver at /dev/i2c[N] that may be
		used to perform I2C bus transfers from applications.  The intent of
		this driver is to support I2C testing.  It is not suitable for use
		in any real driver application.

endif # MX8MP_I2C

#####################################################################
#  SPI Configuration (Master)
#####################################################################

config MX8MP_SPI
	bool "SPI Master"
	select SPI
	---help---
		Build in support for SPI master mode.

if MX8MP_SPI

config MX8MP_SPI1
	bool "SPI1"
	default n
	select SPI

config MX8MP_SPI2
	bool "SPI2"
	default n
	select SPI

config MX8MP_SPI3
	bool "SPI3"
	default n
	select SPI

config MX8MP_SPI_DRIVER
	bool "SPI character driver"
	default n
	select SPI_DRIVER
	---help---
		Build in support for a character driver at /dev/spi[N] that may b
		used to perform SPI bus transfers from applications.  The intent of
		this driver is to support SPI testing.

endif # MX8MP_SPI

config MX8MP_RPMSG
	bool "RPMSG support"
	default y
	depends on DEV_RPMSG
	---help---
		Enable RPMSG shared memory and behave as a client device that can be
		accessed by the IMX8MP A53 core running Linux IMX.

endmenu # i.MX8MP Peripheral Selection

# These "hidden" settings determine whether a peripheral option is available
# for the selected MCU

# When there are multiple instances of a device, these "hidden" settings
# will automatically be selected and will represent the 'OR' of the
# instances selected.
```
