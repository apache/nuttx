## arch/arm/src/rtl8720c/Kconfig
```kconfig
#
# For a description of the syntax of this configuration file,
# see the file kconfig-language.txt in the NuttX tools repository.
#

if ARCH_CHIP_CUSTOM

comment "AMEBA Configuration Options"

choice
	prompt "AMEBA Chip Selection"
	default ARCH_CHIP_AMEBAZ

config ARCH_CHIP_AMEBAZ
	bool "AmebaZ"
	select ARCH_CORTEXM33

endchoice

choice
	prompt "AMEBAZ Chip Type Selection"
	default ARCH_CHIP_AMEBAZ_C_CUT
	depends on ARCH_CHIP_AMEBAZ

config ARCH_CHIP_AMEBAZ_C_CUT
	bool "AmebaZ_C_CUT"

config ARCH_CHIP_AMEBAZ_D_CUT
	bool "AmebaZ_D_CUT"

endchoice

config AMEBA_NR_IRQS
	int "Interrupt Number"

menuconfig AMEBA_UART
	bool "AMEBA UART Chip support"
	select ARCH_HAVE_SERIAL_TERMIOS
	default n

if AMEBA_UART

config AMEBA_UART0
	bool "AMEBA UART0"
	default n

if AMEBA_UART0

config AMEBA_UART0_TX_PIN
	int "AMEBA UART0 tx pin"

config AMEBA_UART0_RX_PIN
	int "AMEBA UART0 rx pin"

config AMEBA_UART0_BAUD
	int "AMEBA UART0 BAUD"
	default 115200

config AMEBA_UART0_PARITY
	int "AMEBA UART0 parity"
	default 0
	range 0 2
	---help---
		AMEBA UART0 parity.  0=None, 1=Odd, 2=Even.  Default: None

config AMEBA_UART0_BITS
	int "AMEBA UART0 number of bits"
	default 8
	---help---
		AMEBA UART0 number of bits.  Default: 8

config AMEBA_UART0_2STOP
	int "AMEBA UART0 two stop bits"
	default 0
	---help---
		0=1 stop bit, 1=Two stop bits.  Default: 1 stop bit

config AMEBA_UART0_RXBUFSIZE
	int "AMEBA UART0 Rx buffer size"
	default 256
	---help---
		AMEBA UART0 Rx buffer size.  Default: 256

config AMEBA_UART0_TXBUFSIZE
	int "AMEBA UART0 Tx buffer size"
	default 256
	---help---
		AMEBA UART0 Tx buffer size.  Default: 256

config AMEBA_UART0_IFLOWCONTROL
	bool "AMEBA UART0 RTS flow control"
	default n
	select SERIAL_IFLOWCONTROL
	---help---
		Enable AMEBA UART0 RTS flow control

config AMEBA_UART0_OFLOWCONTROL
	bool "AMEBA UART0 CTS flow control"
	default n
	select SERIAL_OFLOWCONTROL
	---help---
		Enable AMEBA UART0 CTS flow control

endif # AMEBA_UART0

config AMEBA_UART1
	bool "AMEBA UART1"
	default n

if AMEBA_UART1

config AMEBA_UART1_TX_PIN
	int "AMEBA UART1 tx pin"

config AMEBA_UART1_RX_PIN
	int "AMEBA UART1 rx pin"

config AMEBA_UART1_BAUD
	int "AMEBA UART1 BAUD"
	default 115200

config AMEBA_UART1_PARITY
	int "AMEBA UART1 parity"
	default 0
	range 0 2
	---help---
		AMEBA UART1 parity.  0=None, 1=Odd, 2=Even.  Default: None

config AMEBA_UART1_BITS
	int "AMEBA UART1 number of bits"
	default 8
	---help---
		AMEBA UART1 number of bits.  Default: 8

config AMEBA_UART1_2STOP
	int "AMEBA UART1 two stop bits"
	default 0
	---help---
		0=1 stop bit, 1=Two stop bits.  Default: 1 stop bit

config AMEBA_UART1_RXBUFSIZE
	int "AMEBA UART1 Rx buffer size"
	default 256
	---help---
		AMEBA UART1 Rx buffer size.  Default: 256

config AMEBA_UART1_TXBUFSIZE
	int "AMEBA UART1 Tx buffer size"
	default 256
	---help---
		AMEBA UART1 Tx buffer size.  Default: 256

config AMEBA_UART1_IFLOWCONTROL
	bool "AMEBA UART1 RTS flow control"
	default n
	select SERIAL_IFLOWCONTROL
	---help---
		Enable AMEBA UART1 RTS flow control

config AMEBA_UART1_OFLOWCONTROL
	bool "AMEBA UART1 CTS flow control"
	default n
	select SERIAL_OFLOWCONTROL
	---help---
		Enable AMEBA UART1 CTS flow control

endif # AMEBA_UART1

config AMEBA_UART2
	bool "AMEBA UART2"
	default n

if AMEBA_UART2

config AMEBA_UART2_TX_PIN
	int "AMEBA UART2 tx pin"

config AMEBA_UART2_RX_PIN
	int "AMEBA UART2 rx pin"

config AMEBA_UART2_BAUD
	int "AMEBA UART2 BAUD"
	default 115200

config AMEBA_UART2_PARITY
	int "AMEBA UART2 parity"
	default 0
	range 0 2
	---help---
		AMEBA UART2 parity.  0=None, 1=Odd, 2=Even.  Default: None

config AMEBA_UART2_BITS
	int "AMEBA UART2 number of bits"
	default 8
	---help---
		AMEBA UART2 number of bits.  Default: 8

config AMEBA_UART2_2STOP
	int "AMEBA UART2 two stop bits"
	default 0
	---help---
		0=1 stop bit, 1=Two stop bits.  Default: 1 stop bit

config AMEBA_UART2_RXBUFSIZE
	int "AMEBA UART2 Rx buffer size"
	default 256
	---help---
		AMEBA UART2 Rx buffer size.  Default: 256

config AMEBA_UART2_TXBUFSIZE
	int "AMEBA UART2 Tx buffer size"
	default 256
	---help---
		AMEBA UART2 Tx buffer size.  Default: 256

config AMEBA_UART2_IFLOWCONTROL
	bool "AMEBA UART2 RTS flow control"
	default n
	select SERIAL_IFLOWCONTROL
	---help---
		Enable AMEBA UART2 RTS flow control

config AMEBA_UART2_OFLOWCONTROL
	bool "AMEBA UART2 CTS flow control"
	default n
	select SERIAL_OFLOWCONTROL
	---help---
		Enable AMEBA UART2 CTS flow control

endif # AMEBA_UART2

config AMEBA_UART3
	bool "AMEBA UART3"
	default n

if AMEBA_UART3

config AMEBA_UART3_TX_PIN
	int "AMEBA UART3 tx pin"

config AMEBA_UART3_RX_PIN
	int "AMEBA UART3 rx pin"

config AMEBA_UART3_BAUD
	int "AMEBA UART3 BAUD"
	default 115200

config AMEBA_UART3_PARITY
	int "AMEBA UART3 parity"
	default 0
	range 0 2
	---help---
		AMEBA UART3 parity.  0=None, 1=Odd, 2=Even.  Default: None

config AMEBA_UART3_BITS
	int "AMEBA UART3 number of bits"
	default 8
	---help---
		AMEBA UART3 number of bits.  Default: 8

config AMEBA_UART3_2STOP
	int "AMEBA UART3 two stop bits"
	default 0
	---help---
		0=1 stop bit, 1=Two stop bits.  Default: 1 stop bit

config AMEBA_UART3_RXBUFSIZE
	int "AMEBA UART3 Rx buffer size"
	default 256
	---help---
		AMEBA UART3 Rx buffer size.  Default: 256

config AMEBA_UART3_TXBUFSIZE
	int "AMEBA UART3 Tx buffer size"
	default 256
	---help---
		AMEBA UART3 Tx buffer size.  Default: 256

config AMEBA_UART3_IFLOWCONTROL
	bool "AMEBA UART3 RTS flow control"
	default n
	select SERIAL_IFLOWCONTROL
	---help---
		Enable AMEBA UART3 RTS flow control

config AMEBA_UART3_OFLOWCONTROL
	bool "AMEBA UART3 CTS flow control"
	default n
	select SERIAL_OFLOWCONTROL
	---help---
		Enable AMEBA UART3 CTS flow control

endif # AMEBA_UART3

choice
	prompt "AMEBA Serial Console"
	default AMEBA_NO_SERIAL_CONSOLE
	depends on DEV_CONSOLE

config AMEBA_UART0_SERIAL_CONSOLE
	bool "AMEBA UART0 serial console"
	depends on AMEBA_UART0
	select SERIAL_CONSOLE

config AMEBA_UART1_SERIAL_CONSOLE
	bool "AMEBA UART1 serial console"
	depends on AMEBA_UART1
	select SERIAL_CONSOLE

config AMEBA_UART2_SERIAL_CONSOLE
	bool "AMEBA UART2 serial console"
	depends on AMEBA_UART2
	select SERIAL_CONSOLE

config AMEBA_UART3_SERIAL_CONSOLE
	bool "AMEBA UART3 serial console"
	depends on AMEBA_UART3
	select SERIAL_CONSOLE

config AMEBA_NO_SERIAL_CONSOLE
	bool "No AMEBA serial console"

endchoice # AMEBA Serial Console

config AMEBA_SUPRESS_CONFIG
	bool "Suppress AMEBA configuration"
	default n

config AMEBA_SUPRESS_INITIAL_CONFIG
	bool "Suppress initial AMEBA configuration"
	depends on !AMEBA_SUPRESS_CONFIG
	default n
	---help---
		This option is useful, for example, if you are using a bootloader
		that configures the AMEBA_UART.  In that case, you may want to
		just leave the existing console configuration in place.  Default: n

config SERIAL_UART_ARCH_MMIO
	bool "Platform access register through the memory mapping"
	default n

config SERIAL_UART_ARCH_IOCTL
	bool "Platform has own custom IOCTL"
	default n

config AMEBA_REGINCR
	int "Address increment between AMEBA registers"
	default 1
	---help---
		The address increment between AMEBA registers.  Options are 1, 2, or 4.
		Default: 1

config AMEBA_REGWIDTH
	int "Bit width of AMEBA registers"
	default 8
	---help---
		The bit width of registers.  Options are 8, 16, or 32. Default: 8

config AMEBA_ADDRWIDTH
	int "Address width of AMEBA registers"
	default 8
	---help---
		The bit width of registers.  Options are 8, 16, or 32. Default: 8

config AMEBA_HCI_DEV_NAME
	string "Device Name of UART Device for Bluetooth"
	default "/dev/ttyS2"
	---help---
		This option specifies the name of UART device to be used
		for Bluetooth.

config AMEBA_HCI_PROXY_DEV_NAME
	string "Device Name of UART Device for Bluetooth"
	default "/dev/ttyBT"
	---help---
		This option specifies the name of UART device to be used
		for Bluetooth.

endif # AMEBA_UART

config IEEE80211_REALTEK_AMEBAZ
	bool "Realtek amebaZ chip support"
	default n

if IEEE80211_REALTEK_AMEBAZ

config IEEE80211_REALTEK_AMEBAZ_RECV_STACKSIZE
	int "Realtek amebaZ recv stack size"
	default 4096
	---help---
		Default recv stack size

endif

endif # ARCH_CHIP_CUSTOM
```

## arch/arm/src/rtl8721dx/Kconfig
```kconfig
#
# For a description of the syntax of this configuration file,
# see the file kconfig-language.txt in the NuttX tools repository.
#

if ARCH_CHIP_RTL8721DX

menu "RTL8721Dx Chip Selection"

config RTL8721DX_KM4
	bool
	default y
	---help---
		The Realtek RTL8721Dx KM4 application core
		(ARMv8-M.main / Cortex-M33).

endmenu # RTL8721Dx Chip Selection

menu "RTL8721Dx Bring-up Options"

config RTL8721DX_HEAP_SIZE
	hex "NuttX reserved heap size (bytes)"
	default 0x10000
	---help---
		During bring-up NuttX runs as a guest on the Realtek SDK image and
		must not touch RAM that the SDK owns.  Instead of claiming all SRAM
		from the end of NuttX's BSS to the end of memory (which overlaps the
		SDK heap), NuttX uses a self-contained, statically reserved heap of
		this size placed in NuttX's own .bss.  up_allocate_heap() returns
		this buffer.  Keep it within the 288KB KM4 SRAM budget after NuttX
		text/data/bss.

config RTL8721DX_LOGUART_RXBUFSIZE
	int "LOG-UART console RX buffer size"
	default 256
	---help---
		Size of the NuttX receive buffer for the LOG-UART console.

config RTL8721DX_LOGUART_TXBUFSIZE
	int "LOG-UART console TX buffer size"
	default 256
	---help---
		Size of the NuttX transmit buffer for the LOG-UART console.

endmenu # RTL8721Dx Bring-up Options

menu "RTL8721Dx WiFi"

config RTL8721DX_WIFI
	bool "WiFi (WHC host) support"
	default n
	---help---
		Link the Realtek WHC (WiFi Host Controller) host stack so the AP can
		drive the WiFi MAC/PHY that runs on the NP network processor.  The
		AP-side host WiFi control libraries (lib_wifi_whc_ap and friends)
		are linked from the pinned SDK; the lwIP / event glue they expect is
		provided by NuttX (arch/arm/src/common/ameba/wifi/), routing frames
		into NuttX's native network stack instead of lwIP.

		M3.1 brings up the control plane only (wifi_on + scan); the data
		path and netdev/wireless-extension wiring follow.

endmenu # RTL8721Dx WiFi

menu "RTL8721Dx Storage"

config RTL8721DX_FLASH_FS
	bool "On-chip SPI NOR data filesystem (littlefs)"
	default n
	select MTD
	select MTD_BYTE_WRITE
	select FS_LITTLEFS
	---help---
		Expose the SDK "VFS1" data partition (the last 128 KiB of the
		on-chip SPI NOR flash, which does not overlap the NP/AP firmware
		images) as a NuttX MTD device and mount a littlefs filesystem on it
		at /data.  This provides persistent storage for application data and
		backs the WiFi fast-connect / PMK key-value store (rt_kv_*).

		The MTD backend wraps the SDK's dual-core-locked FLASH_xxx flash
		primitives (ameba_flash_mtd.c).

endmenu # RTL8721Dx Storage

endif # ARCH_CHIP_RTL8721DX
```
