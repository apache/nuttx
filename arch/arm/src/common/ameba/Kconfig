## arch/arm/src/common/ameba/Kconfig
```kconfig
#
# For a description of the syntax of this configuration file,
# see the file kconfig-language.txt in the NuttX tools repository.
#
# Shared Realtek Ameba peripheral drivers (arch/arm/src/common/ameba).  These
# options are common to every Ameba ARM chip (RTL8721Dx, RTL8720F, ...) and
# are sourced from each chip's own Kconfig.
#

menu "Ameba Peripheral Support"

config AMEBA_GPIO
	bool "GPIO"
	default n
	select DEV_GPIO
	---help---
		Expose Ameba GPIO pins through the NuttX GPIO (ioexpander) upper
		half at /dev/gpioN. The board selects which pins are registered
		and their type (input, output or interrupt) in its bring-up code.

		The driver (arch/arm/src/common/ameba/ameba_gpio.c) sits on the SDK
		fwlib register layer and dispatches pin interrupts through the ROM
		GPIO interrupt handler.

config AMEBA_UART
	bool "UART"
	default n
	select SERIAL
	select ARCH_HAVE_SERIAL_TERMIOS
	---help---
		Expose the Ameba high-speed UARTs (UART0/UART1) through the NuttX
		serial upper half.  The LOG-UART owns the console and /dev/ttyS0, so
		the board registers these general-purpose ports at /dev/ttyS1 and up
		in its bring-up code, giving the TX/RX pads and baud for each.

		The driver (arch/arm/src/common/ameba/ameba_uart.c) sits on the SDK
		fwlib register layer and dispatches RX/TX through NuttX-native
		interrupts.

if AMEBA_UART

config AMEBA_UART_RXBUFSIZE
	int "UART receive buffer size"
	default 256
	---help---
		Size, in bytes, of the receive buffer allocated for each registered
		Ameba UART port.

config AMEBA_UART_TXBUFSIZE
	int "UART transmit buffer size"
	default 256
	---help---
		Size, in bytes, of the transmit buffer allocated for each registered
		Ameba UART port.

endif # AMEBA_UART

config AMEBA_I2C
	bool "I2C"
	default n
	select I2C
	select I2C_DRIVER
	---help---
		Expose the Ameba I2C controllers (I2C0/I2C1) as NuttX I2C master
		buses at /dev/i2cN.  The board selects which controller is used and
		its SCL/SDA pads in its bring-up code.

		The driver (arch/arm/src/common/ameba/ameba_i2c.c) sits on the SDK
		fwlib register layer and drives the DesignWare I2C block in polling
		mode.

config AMEBA_SPI
	bool "SPI"
	default n
	select SPI
	select SPI_DRIVER
	select SPI_EXCHANGE
	---help---
		Expose the Ameba SPI controllers (SPI0/SPI1) as NuttX SPI master
		buses at /dev/spiN.  The board selects which controller is used and
		its CLK/MOSI/MISO/CS pads in its bring-up code; the chip select is
		driven as a plain GPIO (software CS).

		The driver (arch/arm/src/common/ameba/ameba_spi.c) sits on the SDK
		fwlib register layer and drives the DesignWare SSI block in polling
		mode.

config AMEBA_PWM
	bool "PWM"
	default n
	select PWM
	---help---
		Expose the Ameba PWM timer as a NuttX PWM output at /dev/pwm0.  The
		chip has a single PWM-capable timer whose one time base feeds several
		compare channels, so every channel shares one frequency and each
		carries its own duty cycle (set CONFIG_PWM_NCHANNELS to the number of
		channels used).  The board selects which channel is routed to which
		pad in its bring-up code.

		The driver (arch/arm/src/common/ameba/ameba_pwm.c) sits on the SDK
		fwlib RTIM register layer and runs in polling task context.

config AMEBA_ADC
	bool "ADC"
	default n
	select ANALOG
	select ADC
	---help---
		Expose the Ameba SAR ADC as a NuttX ADC input at /dev/adc0.  The
		converter has one channel-switch list; the board selects which
		channels are sampled and which analog pad each external channel is
		wired to in its bring-up code.  Every channel is sampled, in list
		order, on each ANIOC_TRIGGER.

		The driver (arch/arm/src/common/ameba/ameba_adc.c) sits on the SDK
		fwlib register layer and reads the auto channel-switch FIFO by
		polling in task context (the chip does not enable a hardware
		software-trigger path).

config AMEBA_RTC
	bool "RTC"
	default n
	select RTC
	select RTC_DRIVER
	select RTC_DATETIME
	---help---
		Expose the Ameba on-chip real-time clock as a NuttX date/time RTC
		at /dev/rtc0 (rdtime/settime).  Enable RTC_ALARM as well to get a
		single one-shot alarm whose expiry fires the RTC interrupt and the
		registered upper-half callback.

		The driver (arch/arm/src/common/ameba/ameba_rtc.c) sits on the SDK
		fwlib RTC register layer.  The hardware keeps a year plus a
		day-of-year (no month/day register); the driver bridges that to the
		NuttX month/day calendar with the libc UTC calendar routines.

config AMEBA_WDG
	bool "Watchdog"
	default n
	select WATCHDOG
	---help---
		Expose the Ameba system watchdog as a NuttX watchdog at
		/dev/watchdog0 (start/stop/keepalive/settimeout, plus a capture
		pre-timeout callback).  The timeout is programmed directly in
		milliseconds.

		The driver (arch/arm/src/common/ameba/ameba_wdg.c) sits on the SDK
		fwlib WDG register layer.  The hardware cannot be halted once
		enabled, so stop() arms the WDG early interrupt and refreshes the
		counter from its handler to inhibit the reset.

config AMEBA_TIMER
	bool "Timer"
	default n
	select TIMER
	---help---
		Expose the Ameba general-purpose timers as NuttX timer devices at
		/dev/timerN (start/stop/settimeout/getstatus, plus a periodic
		expiration callback).  The timeout is programmed directly in
		microseconds.

		The driver (arch/arm/src/common/ameba/ameba_timer.c) is a
		parameterised lower half sitting on the SDK fwlib RTIM register
		layer; the board picks which of the twelve on-chip timers to expose
		via the per-chip instance table.  On the pke8721daf /dev/timer0 is
		TIM1 and /dev/timer1 is TIM2, both 32.768 kHz basic timers.  TIM0
		is reserved by the ROM as the system timer and is not exposed.

endmenu # Ameba Peripheral Support
```

## arch/arm/src/gd32w51x/Kconfig
```kconfig
# ##############################################################################
# arch/arm/src/gd32w51x/Kconfig
#
# SPDX-License-Identifier: Apache-2.0
#
# Licensed to the Apache Software Foundation (ASF) under one or more
# contributor license agreements.  See the NOTICE file distributed with
# this work for additional information regarding copyright ownership.  The
# ASF licenses this file to you under the Apache License, Version 2.0 (the
# "License"); you may not use this file except in compliance with the
# License.  You may obtain a copy of the License at
#
#   http://www.apache.org/licenses/LICENSE-2.0
#
# Unless required by applicable law or agreed to in writing, software
# distributed under the License is distributed on an "AS IS" BASIS, WITHOUT
# WARRANTIES OR CONDITIONS OF ANY KIND, either express or implied.  See the
# License for the specific language governing permissions and limitations
# under the License.
#
# ##############################################################################

comment "GD32W51x Configuration Options"

choice
	prompt "GD32W51x Chip Selection"
	default ARCH_CHIP_GD32W515PI
	depends on ARCH_CHIP_GD32W51X

config ARCH_CHIP_GD32W515PI
	bool "GD32W515PIQ6"
	---help---
		QFN56 package, 2048 KB SIP flash, 448 KB SRAM.
		Chip used on the GD-xD-W515-EVAL board.

config ARCH_CHIP_GD32W515TI
	bool "GD32W515TIQ6"
	---help---
		QFN36 package, 2048 KB SIP flash, 448 KB SRAM.

config ARCH_CHIP_GD32W515TG
	bool "GD32W515TGQ6"
	---help---
		QFN36 package, 1024 KB SIP flash, 384 KB SRAM.

endchoice # GD32W51x Chip Selection

menu "GD32W51x Peripheral Support"

config GD32W51X_USART0
	bool "USART0"
	default n
	select USART0_SERIALDRIVER
	select ARCH_HAVE_SERIAL_TERMIOS
	---help---
		USART0 on APB1 (45 MHz at 180 MHz SYSCLK).  Supports hardware flow
		control.  The pins are chosen by the board (board.h).

config GD32W51X_UART1
	bool "UART1"
	default n
	select UART1_SERIALDRIVER
	select ARCH_HAVE_SERIAL_TERMIOS
	---help---
		USART1 on APB1 (45 MHz at 180 MHz SYSCLK).  The UART1 name is
		shared with the GD32VW55x driver.  The pins are chosen by the
		board (board.h).

config GD32W51X_UART2
	bool "UART2"
	default n
	select UART2_SERIALDRIVER
	select ARCH_HAVE_SERIAL_TERMIOS
	---help---
		USART2 on APB2 (90 MHz at 180 MHz SYSCLK).  The UART2 name is
		shared with the GD32VW55x driver.  The pins are chosen by the
		board (board.h).

config GD32W51X_SERIAL_RXDMA_BUFFER_SIZE
	int "Rx DMA buffer size"
	default 64
	depends on SERIAL_RXDMA
	---help---
		Size of the circular buffer that the DMA fills with the received
		characters of each UART with Rx DMA (USART0_RXDMA, UART1_RXDMA,
		UART2_RXDMA).  They are handed to the serial driver at the half
		and the end of the buffer and when the line goes idle.

config GD32W51X_DMA
	bool "DMA"
	default n
	select ARCH_DMA
	---help---
		DMA0 and DMA1 controllers, 8 channels each.  Each channel selects
		one of 8 peripheral request lines and supports circular mode,
		burst transfers, a FIFO and memory-to-memory transfers.  SPI0
		is served by DMA1.

		The Wi-Fi data path uses DMA inside the prebuilt vendor
		libraries; this driver is for the peripherals.

config GD32W51X_GPIO_IRQ
	bool "GPIO interrupts (EXTI)"
	default n
	---help---
		Enable interrupt support on GPIO pins through the EXTI block
		(16 lines; 5..9 and 10..15 are shared vectors).

config GD32W51X_SPI
	bool
	select SPI

config GD32W51X_SPI0
	bool "SPI0"
	default n
	select GD32W51X_SPI
	---help---
		SPI0, on APB2.

config GD32W51X_SPI1
	bool "SPI1"
	default n
	select GD32W51X_SPI
	---help---
		SPI1, on APB1.  Its I2S mode (I2S1) is not supported.

config GD32W51X_QSPI
	bool "QSPI"
	default n
	---help---
		Quad-SPI controller in indirect mode (polled), for an external
		NOR flash (e.g. with the GD25 MTD driver in QSPI mode).  The QSPI
		is a secure peripheral: its pins are marked secure when it is
		initialized.

config GD32W51X_QSPI_DMA
	bool "QSPI DMA reads"
	default n
	depends on GD32W51X_QSPI && GD32W51X_DMA
	---help---
		Move the data of the longer reads with DMA1 channel 0 instead of
		polling the FIFO.  The calling thread sleeps until the transfer
		ends.

config GD32W51X_QSPI_DMATHRESHOLD
	int "QSPI DMA threshold (bytes)"
	default 64
	depends on GD32W51X_QSPI_DMA
	---help---
		Reads shorter than this are done by polling: setting up DMA costs
		more than moving a few bytes.

config GD32W51X_TSI
	bool "TSI"
	default n
	---help---
		Touch sensing interface (capacitive keys), polled in software
		trigger mode.

config GD32W51X_I2C0
	bool "I2C0"
	default n
	select GD32W51X_I2C
	select I2C

config GD32W51X_I2C1
	bool "I2C1"
	default n
	select GD32W51X_I2C
	select I2C

config GD32W51X_I2C
	bool
	default n

config GD32W51X_ADC
	bool "ADC"
	default n
	select ANALOG
	select ADC
	---help---
		Single ADC, 6/8/10/12-bit resolution.  9 external channels on
		the QFN56 parts, 5 on the QFN36 parts.

config GD32W51X_TIMER0
	bool "TIMER0 (advanced)"
	default n
	select GD32W51X_TIMER
	---help---
		Advanced-control timer: 4 channels, complementary outputs with
		dead-time insertion and a break input.

config GD32W51X_TIMER1
	bool "TIMER1"
	default n
	select GD32W51X_TIMER

config GD32W51X_TIMER2
	bool "TIMER2"
	default n
	select GD32W51X_TIMER

config GD32W51X_TIMER15
	bool "TIMER15"
	default n
	select GD32W51X_TIMER

config GD32W51X_TIMER16
	bool "TIMER16"
	default n
	select GD32W51X_TIMER

config GD32W51X_TIMER
	bool
	default n

config GD32W51X_FWDGT
	bool "Independent watchdog (FWDGT)"
	default n
	select WATCHDOG
	---help---
		Free watchdog timer, clocked from the IRC32K.  It keeps running
		in the low-power modes.

config GD32W51X_WWDGT
	bool "Window watchdog (WWDGT)"
	default n
	select WATCHDOG
	---help---
		Window watchdog, clocked from APB1.

config GD32W51X_PROGMEM
	bool "Program memory (internal flash)"
	default n
	select ARCH_HAVE_PROGMEM
	select ARCH_HAVE_PROGMEM_READ
	---help---
		Expose part of the internal flash through the up_progmem
		interface.

		Take care: the internal flash also holds the firmware itself.
		Only the region configured below is touched.

config GD32W51X_RNG
	bool "True random number generator (TRNG)"
	default n
	select ARCH_HAVE_RNG
	---help---
		Hardware TRNG, registered as /dev/random.  Note that its
		interrupt is shared with the hash accelerator (HAU).

config GD32W51X_CRC
	bool "Hardware CRC unit"
	default n
	---help---
		CRC-32 calculation unit.

endmenu # GD32W51x Peripheral Support

menu "SPI Configuration"
	depends on GD32W51X_SPI

config GD32W51X_SPI_DMA
	bool "SPI DMA"
	default n
	depends on GD32W51X_DMA
	---help---
		Use DMA for SPI transfers instead of interrupt-driven
		byte-by-byte exchanges.

config GD32W51X_SPI_DMATHRESHOLD
	int "SPI DMA threshold (bytes)"
	default 4
	depends on GD32W51X_SPI_DMA
	---help---
		Transfers shorter than this are done by polling: setting up DMA
		costs more than moving a few bytes.

endmenu # SPI Configuration

menu "I2C Configuration"
	depends on GD32W51X_I2C

config GD32W51X_I2C_TIMEOSEC
	int "Transfer timeout, seconds"
	default 0

config GD32W51X_I2C_TIMEOMS
	int "Transfer timeout, milliseconds"
	default 500

config GD32W51X_I2C_TIMEOTICKS
	int "Transfer timeout, system ticks"
	default 0
	---help---
		Overrides the seconds/milliseconds pair when non-zero.

endmenu # I2C Configuration

menu "ADC Configuration"
	depends on GD32W51X_ADC

config GD32W51X_ADC_CLOCK
	int "ADC clock (Hz)"
	default 11250000
	---help---
		Derived from PCLK2 (90 MHz) by a prescaler of 2/4/6/8.  The
		default is PCLK2/8 = 11.25 MHz, a conservative choice: the maximum
		ADC clock is not stated in the vendor documentation.

config GD32W51X_ADC_SAMPLETIME
	int "ADC sample time selector"
	default 4
	range 0 7
	---help---
		Sample time per channel, as the ADC_SAMPTx field encoding:
		0=3, 1=15, 2=28, 3=56, 4=84, 5=112, 6=144, 7=480 cycles.

		Note: a routine sequence takes at most 9 channels on this chip,
		not 16.

endmenu # ADC Configuration

menu "Timer Configuration"
	depends on GD32W51X_TIMER

config GD32W51X_PWM
	bool "PWM output"
	default n
	select PWM
	---help---
		Drive PWM through the timer output channels.  TIMER5 has no
		output channel and cannot be used.

config GD32W51X_CAPTURE
	bool "Input capture"
	default n
	select CAPTURE
	---help---
		Measure frequency and duty cycle on a timer input channel.

endmenu # Timer Configuration

menu "Watchdog Configuration"
	depends on GD32W51X_FWDGT || GD32W51X_WWDGT

config GD32W51X_FWDGT_DEFTIMOUT
	int "FWDGT default timeout (ms)"
	default 32760
	depends on GD32W51X_FWDGT
	---help---
		Clocked from the IRC32K; the longest timeout is about 32760 ms.

config GD32W51X_WWDGT_DEFTIMOUT
	int "WWDGT default timeout (ms)"
	default 26
	depends on GD32W51X_WWDGT
	---help---
		Clocked from APB1 (45 MHz); the longest timeout is about 46 ms.

endmenu # Watchdog Configuration

menu "Program memory Configuration"
	depends on GD32W51X_PROGMEM

config GD32W51X_PROGMEM_START_ADDR
	hex "Start address of the progmem region"
	default 0x081e0000
	---help---
		Absolute address of the first flash page handed to progmem.  It
		must be 4 KiB aligned (the erase page size).

		Nothing outside the region configured here is ever erased or
		written.  The default is the last 128 KiB of a 2 MiB part; the
		board linker script must not hand the same pages to the
		firmware.

config GD32W51X_PROGMEM_SIZE
	int "Size of the progmem region (bytes)"
	default 131072
	---help---
		Must be a multiple of 4096 (the erase page size).

endmenu # Program memory Configuration

menu "Power Management Configuration"
	depends on PM

config GD32W51X_PM_WAKEUP_MS
	int "Wake-up period in standby (ms)"
	default 1000
	range 0 32000
	depends on RTC
	---help---
		In the PM_STANDBY state the chip is in deep-sleep, where the
		system timer stops.  Besides any EXTI interrupt, the RTC wake-up
		timer ends the deep-sleep after this period, so that the timers
		still run, late by at most this period.  0 disables it.

config GD32W51X_PM_SERIAL_ACTIVITY
	int "PM serial activity"
	default 10
	---help---
		PM activity reported to the power management logic on every
		received character.

endmenu # Power Management Configuration
```
