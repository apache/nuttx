## arch/arm/src/stm32n6/Kconfig
```kconfig
#
# For a description of the syntax of this configuration file,
# see the file kconfig-language.txt in the NuttX tools repository.
#

if ARCH_CHIP_STM32N6

comment "STM32N6 Configuration Options"

config STM32_N6_PERIPHERALS
	bool
	default y
	select STM32_HAVE_IP_DMA_GPDMA
	select STM32_HAVE_IP_EXTI_M33M55_V1
	select STM32_HAVE_IP_GPIO_M33M55_V1
	select STM32_HAVE_IP_I2C_M33M55_V2
	select STM32_HAVE_IP_TIMERS_V3
	select STM32_HAVE_IP_USART_M33M55_V3
	select STM32_HAVE_IP_DBGMCU_V8
	select STM32_HAVE_IP_LPTIM_V2
	select STM32_HAVE_IP_RNG_V1
	select STM32_HAVE_IP_RTCC_M33M55_V1
	select STM32_HAVE_IP_WDG_V3
	select STM32_HAVE_DMA1
	select STM32_HAVE_DMA2
	select STM32_HAVE_GPDMA_SECURE
	select STM32_HAVE_I2C1
	select STM32_HAVE_I2C2
	select STM32_HAVE_I2C3
	select STM32_HAVE_I2C4
	select STM32_HAVE_LPTIM1
	select STM32_HAVE_LPTIM2
	select STM32_HAVE_LPTIM3
	select STM32_HAVE_LPTIM4
	select STM32_HAVE_LPTIM5
	select STM32_HAVE_RNG
	select STM32_HAVE_RTC
	select STM32_HAVE_RTC_MAGIC
	select STM32_HAVE_RTC_SUBSECONDS
	select STM32_HAVE_TIM1
	select STM32_HAVE_TIM2
	select STM32_HAVE_TIM3
	select STM32_HAVE_TIM4
	select STM32_HAVE_TIM5
	select STM32_HAVE_TIM6
	select STM32_HAVE_TIM7
	select STM32_HAVE_TIM8
	select STM32_HAVE_TIM9
	select STM32_HAVE_TIM10
	select STM32_HAVE_TIM11
	select STM32_HAVE_TIM12
	select STM32_HAVE_TIM13
	select STM32_HAVE_TIM14
	select STM32_HAVE_TIM15
	select STM32_HAVE_TIM16
	select STM32_HAVE_TIM17
	select STM32_HAVE_TIM2_32BITS
	select STM32_HAVE_TIM5_32BITS
	select STM32_HAVE_LPUART1
	select STM32_HAVE_USART1
	select STM32_HAVE_USART2
	select STM32_HAVE_USART3
	select STM32_HAVE_UART4
	select STM32_HAVE_UART5
	select STM32_HAVE_USART6
	select STM32_HAVE_UART7
	select STM32_HAVE_UART8
	select STM32_HAVE_UART9
	select STM32_HAVE_USART10
	select STM32_USART1_HAVE_RXDMA if STM32_DMA1 || STM32_DMA2
	select STM32_USART2_HAVE_RXDMA if STM32_DMA1 || STM32_DMA2
	select STM32_USART3_HAVE_RXDMA if STM32_DMA1 || STM32_DMA2
	select STM32_UART4_HAVE_RXDMA if STM32_DMA1 || STM32_DMA2
	select STM32_UART5_HAVE_RXDMA if STM32_DMA1 || STM32_DMA2
	select STM32_USART6_HAVE_RXDMA if STM32_DMA1 || STM32_DMA2
	select STM32_UART7_HAVE_RXDMA if STM32_DMA1 || STM32_DMA2
	select STM32_UART8_HAVE_RXDMA if STM32_DMA1 || STM32_DMA2

config STM32_STM32N6XXXX
	bool
	default y

choice
	prompt "STM32 N6 Chip Selection"
	default ARCH_CHIP_STM32N657X0
	depends on ARCH_CHIP_STM32N6

config ARCH_CHIP_STM32N657X0
	bool "STM32N657X0"
	select STM32_STM32N6XXXX

endchoice

config STM32N6_DEBUG
	bool "Enable debugger access after boot"
	default n
	---help---
		Reopen secure and non-secure debugger access at the current hardware
		protection level early in startup.  The boot ROM can close this access
		when booting from external flash.  Enable this option for development
		to attach without switching to DEV boot mode.  This changes runtime
		BSEC registers only, not OTP fuses.

endif # ARCH_CHIP_STM32N6
```

## arch/arm/src/stm32u0/Kconfig
```kconfig
#
# For a description of the syntax of this configuration file,
# see the file kconfig-language.txt in the NuttX tools repository.
#
comment "STM32 U0 configuration"

if ARCH_CHIP_STM32U0

choice
	prompt "ST STM32U0 Chip Selection"
	default ARCH_CHIP_STM32U083RC
	depends on ARCH_CHIP_STM32U0

config ARCH_CHIP_STM32U073C8
	bool "STM32U073C8"
	select STM32_STM32U073
	select STM32_FLASH_CONFIG_8
	depends on ARCH_CHIP_STM32U0
	---help---
		STM32 U0 Cortex M0+, 64 Kb FLASH, 40 Kb SRAM

config ARCH_CHIP_STM32U073CB
	bool "STM32U073CB"
	select STM32_STM32U073
	select STM32_FLASH_CONFIG_B
	depends on ARCH_CHIP_STM32U0
	---help---
		STM32 U0 Cortex M0+, 128 Kb FLASH, 40 Kb SRAM

config ARCH_CHIP_STM32U073CC
	bool "STM32U073CC"
	select STM32_STM32U073
	select STM32_FLASH_CONFIG_C
	depends on ARCH_CHIP_STM32U0
	---help---
		STM32 U0 Cortex M0+, 256 Kb FLASH, 40 Kb SRAM

config ARCH_CHIP_STM32U073M8
	bool "STM32U073M8"
	select STM32_STM32U073
	select STM32_FLASH_CONFIG_8
	depends on ARCH_CHIP_STM32U0
	---help---
		STM32 U0 Cortex M0+, 64 Kb FLASH, 40 Kb SRAM

config ARCH_CHIP_STM32U073MB
	bool "STM32U073MB"
	select STM32_STM32U073
	select STM32_FLASH_CONFIG_B
	depends on ARCH_CHIP_STM32U0
	---help---
		STM32 U0 Cortex M0+, 128 Kb FLASH, 40 Kb SRAM

config ARCH_CHIP_STM32U073MC
	bool "STM32U073MC"
	select STM32_STM32U073
	select STM32_FLASH_CONFIG_C
	depends on ARCH_CHIP_STM32U0
	---help---
		STM32 U0 Cortex M0+, 256 Kb FLASH, 40 Kb SRAM

config ARCH_CHIP_STM32U073R8
	bool "STM32U073R8"
	select STM32_STM32U073
	select STM32_FLASH_CONFIG_8
	depends on ARCH_CHIP_STM32U0
	---help---
		STM32 U0 Cortex M0+, 64 Kb FLASH, 40 Kb SRAM

config ARCH_CHIP_STM32U073RB
	bool "STM32U073RB"
	select STM32_STM32U073
	select STM32_FLASH_CONFIG_B
	depends on ARCH_CHIP_STM32U0
	---help---
		STM32 U0 Cortex M0+, 128 Kb FLASH, 40 Kb SRAM

config ARCH_CHIP_STM32U073RC
	bool "STM32U073RC"
	select STM32_STM32U073
	select STM32_FLASH_CONFIG_C
	depends on ARCH_CHIP_STM32U0
	---help---
		STM32 U0 Cortex M0+, 256 Kb FLASH, 40 Kb SRAM

config ARCH_CHIP_STM32U083CC
	bool "STM32U083CC"
	select STM32_STM32U083
	select STM32_FLASH_CONFIG_C
	depends on ARCH_CHIP_STM32U0
	---help---
		STM32 U0 Cortex M0+, 256 Kb FLASH, 40 Kb SRAM

config ARCH_CHIP_STM32U083MC
	bool "STM32U083MC"
	select STM32_STM32U083
	select STM32_FLASH_CONFIG_C
	depends on ARCH_CHIP_STM32U0
	---help---
		STM32 U0 Cortex M0+, 256 Kb FLASH, 40 Kb SRAM

config ARCH_CHIP_STM32U083RC
	bool "STM32U083RC"
	select STM32_STM32U083
	select STM32_FLASH_CONFIG_C
	depends on ARCH_CHIP_STM32U0
	---help---
		STM32 U0 Cortex M0+, 256 Kb FLASH, 40 Kb SRAM

endchoice

endif

config STM32_STM32U0
	bool
	default n
	select STM32_HAVE_DMA1
	select STM32_HAVE_USART1
	select STM32_HAVE_USART2
	select STM32_HAVE_I2C1
	select STM32_HAVE_I2C2
	select STM32_HAVE_I2C3
	select STM32_HAVE_SPI1
	select STM32_HAVE_SPI2
	select STM32_HAVE_DMAMUX
	select STM32_HAVE_CRC
	select STM32_HAVE_PWR
	select STM32_HAVE_BKP
	select STM32_HAVE_BKPSRAM
	select STM32_HAVE_SYSCFG
	select STM32_HAVE_CRS
	select STM32_HAVE_HSI48
	select STM32_HAVE_LPUART1
	select STM32_HAVE_LPUART2
	select STM32_HAVE_TIM1
	select STM32_HAVE_TIM2
	select STM32_HAVE_TIM3
	select STM32_HAVE_TIM6
	select STM32_HAVE_TIM7
	select STM32_HAVE_TIM15
	select STM32_HAVE_TIM16
	select STM32_HAVE_LPTIM1
	select STM32_HAVE_LPTIM2
	select STM32_HAVE_IP_ADC_M0_V1
	select STM32_HAVE_IP_AES_M0_V1 if STM32_HAVE_AES
	select STM32_HAVE_IP_COMP_M0_V1 if STM32_HAVE_COMP
	select STM32_HAVE_IP_DAC_M0_V1 if STM32_HAVE_DAC1
	select STM32_HAVE_IP_DBGMCU_M0_V1
	select STM32_HAVE_IP_DMA_V1
	select STM32_HAVE_IP_DMA_V1_7CH_DMAMUX
	select STM32_HAVE_IP_EXTI_V2
	select STM32_HAVE_IP_FLASH_M0_V1
	select STM32_HAVE_IP_GPIO_M0_V1
	select STM32_HAVE_IP_HSI48_M0_V1
	select STM32_HAVE_IP_I2C_M0_V1
	select STM32_HAVE_IP_PWR_G0
	select STM32_HAVE_IP_RNG_M0_V1 if STM32_HAVE_RNG
	select STM32_HAVE_IP_RTCC_M0_V1
	select STM32_HAVE_IP_SPI_V2
	select STM32_HAVE_IP_TIMERS_M0_V1
	select STM32_HAVE_IP_USART_V4
	select STM32_HAVE_IP_WDG_M0_V1

config STM32_STM32U073
	bool
	default n
	select STM32_STM32U0
	select STM32_HAVE_DMA2
	select STM32_HAVE_USART3
	select STM32_HAVE_USART4
	select STM32_HAVE_LPUART3
	select STM32_HAVE_LPTIM3
	select STM32_HAVE_I2C4
	select STM32_HAVE_SPI3
	select STM32_HAVE_RNG
	select STM32_HAVE_DAC1
	select STM32_HAVE_COMP1
	select STM32_HAVE_COMP2
	select STM32_HAVE_TSC
	select STM32_HAVE_LCD

config STM32_STM32U083
	bool
	default n
	select STM32_STM32U0
	select STM32_HAVE_DMA2
	select STM32_HAVE_USART3
	select STM32_HAVE_USART4
	select STM32_HAVE_LPUART3
	select STM32_HAVE_LPTIM3
	select STM32_HAVE_I2C4
	select STM32_HAVE_SPI3
	select STM32_HAVE_RNG
	select STM32_HAVE_AES
	select STM32_HAVE_DAC1
	select STM32_HAVE_COMP1
	select STM32_HAVE_COMP2
	select STM32_HAVE_TSC
	select STM32_HAVE_LCD
```

## arch/arm/src/stm32u3/Kconfig
```kconfig
#
# For a description of the syntax of this configuration file,
# see the file kconfig-language.txt in the NuttX tools repository.
#

if ARCH_CHIP_STM32U3

comment "STM32U3 Configuration Options"

config STM32_U3_PERIPHERALS
	bool
	default y
	select STM32_HAVE_IP_EXTI_M33_V1
	select STM32_HAVE_IP_GPIO_M33_V1
	select STM32_HAVE_IP_USART_M33_V3
	select STM32_HAVE_SYSCFG
	select STM32_HAVE_USART1
	select STM32_HAVE_USART2
	select STM32_HAVE_USART3
	select STM32_HAVE_UART4
	select STM32_HAVE_UART5
	select STM32_HAVE_LPUART1

choice
	prompt "STM32U3 Chip Selection"
	default ARCH_CHIP_STM32U3C5ZI

config ARCH_CHIP_STM32U3C5ZI
	bool "STM32U3C5ZI"
	select STM32_STM32U3C5XX
	select STM32U3_IO_CONFIG_Z
	---help---
		STM32U3 Cortex-M33, 2048 KiB flash, 640 KiB SRAM, LQFP144.

endchoice

config STM32_STM32U3C5XX
	bool
	select ARCH_HAVE_FPU

config STM32U3_IO_CONFIG_Z
	bool

endif # ARCH_CHIP_STM32U3
```

## arch/arm64/src/qemu/Kconfig
```kconfig
#
# For a description of the syntax of this configuration file,
# see the file kconfig-language.txt in the NuttX tools repository.
#

if ARCH_CHIP_QEMU

menu "Qemu Virt Chip Selection"

choice
	prompt "Qemu Core Configuration"
	default ARCH_CHIP_QEMU_A53

config ARCH_CHIP_QEMU_A53
	bool "Qemu virtual Processor (cortex-a53)"
	select ARCH_HAVE_MULTICPU
	select ARMV8A_HAVE_GICv3
	select ARM64_HAVE_PSCI
	select ARCH_CORTEX_A53

config ARCH_CHIP_QEMU_A57
	bool "Qemu virtual Processor (cortex-a57)"
	select ARCH_HAVE_MULTICPU
	select ARMV8A_HAVE_GICv3
	select ARM64_HAVE_PSCI
	select ARCH_CORTEX_A57

config ARCH_CHIP_QEMU_A72
	bool "Qemu virtual Processor (cortex-a72)"
	select ARCH_HAVE_MULTICPU
	select ARMV8A_HAVE_GICv3
	select ARM64_HAVE_PSCI
	select ARCH_CORTEX_A72

config ARCH_CHIP_QEMU_UNKNOWN
	bool "Qemu virtual Processor (unknown CPU)"
	select ARCH_HAVE_MULTICPU
	select ARMV8A_HAVE_GICv3
	select ARM64_HAVE_PSCI
	select ARCH_CPU_UNKNOWN

endchoice # Qemu Chip Selection

config ARCH_CHIP_QEMU_WITH_HV
	bool "Qemu with hypervisor (e.g. kvm, hvf)"
	default n

endmenu # "Qemu Chip Selection"

config QEMU_RTC_PL031_BASE
	hex "PL031 RTC base address"
	default 0x09010000
	depends on RTC_PL031
	---help---
		Physical address of the PL031 RTC of the QEMU virt machine.

config QEMU_RTC_PL031_IRQ
	int "PL031 RTC interrupt"
	default 34
	depends on RTC_PL031
	---help---
		Interrupt of the PL031 RTC of the QEMU virt machine (SPI 2).

config QEMU_RTC_PL031_SYNC
	bool "Start the system time at an RTC second boundary"
	default n
	depends on RTC_PL031
	---help---
		The PL031 counts whole seconds, so the system time starts up to a
		second behind the host.  Files that the host writes then look
		up to a second in the future, and make warns about clock skew.
		With this option the boot waits (up to a second) for the RTC
		second to change, so the time is correct to a few milliseconds.

endif # ARCH_CHIP_QEMU
```

## arch/rh850/Kconfig
```kconfig
#
# For a description of the syntax of this configuration file,
# see the file kconfig-language.txt in the NuttX tools repository.
#

if ARCH_RH850
comment "RH850 Options"

choice
	prompt "RH850 chip selection"
	default ARCH_CHIP_R7F702600

config ARCH_CHIP_R7F702600
	bool "R7F702600 (RH850/U2C8)"
	select ARCH_CHIP_U2C
	---help---
		Renesas RH850/U2C8 microcontroller, CPU0 (G4KH core).

endchoice

config ARCH_CHIP_U2C
	bool
	select ARCH_RH850_G4KH
	select ALARM_ARCH
	select ONESHOT
	select ONESHOT_COUNT

config ARCH_RH850_G4KH
	bool
	select ARCH_HAVE_FPU
	---help---
		RH850 G4KH CPU core with the single and double precision FPU.

config ARCH_CHIP
	string
	default "u2c"		if ARCH_CHIP_U2C

config RH850_CLK_HSB_FREQUENCY
	int "CLKC_HSB frequency (Hz)"
	default 20000000
	---help---
		Frequency of CLKC_HSB, the clock of RLIN3 and OSTM (QEMU rh850-u2c
		machine property clk-hsb, default 20 MHz).

menu "RH850 Peripheral Selection"

config RH850_RLIN311
	bool "RLIN311 (UART0)"
	default y
	select UART0_SERIALDRIVER
	---help---
		RLIN3 unit 11 in UART mode, UART0 (QEMU serial0).

config RH850_OSTM0_PRIORITY
	int "OSTM0 interrupt priority (0 highest, 15 lowest)"
	default 1
	range 0 15
	---help---
		EIP of the system timer interrupt (OSTM0, channel 63).

endmenu

endif # ARCH_RH850
```

## arch/risc-v/src/ab32vg1/Kconfig
```kconfig
#
# For a description of the syntax of this configuration file,
# see the file kconfig-language.txt in the NuttX tools repository.
#

comment "AB32VG1 Configuration Options"

config AB32VG1_SYSCLK_MHZ
	int "System clock frequency (MHz)"
	default 48
	range 24 120
	---help---
		The system clock is PLL0 (240 MHz) divided by an integer, so the
		valid values are 24, 30, 40, 48, 60, 80 and 120.  48 MHz is the
		frequency used by the mask ROM and by the RT-Thread BSP.

menu "AB32VG1 Peripheral Support"

config AB32VG1_UART0
	bool "UART0"
	default y
	select UART0_SERIALDRIVER
	select ARCH_HAVE_SERIAL_TERMIOS
	---help---
		UART0 in single-wire mode on PA7 (TX0 group G1, RX mapped to the
		TX pin).  On the AB32VG1 development boards this is the pin wired
		to the USB-serial bridge and used by the mask ROM UART loader.

config AB32VG1_UART0_ROMKEY
	bool "Reboot into the ROM loader on the download key"
	default y
	depends on AB32VG1_UART0
	---help---
		Watch the UART0 receive stream for the key sent by host download
		tools (F5 A0 A5 96 87 5A) and reset the chip when it is seen, so
		that the mask ROM UART loader can take over without pressing the
		reset button.

endmenu
```

## arch/risc-v/src/eic7700x/Kconfig
```kconfig
#
# For a description of the syntax of this configuration file,
# see the file kconfig-language.txt in the NuttX tools repository.
#

comment "EIC7700X Configuration Options"

config EIC7700X_CLK
	bool "CRG clock provider"
	default y
	select CLK
	---help---
		Register the Clock and Reset Generator (CRG) clock tree with the
		NuttX clock framework.  Registration itself writes nothing: the
		tree comes up describing the PLL, mux, divider and gate
		configuration the boot loader left behind.  The tree is visible
		through /proc/clk when procfs is enabled.

		A clock moves only when a driver asks it to, by enabling a gate,
		setting a divider, or reparenting a mux.  A mux that carries a
		clock the system is running on will speed up on request but
		refuses to slow down, since that would change the timing every
		driver downstream was configured for while they are using it.

config EIC7700X_CPUCLK
	bool "CPU core clock control"
	default n
	select EIC7700X_CLK
	---help---
		Measure and set the speed of the four application cores.

		The measurement is real: it counts core cycles against the
		crystal-derived time counter rather than decoding the PLL,
		because the manual and the vendor disagree by a factor of two
		about which PLL output the cores run from.

if EIC7700X_CPUCLK

config EIC7700X_CPU_FREQ_MHZ
	int "CPU clock at boot (MHz)"
	default 1400
	---help---
		Where to put the cores at boot, from the vendor's validated
		set: 400, 500, 600, 700, 800, 1000, 1100, 1200, 1300 or 1400.
		Every one of them runs at the same core voltage, so no
		regulator is involved.  The boot firmware already leaves the
		cores at 1400, so the default changes nothing and merely says
		so in the log.

endif
```
