## arch/arm/src/rzv2h/Kconfig
```kconfig
#
# For a description of the syntax of this configuration file,
# see the file kconfig-language.txt in the NuttX tools repository.
#

menu "RZ/V2H Configuration Options"

choice
	prompt "RZ/V2H Core Configuration"
	default ARCH_CHIP_R9A09G057

config ARCH_CHIP_R9A09G057
	bool "RZ/V2H Processor (cortex-r8)"
	select ARCH_CORTEXR8
	select ARCH_HAVE_FPU
	select ARCH_HAVE_THUMB
	select ARCH_HAVE_DPFPU
	select ARMV7R_HAVE_GICv2
	select ARCH_HAVE_MPU
	select ARCH_IRQPRIO
	select RZV2H_HAVE_SCI_B_UART0
	select RZV2H_HAVE_SCI_B_UART1
	select RZV2H_HAVE_SCI_B_UART2
	select RZV2H_HAVE_SCI_B_UART3
	select RZV2H_HAVE_SCI_B_UART4
	select RZV2H_HAVE_SCI_B_UART5
	select RZV2H_HAVE_SCI_B_UART6
	select RZV2H_HAVE_SCI_B_UART7
	select RZV2H_HAVE_SCI_B_UART8
	select RZV2H_HAVE_SCI_B_UART9
	---help---
		RZ/V2H family of Renesas MPUs cortex-r8

endchoice # RZ/V2H Chip Selection

config RZV2H_CORTEXR8_0
	bool "Build for CR8_0 core"
	---help---
		Build for the CR8_0 core of the RZV2H.
		This is the default core for the EVK-RZV2H board.

config RZV2H_GPIO
	bool "GPIO support"
	default y
	depends on DEV_GPIO
	---help---
		Enable support for GPIO pins.

# Peripheral
config RZV2H_SCI_B
	bool
	default n

config RZV2H_HAVE_SCI_B_UART0
	bool
	default n

config RZV2H_HAVE_SCI_B_UART1
	bool
	default n

config RZV2H_HAVE_SCI_B_UART2
	bool
	default n

config RZV2H_HAVE_SCI_B_UART3
	bool
	default n

config RZV2H_HAVE_SCI_B_UART4
	bool
	default n

config RZV2H_HAVE_SCI_B_UART5
	bool
	default n

config RZV2H_HAVE_SCI_B_UART6
	bool
	default n

config RZV2H_HAVE_SCI_B_UART7
	bool
	default n

config RZV2H_HAVE_SCI_B_UART8
	bool
	default n

config RZV2H_HAVE_SCI_B_UART9
	bool
	default n

menuconfig RZV2H_UART_SCI
	bool "SCI-B UART support"
	default y
	select RZV2H_SCI_B
	select ARCH_HAVE_SERIAL_TERMIOS
	---help---
		Enable the RZ/V2H SCI-B UART driver. Select this option to
		configure the individual SCI-B UART channels.

if RZV2H_UART_SCI

config RZV2H_SCI_B_IRQ_PRIORITY
	int "SCI-B interrupt priority"
	range 0 15
	default 12
	---help---
		Set the GIC interrupt priority used by all enabled SCI-B UART
		channels. Zero is the highest priority and 15 is the lowest.

menu "SCI-B UART optional features"

config RZV2H_SCI_B_FLOW_CONTROL
	bool "Flow control support (not implemented)"
	default n
	---help---
		Configuration support for SCI-B CTS/RTS hardware flow
		control.

config RZV2H_SCI_B_DMA
	bool "DMA transfer support (not implemented)"
	default n
	---help---
		Configuration support for SCI-B DMA transfers.

config RZV2H_SCI_B_FIFO
	bool "FIFO support (not implemented)"
	default n
	---help---
		Configuration support for SCI-B hardware FIFOs.

endmenu # "SCI-B UART optional features"

config RZV2H_SCI_B_UART0
	bool "SCI_B UART 0"
	default n
	depends on RZV2H_HAVE_SCI_B_UART0
	select SCI0_SERIALDRIVER

config RZV2H_SCI_B_UART1
	bool "SCI_B UART 1"
	default n
	depends on RZV2H_HAVE_SCI_B_UART1
	select SCI1_SERIALDRIVER

config RZV2H_SCI_B_UART2
	bool "SCI_B UART 2"
	default n
	depends on RZV2H_HAVE_SCI_B_UART2
	select SCI2_SERIALDRIVER

config RZV2H_SCI_B_UART3
	bool "SCI_B UART 3"
	default n
	depends on RZV2H_HAVE_SCI_B_UART3
	select SCI3_SERIALDRIVER

config RZV2H_SCI_B_UART4
	bool "SCI_B UART 4"
	default n
	depends on RZV2H_HAVE_SCI_B_UART4
	select SCI4_SERIALDRIVER

config RZV2H_SCI_B_UART5
	bool "SCI_B UART 5"
	default n
	depends on RZV2H_HAVE_SCI_B_UART5
	select SCI5_SERIALDRIVER

config RZV2H_SCI_B_UART6
	bool "SCI_B UART 6"
	default n
	depends on RZV2H_HAVE_SCI_B_UART6
	select SCI6_SERIALDRIVER

config RZV2H_SCI_B_UART7
	bool "SCI_B UART 7"
	default n
	depends on RZV2H_HAVE_SCI_B_UART7
	select SCI7_SERIALDRIVER

config RZV2H_SCI_B_UART8
	bool "SCI_B UART 8"
	default n
	depends on RZV2H_HAVE_SCI_B_UART8
	select SCI8_SERIALDRIVER

config RZV2H_SCI_B_UART9
	bool "SCI_B UART 9"
	default n
	depends on RZV2H_HAVE_SCI_B_UART9
	select SCI9_SERIALDRIVER

endif # RZV2H_UART_SCI

config RZV2H_UBOOT_IMAGE
	bool "Generate split CR8_0 U-Boot images"
	default n
	depends on RZV2H_CORTEXR8_0
	---help---
		Link the low-vector table at its ITCM run address, with its load copy
		at the start of RCPU SRAM, and generate the raw image nuttx_uboot.bin
		(the table's load copy, code and data) after linking.  U-Boot loads
		it at CONFIG_RAM_START.  CR8_0 takes its reset vector from ITCM, so
		U-Boot also writes a two-word trampoline into ITCM through its AXI
		alias before releasing CR8_0 from reset:

		  mw.l 0x12040000 0xe51ff004   (ldr pc, [pc, #-4])
		  mw.l 0x12040004 0x08180000   (start of nuttx_uboot.bin)

		NuttX replaces the trampoline with the full vector table at boot.

		Leave this disabled for debugger loading.  In that layout the vector
		table is linked into SRAM and copied to ITCM by the NuttX startup
		code after the debugger enters the firmware at __start.

endmenu # "RZ/V2H Configuration Options"
```

## arch/arm/src/stm32c5/Kconfig
```kconfig
#
# For a description of the syntax of this configuration file,
# see the file kconfig-language.txt in the NuttX tools repository.
#

if ARCH_CHIP_STM32C5

comment "STM32C5 Configuration Options"

config STM32_C5_PERIPHERALS
	bool
	default y
	select ARCH_HAVE_FPU
	select STM32_HAVE_IP_EXTI_M33_V1
	select STM32_HAVE_IP_GPIO_M33_V1
	select STM32_HAVE_IP_USART_M33_V3
	select STM32_HAVE_LPUART1
	select STM32_HAVE_UART4
	select STM32_HAVE_UART5
	select STM32_HAVE_USART1
	select STM32_HAVE_USART2
	select STM32_HAVE_USART3

choice
	prompt "STM32 C5 Chip Selection"
	default ARCH_CHIP_STM32C562RE
	depends on ARCH_CHIP_STM32C5

config ARCH_CHIP_STM32C562CE
	bool "STM32C562CE"
	select STM32_FLASH_CONFIG_E
	select STM32C5_IO_CONFIG_C
	---help---
		STM32C5 Cortex-M33, 512 KiB flash, 128 KiB SRAM, 48 pins.

config ARCH_CHIP_STM32C562KE
	bool "STM32C562KE"
	select STM32_FLASH_CONFIG_E
	select STM32C5_IO_CONFIG_K
	---help---
		STM32C5 Cortex-M33, 512 KiB flash, 128 KiB SRAM, 32 pins.

config ARCH_CHIP_STM32C562ME
	bool "STM32C562ME"
	select STM32_FLASH_CONFIG_E
	select STM32C5_IO_CONFIG_M
	---help---
		STM32C5 Cortex-M33, 512 KiB flash, 128 KiB SRAM, 80 pins.

config ARCH_CHIP_STM32C562RE
	bool "STM32C562RE"
	select STM32_FLASH_CONFIG_E
	select STM32C5_IO_CONFIG_R
	---help---
		STM32C5 Cortex-M33, 512 KiB flash, 128 KiB SRAM, 64 pins.

config ARCH_CHIP_STM32C562VE
	bool "STM32C562VE"
	select STM32_FLASH_CONFIG_E
	select STM32C5_IO_CONFIG_V
	---help---
		STM32C5 Cortex-M33, 512 KiB flash, 128 KiB SRAM, 100 pins.

endchoice # STM32 C5 Chip Selection

# Pin/package configurations

config STM32C5_IO_CONFIG_K
	# Package designator K
	bool
	default n

config STM32C5_IO_CONFIG_C
	# Package designator C
	bool
	default n

config STM32C5_IO_CONFIG_R
	# Package designator R
	bool
	default n

config STM32C5_IO_CONFIG_M
	# Package designator M
	bool
	default n

config STM32C5_IO_CONFIG_V
	# Package designator V
	bool
	default n

endif # ARCH_CHIP_STM32C5
```

## arch/arm/src/stm32h5/Kconfig
```kconfig
#
# For a description of the syntax of this configuration file,
# see the file kconfig-language.txt in the NuttX tools repository.
#

if ARCH_CHIP_STM32H5

comment "STM32H5 Configuration Options"

config STM32_H5_PERIPHERALS
	bool
	default y
	select STM32_HAVE_DMA1
	select STM32_HAVE_DMA2
	select STM32_HAVE_I2C1
	select STM32_HAVE_I2C2
	select STM32_HAVE_LPTIM1
	select STM32_HAVE_LPTIM2
	select STM32_HAVE_LPTIM3
	select STM32_HAVE_LPTIM4
	select STM32_HAVE_LPTIM5
	select STM32_HAVE_RNG
	select STM32_HAVE_SPI1
	select STM32_HAVE_SPI2
	select STM32_HAVE_SPI3
	select STM32_HAVE_SYSCFG
	select STM32_HAVE_DTS
	select STM32_HAVE_USBFS_MODE
	select STM32_HAVE_USBDRD_HOST
	select STM32_HAVE_ADC_H5
	select STM32_HAVE_USART_H5
	select STM32_HAVE_USART_WUS
	select STM32_HAVE_I2C_H5
	select STM32_HAVE_CRC
	select STM32_HAVE_IP_WDG_M3M4_V1

choice
	prompt "STM32 H5 Chip Selection"
	default ARCH_CHIP_STM32H563ZI
	depends on ARCH_CHIP_STM32H5

config ARCH_CHIP_STM32H503RB
	bool "STM32H503RB"
	select ARCH_CORTEXM33
	select STM32_STM32H5XXXX
	select STM32_STM32H50XXX
	select STM32_FLASH_CONFIG_B
	select STM32H5_IO_CONFIG_R
	---help---
		STM32 H5 Cortex M33, 128 Kb FLASH, 32 Kb SRAM

config ARCH_CHIP_STM32H533RE
	bool "STM32H533RE"
	select ARCH_CORTEXM33
	select STM32_STM32H5XXXX
	select STM32_STM32H53XXX
	select STM32_FLASH_CONFIG_E
	select STM32H5_IO_CONFIG_R
	---help---
		STM32 H5 Cortex M33, 512 Kb FLASH, 272 Kb SRAM

config ARCH_CHIP_STM32H563ZI
	bool "STM32H563ZI"
	select ARCH_CORTEXM33
	select STM32_STM32H5XXXX
	select STM32_STM32H56XXX
	select STM32_STM32H563XX
	select STM32_FLASH_CONFIG_I
	select STM32H5_IO_CONFIG_Z
	---help---
		STM32 H5 Cortex M33, 2 Mb FLASH, 640 Kb SRAM

endchoice # STM32 H5 Chip Selection

# Chip families:

config STM32_STM32H5XXXX
	bool
	default n
	select ARCH_HAVE_FPU
	select STM32_HAVE_ICACHE

config STM32_STM32H50XXX
	bool
	default n
	select STM32_HAVE_FDCAN1
	select STM32_HAVE_TIM1
	select STM32_HAVE_TIM2
	select STM32_HAVE_TIM3
	select STM32_HAVE_TIM6
	select STM32_HAVE_TIM7
	select STM32_HAVE_LPUART1
	select STM32_HAVE_USART1
	select STM32_HAVE_USART2
	select STM32_HAVE_USART3
	select STM32_HAVE_USBFS
	select STM32_HAVE_HSI48

config STM32_STM32H53XXX
	bool
	default n
	select STM32_HAVE_I2C3
	select STM32_HAVE_QSPI1
	select STM32_HAVE_FDCAN1
	select STM32_HAVE_FDCAN2
	select STM32_HAVE_TIM1
	select STM32_HAVE_TIM2
	select STM32_HAVE_TIM3
	select STM32_HAVE_TIM4
	select STM32_HAVE_TIM5
	select STM32_HAVE_TIM6
	select STM32_HAVE_TIM7
	select STM32_HAVE_TIM8
	select STM32_HAVE_TIM12
	select STM32_HAVE_TIM15
	select STM32_HAVE_LPUART1
	select STM32_HAVE_USART1
	select STM32_HAVE_USART2
	select STM32_HAVE_USART3
	select STM32_HAVE_UART4
	select STM32_HAVE_UART5
	select STM32_HAVE_USART6
	select STM32_HAVE_SPI4
	select STM32_HAVE_USBFS
	select STM32_HAVE_HSI48
	select STM32_HAVE_ICACHE_REMAP

config STM32_STM32H56XXX
	bool
	default n
	select STM32_HAVE_I2C3
	select STM32_HAVE_QSPI1
	select STM32_HAVE_CORDIC
	select STM32_HAVE_FDCAN1
	select STM32_HAVE_FDCAN2
	select STM32_HAVE_IP_CORDIC_M3M4_V1
	select STM32_HAVE_TIM1
	select STM32_HAVE_TIM2
	select STM32_HAVE_TIM3
	select STM32_HAVE_TIM4
	select STM32_HAVE_TIM5
	select STM32_HAVE_TIM6
	select STM32_HAVE_TIM7
	select STM32_HAVE_TIM8
	select STM32_HAVE_TIM12
	select STM32_HAVE_TIM13
	select STM32_HAVE_TIM14
	select STM32_HAVE_TIM15
	select STM32_HAVE_TIM16
	select STM32_HAVE_TIM17
	select STM32_HAVE_LPUART1
	select STM32_HAVE_USART1
	select STM32_HAVE_USART2
	select STM32_HAVE_USART3
	select STM32_HAVE_UART4
	select STM32_HAVE_UART5
	select STM32_HAVE_USART6
	select STM32_HAVE_UART7
	select STM32_HAVE_UART8
	select STM32_HAVE_UART9
	select STM32_HAVE_USART10
	select STM32_HAVE_USART11
	select STM32_HAVE_UART12
	select STM32_HAVE_SPI4
	select STM32_HAVE_SPI5
	select STM32_HAVE_SPI6
	select STM32_HAVE_I2C4
	select STM32_HAVE_USBFS
	select STM32_HAVE_HSI48
	select STM32_HAVE_SDMMC1
	select STM32_HAVE_SDMMC2
	select STM32_HAVE_ICACHE_REMAP

config STM32_STM32H563XX
	# STM32H552 and STM32H562 devices documented in RM0439
	bool
	default n
	select STM32_HAVE_ETHERNET

# Pin/package configurations

config STM32H5_IO_CONFIG_K
	# Package designator K
	bool
	default n

config STM32H5_IO_CONFIG_T
	# Package designator T
	bool
	default n

config STM32H5_IO_CONFIG_C
	# Package designator C
	bool
	default n

config STM32H5_IO_CONFIG_R
	# Package designator R
	bool
	default n

config STM32H5_IO_CONFIG_J
	# Package designator J
	bool
	default n

config STM32H5_IO_CONFIG_M
	# Package designator M
	bool
	default n

config STM32H5_IO_CONFIG_V
	# Package designator V
	bool
	default n

config STM32H5_IO_CONFIG_Q
	# Package designator Q
	bool
	default n

config STM32H5_IO_CONFIG_Z
	# Package designator Z
	bool
	default n

config STM32H5_IO_CONFIG_A
	# Package designator A
	bool
	default n

comment "STM32H5 OTP Options"

config STM32H5_OTP_WORD
	bool "OTP word read/write"
	default n
	---help---
		Build stm32_otp_word_read16()/read32() (and, with
		STM32H5_OTP_WRITE below, write16()/write32()) in
		stm32h563xx_flash.c: direct 16- or 32-bit word access to the
		STM32H5 OTP area (RM0481, "OTP area"), independent of the
		existing block/locking API (stm32_otp_write()/
		stm32_otp_read()/stm32_otp_getlockstatus()) in that same
		file, which is always built.

		The OTP area's base address and size are fixed by the
		silicon, so they are plain constants in
		arch/arm/src/stm32h5/hardware/stm32h5xxx_memorymap.h rather
		than configuration here.

if STM32H5_OTP_WORD

config STM32H5_OTP_WRITE
	bool "Allow OTP word programming"
	default n
	---help---
		Build the code that programs OTP words.

		Programming is IRREVERSIBLE: OTP bits can only be cleared, and
		because ECC is computed over each 16-bit word, a word that
		already holds a different value can never be reprogrammed to
		match -- see stm32_otp_word_write16() in
		arch/arm/src/stm32h5/stm32h563xx_flash.c.  Reads work normally
		either way.

endif # STM32H5_OTP_WORD

config STM32H5_EFUSE
	bool "eFuse character device for the OTP area"
	default n
	depends on EFUSE
	select STM32H5_OTP_WORD
	---help---
		Expose the OTP area through the NuttX efuse interface as a
		character device, by default /dev/efuse, built on
		stm32_otp_word_read16()/write16() -- see stm32_efuse.c.

comment "STM32H5 SRAM2 Options"

config STM32_SBS
	bool
	default n

config STM32_EDATA
	bool "Flash high-cycle data (EDATA) MTD driver"
	default n
	depends on STM32_STM32H563XX
	select MTD
	select STM32_SBS
	---help---
		Provides stm32_edata_initialize(), which configures the last
		sectors of a flash bank as high-cycle data (EDATA) and returns an
		MTD device for them.  EDATA is rated for many more erase cycles
		than user flash, which makes it suitable for configuration storage
		such as NVS (MTD_CONFIG_NVS).

endif # ARCH_CHIP_STM32H5
```
