## arch/arm/src/ra8m1/Kconfig
```kconfig
#
# For a description of the syntax of this configuration file,
# see the file kconfig-language.txt in the NuttX tools repository.
#

comment "RA Configuration Options"

choice
	prompt "RA Chip Selection"
	default ARCH_CHIP_R7FA8M1AHECFC
	depends on ARCH_CHIP_RA8M1

config ARCH_CHIP_R7FA8M1AFECAM
	bool "R7FA8M1AFECAM"
	select RA_HAVE_SCI_B0
	select RA_HAVE_SCI_B1
	select RA_HAVE_SCI_B2
	select RA_HAVE_SCI_B3
	select RA_HAVE_SCI_B4
	select RA_HAVE_SCI_B9
	select RA_HAVE_GPT0
	select RA_HAVE_GPT1
	select RA_HAVE_GPT2
	select RA_HAVE_GPT3
	select RA_HAVE_GPT4
	select RA_HAVE_GPT5
	select RA_HAVE_GPT6
	select RA_HAVE_GPT7
	select RA_HAVE_GPT8
	select RA_HAVE_GPT9
	select RA_HAVE_GPT10
	select RA_HAVE_GPT11
	select RA_HAVE_GPT12
	select RA_HAVE_GPT13
	select RA8M1_FAMILY

config ARCH_CHIP_R7FA8M1AFECBD
	bool "R7FA8M1AFECBD"
	select RA_HAVE_SCI_B0
	select RA_HAVE_SCI_B1
	select RA_HAVE_SCI_B2
	select RA_HAVE_SCI_B3
	select RA_HAVE_SCI_B4
	select RA_HAVE_SCI_B9
	select RA_HAVE_GPT0
	select RA_HAVE_GPT1
	select RA_HAVE_GPT2
	select RA_HAVE_GPT3
	select RA_HAVE_GPT4
	select RA_HAVE_GPT5
	select RA_HAVE_GPT6
	select RA_HAVE_GPT7
	select RA_HAVE_GPT8
	select RA_HAVE_GPT9
	select RA_HAVE_GPT10
	select RA_HAVE_GPT11
	select RA_HAVE_GPT12
	select RA_HAVE_GPT13
	select RA8M1_FAMILY

config ARCH_CHIP_R7FA8M1AFECFB
	bool "R7FA8M1AFECFB"
	select RA_HAVE_SCI_B0
	select RA_HAVE_SCI_B1
	select RA_HAVE_SCI_B2
	select RA_HAVE_SCI_B3
	select RA_HAVE_SCI_B4
	select RA_HAVE_SCI_B9
	select RA_HAVE_GPT0
	select RA_HAVE_GPT1
	select RA_HAVE_GPT2
	select RA_HAVE_GPT3
	select RA_HAVE_GPT4
	select RA_HAVE_GPT5
	select RA_HAVE_GPT6
	select RA_HAVE_GPT7
	select RA_HAVE_GPT8
	select RA_HAVE_GPT9
	select RA_HAVE_GPT10
	select RA_HAVE_GPT11
	select RA_HAVE_GPT12
	select RA_HAVE_GPT13
	select RA8M1_FAMILY

config ARCH_CHIP_R7FA8M1AFECFC
	bool "R7FA8M1AFECFC"
	select RA_HAVE_SCI_B0
	select RA_HAVE_SCI_B1
	select RA_HAVE_SCI_B2
	select RA_HAVE_SCI_B3
	select RA_HAVE_SCI_B4
	select RA_HAVE_SCI_B9
	select RA_HAVE_GPT0
	select RA_HAVE_GPT1
	select RA_HAVE_GPT2
	select RA_HAVE_GPT3
	select RA_HAVE_GPT4
	select RA_HAVE_GPT5
	select RA_HAVE_GPT6
	select RA_HAVE_GPT7
	select RA_HAVE_GPT8
	select RA_HAVE_GPT9
	select RA_HAVE_GPT10
	select RA_HAVE_GPT11
	select RA_HAVE_GPT12
	select RA_HAVE_GPT13
	select RA8M1_FAMILY

config ARCH_CHIP_R7FA8M1AFECFP
	bool "R7FA8M1AFECFP"
	select RA_HAVE_SCI_B0
	select RA_HAVE_SCI_B1
	select RA_HAVE_SCI_B2
	select RA_HAVE_SCI_B3
	select RA_HAVE_SCI_B4
	select RA_HAVE_SCI_B9
	select RA_HAVE_GPT0
	select RA_HAVE_GPT1
	select RA_HAVE_GPT2
	select RA_HAVE_GPT3
	select RA_HAVE_GPT4
	select RA_HAVE_GPT5
	select RA_HAVE_GPT6
	select RA_HAVE_GPT7
	select RA_HAVE_GPT8
	select RA_HAVE_GPT9
	select RA_HAVE_GPT10
	select RA_HAVE_GPT11
	select RA_HAVE_GPT12
	select RA_HAVE_GPT13
	select RA8M1_FAMILY

config ARCH_CHIP_R7FA8M1AHECAM
	bool "R7FA8M1AHECAM"
	select RA_HAVE_SCI_B0
	select RA_HAVE_SCI_B1
	select RA_HAVE_SCI_B2
	select RA_HAVE_SCI_B3
	select RA_HAVE_SCI_B4
	select RA_HAVE_SCI_B9
	select RA_HAVE_GPT0
	select RA_HAVE_GPT1
	select RA_HAVE_GPT2
	select RA_HAVE_GPT3
	select RA_HAVE_GPT4
	select RA_HAVE_GPT5
	select RA_HAVE_GPT6
	select RA_HAVE_GPT7
	select RA_HAVE_GPT8
	select RA_HAVE_GPT9
	select RA_HAVE_GPT10
	select RA_HAVE_GPT11
	select RA_HAVE_GPT12
	select RA_HAVE_GPT13
	select RA8M1_FAMILY

config ARCH_CHIP_R7FA8M1AHECBD
	bool "R7FA8M1AHECBD"
	select RA_HAVE_SCI_B0
	select RA_HAVE_SCI_B1
	select RA_HAVE_SCI_B2
	select RA_HAVE_SCI_B3
	select RA_HAVE_SCI_B4
	select RA_HAVE_SCI_B9
	select RA_HAVE_GPT0
	select RA_HAVE_GPT1
	select RA_HAVE_GPT2
	select RA_HAVE_GPT3
	select RA_HAVE_GPT4
	select RA_HAVE_GPT5
	select RA_HAVE_GPT6
	select RA_HAVE_GPT7
	select RA_HAVE_GPT8
	select RA_HAVE_GPT9
	select RA_HAVE_GPT10
	select RA_HAVE_GPT11
	select RA_HAVE_GPT12
	select RA_HAVE_GPT13
	select RA8M1_FAMILY

config ARCH_CHIP_R7FA8M1AHECFB
	bool "R7FA8M1AHECFB"
	select RA_HAVE_SCI_B0
	select RA_HAVE_SCI_B1
	select RA_HAVE_SCI_B2
	select RA_HAVE_SCI_B3
	select RA_HAVE_SCI_B4
	select RA_HAVE_SCI_B9
	select RA_HAVE_GPT0
	select RA_HAVE_GPT1
	select RA_HAVE_GPT2
	select RA_HAVE_GPT3
	select RA_HAVE_GPT4
	select RA_HAVE_GPT5
	select RA_HAVE_GPT6
	select RA_HAVE_GPT7
	select RA_HAVE_GPT8
	select RA_HAVE_GPT9
	select RA_HAVE_GPT10
	select RA_HAVE_GPT11
	select RA_HAVE_GPT12
	select RA_HAVE_GPT13
	select RA8M1_FAMILY

config ARCH_CHIP_R7FA8M1AHECFC
	bool "R7FA8M1AHECFC"
	select RA_HAVE_SCI_B0
	select RA_HAVE_SCI_B1
	select RA_HAVE_SCI_B2
	select RA_HAVE_SCI_B3
	select RA_HAVE_SCI_B4
	select RA_HAVE_SCI_B9
	select RA_HAVE_GPT0
	select RA_HAVE_GPT1
	select RA_HAVE_GPT2
	select RA_HAVE_GPT3
	select RA_HAVE_GPT4
	select RA_HAVE_GPT5
	select RA_HAVE_GPT6
	select RA_HAVE_GPT7
	select RA_HAVE_GPT8
	select RA_HAVE_GPT9
	select RA_HAVE_GPT10
	select RA_HAVE_GPT11
	select RA_HAVE_GPT12
	select RA_HAVE_GPT13
	select RA8M1_FAMILY

config ARCH_CHIP_R7FA8M1AHECFP
	bool "R7FA8M1AHECFP"
	select RA_HAVE_SCI_B0
	select RA_HAVE_SCI_B1
	select RA_HAVE_SCI_B2
	select RA_HAVE_SCI_B3
	select RA_HAVE_SCI_B4
	select RA_HAVE_SCI_B9
	select RA_HAVE_GPT0
	select RA_HAVE_GPT1
	select RA_HAVE_GPT2
	select RA_HAVE_GPT3
	select RA_HAVE_GPT4
	select RA_HAVE_GPT5
	select RA_HAVE_GPT6
	select RA_HAVE_GPT7
	select RA_HAVE_GPT8
	select RA_HAVE_GPT9
	select RA_HAVE_GPT10
	select RA_HAVE_GPT11
	select RA_HAVE_GPT12
	select RA_HAVE_GPT13
	select RA8M1_FAMILY

endchoice # RA Chip Selection

config RA8M1_FAMILY
	bool
	default n
	select ARCH_CORTEXM85

menu "RA8M1 Peripheral Support"

config RA_HAVE_SCI_B0
	bool
	default n

config RA_HAVE_SCI_B1
	bool
	default n

config RA_HAVE_SCI_B2
	bool
	default n

config RA_HAVE_SCI_B3
	bool
	default n

config RA_HAVE_SCI_B4
	bool
	default n

config RA_HAVE_SCI_B9
	bool
	default n

config RA_HAVE_GPT0
	bool
	default n

config RA_HAVE_GPT1
	bool
	default n

config RA_HAVE_GPT2
	bool
	default n

config RA_HAVE_GPT3
	bool
	default n

config RA_HAVE_GPT4
	bool
	default n

config RA_HAVE_GPT5
	bool
	default n

config RA_HAVE_GPT6
	bool
	default n

config RA_HAVE_GPT7
	bool
	default n

config RA_HAVE_GPT8
	bool
	default n

config RA_HAVE_GPT9
	bool
	default n

config RA_HAVE_GPT10
	bool
	default n

config RA_HAVE_GPT11
	bool
	default n

config RA_HAVE_GPT12
	bool
	default n

config RA_HAVE_GPT13
	bool
	default n

# TODO: user-facing enable options go here, one per
# RA_HAVE_* above (prompt, depends on RA_HAVE_*, select
# the driver it wires up -- see README "Kconfig draft").

config RA_SCI0_UART
	bool "UART 0"
	default n
	depends on RA_HAVE_SCI_B0
	select SCI0_SERIALDRIVER

config RA_SCI0_FIFO
	bool "Use SCI0's 16-stage FIFO"
	default n
	depends on RA_SCI0_UART
	select RA_SCI_FIFO
	---help---
		Switch SCI0 to its 16-stage FIFO (CCR3.FM=1): fewer interrupts
		on a continuous stream, and enables the receive-timeout ("idle
		line") event (SCIn_RXI fires on fewer-than-trigger-level bytes
		within 15 ETUs of the last stop bit).

		Mutually exclusive with CONFIG_RA_SCI0_TXDTC/RXDTC (see their help).

if RA_SCI0_FIFO

config RA_SCI0_FIFO_TXTRG
	int "Transmit FIFO trigger level (FCR.TTRG)"
	range 0 15
	default 0
	---help---
		SCIn_TXI fires once the transmit-FIFO's occupancy drops to this
		level or below.  0 (the Renesas FSP default) waits for the FIFO
		to empty completely before the next interrupt, for the fewest
		interrupts on a continuous stream.

config RA_SCI0_FIFO_RXTRG
	int "Receive FIFO trigger level (FCR.RTRG)"
	range 0 15
	default 15
	---help---
		SCIn_RXI fires once the receive-FIFO's occupancy reaches this
		level.  The idle-line timeout only ever fires when 0 < count <
		RTRG, so it never fires at RTRG 0 or 1.  Lower values give more
		overrun margin (confirmed on hardware: RTRG=0 ran clean to
		3 Mbps); higher values mean fewer interrupts but less margin --
		the default of 15 is the worst setting for high-baud overrun
		resistance.

endif # RA_SCI0_FIFO

config RA_SCI0_TXDTC
	bool "Transmit SCI0 through the DTC"
	default n
	depends on RA_SCI0_UART && RA_DTC && !RA_SCI0_FIFO
	select SERIAL_TXDMA
	---help---
		Move transmit data out of the ring buffer into TDR through the
		DTC in the background, instead of one byte per SCIn_TXI: one
		completion interrupt per chunk, not per byte (up_dma_send_at()
		in ra_serial.c).

		Mutually exclusive with CONFIG_RA_SCI0_FIFO (see its help).

config RA_SCI0_RXDTC
	bool "Receive SCI0 through the DTC"
	default n
	depends on RA_SCI0_UART && RA_DTC && !RA_SCI0_FIFO
	---help---
		Move each received byte out of RDR through the DTC as it
		arrives: one DTC activation per byte, with a CPU interrupt on
		every one (no interrupt-count reduction like TXDTC, since byte
		arrival isn't known in advance).

		Its register move avoids NVIC latency, but only while armed --
		the gap between a byte being consumed and up_dma_rxarm()
		re-arming is serviced by the CPU instead.  At very high baud
		rates that gap can matter more than FIFO's standing multi-byte
		margin: do not assume this beats CONFIG_RA_SCI0_FIFO with a low
		receive trigger level.

		Mutually exclusive with CONFIG_RA_SCI0_FIFO (see its help).

config RA_SCI1_UART
	bool "UART 1"
	default n
	depends on RA_HAVE_SCI_B1
	select SCI1_SERIALDRIVER

config RA_SCI1_FIFO
	bool "Use SCI1's 16-stage FIFO"
	default n
	depends on RA_SCI1_UART
	select RA_SCI_FIFO
	---help---
		Switch SCI1 to its 16-stage FIFO (CCR3.FM=1): fewer interrupts
		on a continuous stream, and enables the receive-timeout ("idle
		line") event (SCIn_RXI fires on fewer-than-trigger-level bytes
		within 15 ETUs of the last stop bit).

		Mutually exclusive with CONFIG_RA_SCI1_TXDTC/RXDTC (see their help).

if RA_SCI1_FIFO

config RA_SCI1_FIFO_TXTRG
	int "Transmit FIFO trigger level (FCR.TTRG)"
	range 0 15
	default 0
	---help---
		SCIn_TXI fires once the transmit-FIFO's occupancy drops to this
		level or below.  0 (the Renesas FSP default) waits for the FIFO
		to empty completely before the next interrupt, for the fewest
		interrupts on a continuous stream.

config RA_SCI1_FIFO_RXTRG
	int "Receive FIFO trigger level (FCR.RTRG)"
	range 0 15
	default 15
	---help---
		SCIn_RXI fires once the receive-FIFO's occupancy reaches this
		level.  The idle-line timeout only ever fires when 0 < count <
		RTRG, so it never fires at RTRG 0 or 1.  Lower values give more
		overrun margin (confirmed on hardware: RTRG=0 ran clean to
		3 Mbps); higher values mean fewer interrupts but less margin --
		the default of 15 is the worst setting for high-baud overrun
		resistance.

endif # RA_SCI1_FIFO

config RA_SCI1_TXDTC
	bool "Transmit SCI1 through the DTC"
	default n
	depends on RA_SCI1_UART && RA_DTC && !RA_SCI1_FIFO
	select SERIAL_TXDMA
	---help---
		Move transmit data out of the ring buffer into TDR through the
		DTC in the background, instead of one byte per SCIn_TXI: one
		completion interrupt per chunk, not per byte (up_dma_send_at()
		in ra_serial.c).

		Mutually exclusive with CONFIG_RA_SCI1_FIFO (see its help).

config RA_SCI1_RXDTC
	bool "Receive SCI1 through the DTC"
	default n
	depends on RA_SCI1_UART && RA_DTC && !RA_SCI1_FIFO
	---help---
		Move each received byte out of RDR through the DTC as it
		arrives: one DTC activation per byte, with a CPU interrupt on
		every one (no interrupt-count reduction like TXDTC, since byte
		arrival isn't known in advance).

		Its register move avoids NVIC latency, but only while armed --
		the gap between a byte being consumed and up_dma_rxarm()
		re-arming is serviced by the CPU instead.  At very high baud
		rates that gap can matter more than FIFO's standing multi-byte
		margin: do not assume this beats CONFIG_RA_SCI1_FIFO with a low
		receive trigger level.

		Mutually exclusive with CONFIG_RA_SCI1_FIFO (see its help).

config RA_SCI2_UART
	bool "UART 2"
	default n
	depends on RA_HAVE_SCI_B2
	select SCI2_SERIALDRIVER

config RA_SCI2_FIFO
	bool "Use SCI2's 16-stage FIFO"
	default n
	depends on RA_SCI2_UART
	select RA_SCI_FIFO
	---help---
		Switch SCI2 to its 16-stage FIFO (CCR3.FM=1): fewer interrupts
		on a continuous stream, and enables the receive-timeout ("idle
		line") event (SCIn_RXI fires on fewer-than-trigger-level bytes
		within 15 ETUs of the last stop bit).

		Mutually exclusive with CONFIG_RA_SCI2_TXDTC/RXDTC (see their help).

if RA_SCI2_FIFO

config RA_SCI2_FIFO_TXTRG
	int "Transmit FIFO trigger level (FCR.TTRG)"
	range 0 15
	default 0
	---help---
		SCIn_TXI fires once the transmit-FIFO's occupancy drops to this
		level or below.  0 (the Renesas FSP default) waits for the FIFO
		to empty completely before the next interrupt, for the fewest
		interrupts on a continuous stream.

config RA_SCI2_FIFO_RXTRG
	int "Receive FIFO trigger level (FCR.RTRG)"
	range 0 15
	default 15
	---help---
		SCIn_RXI fires once the receive-FIFO's occupancy reaches this
		level.  The idle-line timeout only ever fires when 0 < count <
		RTRG, so it never fires at RTRG 0 or 1.  Lower values give more
		overrun margin (confirmed on hardware: RTRG=0 ran clean to
		3 Mbps); higher values mean fewer interrupts but less margin --
		the default of 15 is the worst setting for high-baud overrun
		resistance.

endif # RA_SCI2_FIFO

config RA_SCI2_TXDTC
	bool "Transmit SCI2 through the DTC"
	default n
	depends on RA_SCI2_UART && RA_DTC && !RA_SCI2_FIFO
	select SERIAL_TXDMA
	---help---
		Move transmit data out of the ring buffer into TDR through the
		DTC in the background, instead of one byte per SCIn_TXI: one
		completion interrupt per chunk, not per byte (up_dma_send_at()
		in ra_serial.c).

		Mutually exclusive with CONFIG_RA_SCI2_FIFO (see its help).

config RA_SCI2_RXDTC
	bool "Receive SCI2 through the DTC"
	default n
	depends on RA_SCI2_UART && RA_DTC && !RA_SCI2_FIFO
	---help---
		Move each received byte out of RDR through the DTC as it
		arrives: one DTC activation per byte, with a CPU interrupt on
		every one (no interrupt-count reduction like TXDTC, since byte
		arrival isn't known in advance).

		Its register move avoids NVIC latency, but only while armed --
		the gap between a byte being consumed and up_dma_rxarm()
		re-arming is serviced by the CPU instead.  At very high baud
		rates that gap can matter more than FIFO's standing multi-byte
		margin: do not assume this beats CONFIG_RA_SCI2_FIFO with a low
		receive trigger level.

		Mutually exclusive with CONFIG_RA_SCI2_FIFO (see its help).

config RA_SCI3_UART
	bool "UART 3"
	default n
	depends on RA_HAVE_SCI_B3
	select SCI3_SERIALDRIVER

config RA_SCI3_FIFO
	bool "Use SCI3's 16-stage FIFO"
	default n
	depends on RA_SCI3_UART
	select RA_SCI_FIFO
	---help---
		Switch SCI3 to its 16-stage FIFO (CCR3.FM=1): fewer interrupts
		on a continuous stream, and enables the receive-timeout ("idle
		line") event (SCIn_RXI fires on fewer-than-trigger-level bytes
		within 15 ETUs of the last stop bit).

		Mutually exclusive with CONFIG_RA_SCI3_TXDTC/RXDTC (see their help).

if RA_SCI3_FIFO

config RA_SCI3_FIFO_TXTRG
	int "Transmit FIFO trigger level (FCR.TTRG)"
	range 0 15
	default 0
	---help---
		SCIn_TXI fires once the transmit-FIFO's occupancy drops to this
		level or below.  0 (the Renesas FSP default) waits for the FIFO
		to empty completely before the next interrupt, for the fewest
		interrupts on a continuous stream.

config RA_SCI3_FIFO_RXTRG
	int "Receive FIFO trigger level (FCR.RTRG)"
	range 0 15
	default 15
	---help---
		SCIn_RXI fires once the receive-FIFO's occupancy reaches this
		level.  The idle-line timeout only ever fires when 0 < count <
		RTRG, so it never fires at RTRG 0 or 1.  Lower values give more
		overrun margin (confirmed on hardware: RTRG=0 ran clean to
		3 Mbps); higher values mean fewer interrupts but less margin --
		the default of 15 is the worst setting for high-baud overrun
		resistance.

endif # RA_SCI3_FIFO

config RA_SCI3_TXDTC
	bool "Transmit SCI3 through the DTC"
	default n
	depends on RA_SCI3_UART && RA_DTC && !RA_SCI3_FIFO
	select SERIAL_TXDMA
	---help---
		Move transmit data out of the ring buffer into TDR through the
		DTC in the background, instead of one byte per SCIn_TXI: one
		completion interrupt per chunk, not per byte (up_dma_send_at()
		in ra_serial.c).

		Mutually exclusive with CONFIG_RA_SCI3_FIFO (see its help).

config RA_SCI3_RXDTC
	bool "Receive SCI3 through the DTC"
	default n
	depends on RA_SCI3_UART && RA_DTC && !RA_SCI3_FIFO
	---help---
		Move each received byte out of RDR through the DTC as it
		arrives: one DTC activation per byte, with a CPU interrupt on
		every one (no interrupt-count reduction like TXDTC, since byte
		arrival isn't known in advance).

		Its register move avoids NVIC latency, but only while armed --
		the gap between a byte being consumed and up_dma_rxarm()
		re-arming is serviced by the CPU instead.  At very high baud
		rates that gap can matter more than FIFO's standing multi-byte
		margin: do not assume this beats CONFIG_RA_SCI3_FIFO with a low
		receive trigger level.

		Mutually exclusive with CONFIG_RA_SCI3_FIFO (see its help).

config RA_SCI4_UART
	bool "UART 4"
	default n
	depends on RA_HAVE_SCI_B4
	select SCI4_SERIALDRIVER

config RA_SCI4_FIFO
	bool "Use SCI4's 16-stage FIFO"
	default n
	depends on RA_SCI4_UART
	select RA_SCI_FIFO
	---help---
		Switch SCI4 to its 16-stage FIFO (CCR3.FM=1): fewer interrupts
		on a continuous stream, and enables the receive-timeout ("idle
		line") event (SCIn_RXI fires on fewer-than-trigger-level bytes
		within 15 ETUs of the last stop bit).

		Mutually exclusive with CONFIG_RA_SCI4_TXDTC/RXDTC (see their help).

if RA_SCI4_FIFO

config RA_SCI4_FIFO_TXTRG
	int "Transmit FIFO trigger level (FCR.TTRG)"
	range 0 15
	default 0
	---help---
		SCIn_TXI fires once the transmit-FIFO's occupancy drops to this
		level or below.  0 (the Renesas FSP default) waits for the FIFO
		to empty completely before the next interrupt, for the fewest
		interrupts on a continuous stream.

config RA_SCI4_FIFO_RXTRG
	int "Receive FIFO trigger level (FCR.RTRG)"
	range 0 15
	default 15
	---help---
		SCIn_RXI fires once the receive-FIFO's occupancy reaches this
		level.  The idle-line timeout only ever fires when 0 < count <
		RTRG, so it never fires at RTRG 0 or 1.  Lower values give more
		overrun margin (confirmed on hardware: RTRG=0 ran clean to
		3 Mbps); higher values mean fewer interrupts but less margin --
		the default of 15 is the worst setting for high-baud overrun
		resistance.

endif # RA_SCI4_FIFO

config RA_SCI4_TXDTC
	bool "Transmit SCI4 through the DTC"
	default n
	depends on RA_SCI4_UART && RA_DTC && !RA_SCI4_FIFO
	select SERIAL_TXDMA
	---help---
		Move transmit data out of the ring buffer into TDR through the
		DTC in the background, instead of one byte per SCIn_TXI: one
		completion interrupt per chunk, not per byte (up_dma_send_at()
		in ra_serial.c).

		Mutually exclusive with CONFIG_RA_SCI4_FIFO (see its help).

config RA_SCI4_RXDTC
	bool "Receive SCI4 through the DTC"
	default n
	depends on RA_SCI4_UART && RA_DTC && !RA_SCI4_FIFO
	---help---
		Move each received byte out of RDR through the DTC as it
		arrives: one DTC activation per byte, with a CPU interrupt on
		every one (no interrupt-count reduction like TXDTC, since byte
		arrival isn't known in advance).

		Its register move avoids NVIC latency, but only while armed --
		the gap between a byte being consumed and up_dma_rxarm()
		re-arming is serviced by the CPU instead.  At very high baud
		rates that gap can matter more than FIFO's standing multi-byte
		margin: do not assume this beats CONFIG_RA_SCI4_FIFO with a low
		receive trigger level.

		Mutually exclusive with CONFIG_RA_SCI4_FIFO (see its help).

config RA_SCI9_UART
	bool "UART 9"
	default n
	depends on RA_HAVE_SCI_B9
	select SCI9_SERIALDRIVER

config RA_SCI_FIFO
	bool
	default n
	---help---
		Hidden aggregate selected by any CONFIG_RA_SCIn_FIFO: lets
		ra_serial.c's shared FIFO code use one compile-time guard
		instead of checking every instance's own option.

config RA_SCI9_FIFO
	bool "Use SCI9's 16-stage FIFO"
	default n
	depends on RA_SCI9_UART
	select RA_SCI_FIFO
	---help---
		Switch SCI9 to its 16-stage FIFO (CCR3.FM=1): fewer interrupts
		on a continuous stream, and enables the receive-timeout ("idle
		line") event (SCIn_RXI fires on fewer-than-trigger-level bytes
		within 15 ETUs of the last stop bit).

		Mutually exclusive with CONFIG_RA_SCI9_TXDTC/RXDTC (see their help).

if RA_SCI9_FIFO

config RA_SCI9_FIFO_TXTRG
	int "Transmit FIFO trigger level (FCR.TTRG)"
	range 0 15
	default 0
	---help---
		SCIn_TXI fires once the transmit-FIFO's occupancy drops to this
		level or below.  0 (the Renesas FSP default) waits for the FIFO
		to empty completely before the next interrupt, for the fewest
		interrupts on a continuous stream.

config RA_SCI9_FIFO_RXTRG
	int "Receive FIFO trigger level (FCR.RTRG)"
	range 0 15
	default 15
	---help---
		SCIn_RXI fires once the receive-FIFO's occupancy reaches this
		level.  The idle-line timeout only ever fires when 0 < count <
		RTRG, so it never fires at RTRG 0 or 1.  Lower values give more
		overrun margin (confirmed on hardware: RTRG=0 ran clean to
		3 Mbps); higher values mean fewer interrupts but less margin --
		the default of 15 is the worst setting for high-baud overrun
		resistance.

endif # RA_SCI9_FIFO

config RA_SCI9_TXDTC
	bool "Transmit SCI9 through the DTC"
	default n
	depends on RA_SCI9_UART && RA_DTC && !RA_SCI9_FIFO
	select SERIAL_TXDMA
	---help---
		Move transmit data out of the ring buffer into TDR through the
		DTC in the background, instead of one byte per SCIn_TXI: one
		completion interrupt per chunk, not per byte (up_dma_send_at()
		in ra_serial.c).

		Mutually exclusive with CONFIG_RA_SCI9_FIFO (see its help).

config RA_SCI9_RXDTC
	bool "Receive SCI9 through the DTC"
	default n
	depends on RA_SCI9_UART && RA_DTC && !RA_SCI9_FIFO
	---help---
		Move each received byte out of RDR through the DTC as it
		arrives: one DTC activation per byte, with a CPU interrupt on
		every one (no interrupt-count reduction like TXDTC, since byte
		arrival isn't known in advance).

		Its register move avoids NVIC latency, but only while armed --
		the gap between a byte being consumed and up_dma_rxarm()
		re-arming is serviced by the CPU instead.  At very high baud
		rates that gap can matter more than FIFO's standing multi-byte
		margin: do not assume this beats CONFIG_RA_SCI9_FIFO with a low
		receive trigger level.

		Mutually exclusive with CONFIG_RA_SCI9_FIFO (see its help).

config RA_DTC
	bool "Data Transfer Controller (DTC)"
	default n
	---help---
		Enable the RA8M1 Data Transfer Controller.  The DTC offloads
		repetitive, register-triggered data transfers (e.g. UART TX/RX)
		from the CPU: the same ICU event that would otherwise interrupt
		the CPU instead activates the DTC, which performs one transfer
		and, once its transfer count is exhausted, still interrupts the
		CPU normally.  Peripheral drivers that support it expose their
		own per-channel options (e.g. RA_SCI9_TXDTC, RA_SCI9_RXDTC).

config RA_GPT_TIMER
	bool "GPT timer (/dev/timerN)"
	default n
	select TIMER
	---help---
		Register enabled GPT channels as generic timers.  Each enabled
		channel uses one ICU slot (its overflow event).

if RA_GPT_TIMER

config RA_GPT0_GPT
	bool "GPT0 (32-bit)"
	default n
	depends on RA_HAVE_GPT0

config RA_GPT1_GPT
	bool "GPT1 (32-bit)"
	default n
	depends on RA_HAVE_GPT1

config RA_GPT2_GPT
	bool "GPT2 (32-bit)"
	default n
	depends on RA_HAVE_GPT2

config RA_GPT3_GPT
	bool "GPT3 (32-bit)"
	default n
	depends on RA_HAVE_GPT3

config RA_GPT4_GPT
	bool "GPT4 (32-bit)"
	default n
	depends on RA_HAVE_GPT4

config RA_GPT5_GPT
	bool "GPT5 (32-bit)"
	default n
	depends on RA_HAVE_GPT5

config RA_GPT6_GPT
	bool "GPT6 (32-bit)"
	default n
	depends on RA_HAVE_GPT6

config RA_GPT7_GPT
	bool "GPT7 (32-bit)"
	default n
	depends on RA_HAVE_GPT7

config RA_GPT8_GPT
	bool "GPT8 (16-bit)"
	default n
	depends on RA_HAVE_GPT8

config RA_GPT9_GPT
	bool "GPT9 (16-bit)"
	default n
	depends on RA_HAVE_GPT9

config RA_GPT10_GPT
	bool "GPT10 (16-bit)"
	default n
	depends on RA_HAVE_GPT10

config RA_GPT11_GPT
	bool "GPT11 (16-bit)"
	default n
	depends on RA_HAVE_GPT11

config RA_GPT12_GPT
	bool "GPT12 (16-bit)"
	default n
	depends on RA_HAVE_GPT12

config RA_GPT13_GPT
	bool "GPT13 (16-bit)"
	default n
	depends on RA_HAVE_GPT13

endif # RA_GPT_TIMER

endmenu # RA8M1 Peripheral Support
```
