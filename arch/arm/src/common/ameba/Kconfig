## arch/risc-v/src/erbium/Kconfig
```kconfig
#
# SPDX-License-Identifier: Apache-2.0
#
# For a description of the syntax of this configuration file,
# see the file kconfig-language.txt in the NuttX tools repository.
#

config ERBIUM_UART_CLOCK
	int "UART input clock (Hz)"
	default 6666667
	range 1 2147483647
	---help---
		UART peripheral clock after the Erbium divide-by-30 prescaler,
		with a 200 MHz system clock.

config ERBIUM_MTIMER_FREQ
	int "Machine timer frequency (Hz)"
	default 2000000
	range 1 2147483647
	---help---
		Machine timer frequency after the reference clock divider and
		timer prescaler. The ET-platform emulator defaults to 2 MHz.

config ERBIUM_MCODE_EMULATION
	bool "Emulate the 64-bit integer FCVT instructions"
	default y
	depends on ARCH_FPU && !ARCH_USE_S_MODE
	---help---
		ET-Minion has no hardware for FCVT.L.S, FCVT.LU.S, FCVT.S.L and
		FCVT.S.LU, which GCC emits for every conversion between float and
		a 64-bit integer type (long, int64_t, size_t, time_t). They raise
		exception 30 (M-code emulation). With this option the trap handler
		performs them in software, with the ET-Minion rule that a subnormal
		input reads as zero and sets fflags bit 31, and resumes after the
		instruction. Each conversion then costs a trap, about 260
		instructions in erbium_emu. Without this option they stop the
		system with an "M-code emulation" exception report. FDIV.S,
		FSQRT.S, FENCE.I, SFENCE.VMA and the ET packed instructions are
		never emulated.
```

## arch/tricore/Kconfig
```kconfig
#
# For a description of the syntax of this configuration file,
# see the file kconfig-language.txt in the NuttX tools repository.
#

if ARCH_TRICORE
comment "Tricore Options"

config ARCH_TC1V6
	bool
	select ARCH_HAVE_DEBUG
	select ARCH_HAVE_MPU
	select ARCH_HAVE_IRQTRIGGER
	select ARCH_HAVE_PERF_EVENTS
	select ARCH_HAVE_POWEROFF
	select ARCH_HAVE_PERF_EVENTS_USER_ACCESS
	select ARCH_HAVE_SETJMP
	select ARCH_HAVE_RESET
	select ARCH_SETJMP_H
	default n

config ARCH_TC1V8
	bool
	select ARCH_DCACHE
	select ARCH_HAVE_DEBUG
	select ARCH_ICACHE
	select ARCH_HAVE_MPU
	select ARCH_HAVE_IRQTRIGGER
	select ARCH_HAVE_PERF_EVENTS
	select ARCH_HAVE_PERF_EVENTS_USER_ACCESS
	select ARCH_HAVE_POWEROFF
	select ARCH_HAVE_SETJMP
	select ARCH_HAVE_RESET
	select ARCH_SETJMP_H
	default n

config ARCH_FAMILY
	string
	default "tc1v6"		if ARCH_TC1V6
	default "tc1v8"		if ARCH_TC1V8

config ARCH_DCACHE_ADDR
	hex "AURIX Dcache base address"
	default 0x7003C000
	---help---
		AURIX Dcache base address, dcache line clear and invalidate need
		use the address.

config ARCH_MPU_NSETS
	int "Protection sets number"
	default 8
	---help---
		The protection sets count

config ARCH_MPU_DATA_NREGIONS
	int "Data regions number"
	default 24
	---help---
		The data regions count

config ARCH_MPU_CODE_NREGIONS
	int "Code regions variables"
	default 16
	---help---
		The code regions count

config CPU_COREID
	int "TRICORE CPU CORE ID"
	default 0
	range 0 6

endif # ARCH_TRICORE
```
