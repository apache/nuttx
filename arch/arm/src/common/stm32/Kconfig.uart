## arch/arm/src/kl/Kconfig
```kconfig
#
# For a description of the syntax of this configuration file,
# see the file kconfig-language.txt in the NuttX tools repository.
#

comment "Kinetis Configuration Options"

choice
	prompt "Kinetis Chip Selection"
	default ARCH_CHIP_MKL25Z128
	depends on ARCH_CHIP_KL

config ARCH_CHIP_MKL25Z64
	bool "MKL25Z64"
	select ARCH_FAMILY_KL2X

config ARCH_CHIP_MKL25Z128
	bool "MKL25Z128"
	select ARCH_FAMILY_KL2X

config ARCH_CHIP_MKL26Z128
	bool "MKL26Z128"
	select ARCH_FAMILY_KL2X

endchoice

# Chip families

config ARCH_FAMILY_KL2X
	bool
	default n

menu "Kinetis Peripheral Support"

config KL_TRACE
	bool "Trace"
	default n
	---help---
		Enable trace clocking on power up.

config KL_FLEXBUS
	bool "FlexBus"
	default n
	---help---
		Enable flexbus clocking on power up.

config KL_UART0
	bool "UART0"
	default n
	select UART0_SERIALDRIVER
	---help---
		Support UART0

config KL_UART1
	bool "UART1"
	default n
	select UART1_SERIALDRIVER
	---help---
		Support UART1

config KL_UART2
	bool "UART2"
	default n
	select UART2_SERIALDRIVER
	---help---
		Support UART2

config KL_RNGB
	bool "Random number generator"
	default n
	depends on ARCH_FAMILY_K60
	select ARCH_HAVE_RNG
	---help---
		Support the random number generator(K60 only)

config KL_FLEXCAN0
	bool "FlexCAN0"
	default n
	---help---
		Support FlexCAN0

config KL_FLEXCAN1
	bool "FlexCAN1"
	default n
	---help---
		Support FlexCAN1

config KL_SPI0
	bool "SPI0"
	default n
	select SPI
	select SPI_EXCHANGE
	---help---
		Support SPI0

config KL_SPI1
	bool "SPI1"
	default n
	select SPI
	select SPI_EXCHANGE
	---help---
		Support SPI1

config KL_SPI2
	bool "SPI2"
	default n
	---help---
		Support SPI2

config KL_I2C0
	bool "I2C0"
	default n
	---help---
		Support I2C0

config KL_I2C1
	bool "I2C1"
	default n
	---help---
		Support I2C1

config KL_I2S
	bool "I2S"
	default n
	---help---
		Support I2S

config KL_DAC0
	bool "DAC0"
	default n
	---help---
		Support DAC0

config KL_DAC1
	bool "DAC1"
	default n
	---help---
		Support DAC1

config KL_ADC0
	bool "ADC0"
	default n
	---help---
		Support ADC0

config KL_ADC1
	bool "ADC1"
	default n
	---help---
		Support ADC1

config KL_CMP
	bool "CMP"
	default n
	---help---
		Support CMP

config KL_VREF
	bool "VREF"
	default n
	---help---
		Support VREF

config KL_TPM0
	bool "Timer/PWM Module 0"
	default n
	---help---
		Support FlexTimer 0

config KL_TPM1
	bool "Timer/PWM Module 1"
	default n
	---help---
		Support FlexTimer 1

config KL_TPM2
	bool "Timer/PWM Module 2"
	default n
	---help---
		Support FlexTimer 2

config KL_LPTIMER
	bool "Low power timer (LPTIMER)"
	default n
	---help---
		Support the low power timer

config KL_RTC
	bool "RTC"
	default n
	---help---
		Support RTC

config KL_SLCD
	bool "Segment LCD (SLCD)"
	default n
	depends on ARCH_FAMILY_K40
	---help---
		Support the segment LCD (K40 only)

config KL_EWM
	bool "External watchdog (WVM)"
	default n
	---help---
		Support the external watchdog

config KL_CMT
	bool "Carrier modulator transmitter (CMT)"
	default n
	---help---
		Support Carrier Modulator Transmitter

config KL_USBOTG
	bool "USB OTG"
	default n
	---help---
		Support USB OTG (see also USBHOST and USBDEV)

config KL_USBDCD
	bool "USB device controller"
	default n
	---help---
		Support the USB Device Charger Detection module

config KL_LLWU
	bool "Low leakage wake-up unit (LLWU)"
	default n
	---help---
		Support the Low Leakage Wake-Up Unit

config KL_TSI
	bool "Touchscreen interface (TSI)"
	default n
	---help---
		Support the touch screeen interface

config KL_FTFL
	bool "FLASH (FTFL)"
	default n
	---help---
		Support FLASH

config KL_DMA
	bool "DMA"
	default n
	---help---
		Support DMA

config KL_CRC
	bool "CRC"
	default n
	---help---
		Support CRC

config KL_PDB
	bool "Programmable delay block (PDB)"
	default n
	---help---
		Support the Programmable Delay Block

config KL_PIT
	bool "Programmable interval timer (PIT)"
	default n
	---help---
		Support Programmable Interval Timers

endmenu

choice
	prompt "SysTick clock source"
	default KL_SYSTICK_CORECLK

config KL_SYSTICK_CORECLK
	bool "Cortex-M0 core clock"

config KL_SYSTICK_CORECLK_DIV16
	bool "Cortex-M0 core clock divided by 16"

endchoice

config KL_TPM0_PWM
	bool "TPM0 PWM"
	default n
	depends on KL_TPM0
	---help---
		Reserve timer 0 for use by PWM

		Timer devices may be used for different purposes.  One special purpose is
		to generate modulated outputs for such things as motor control.  If KL_TPM0
		is defined then THIS following may also be defined to indicate that
		the timer is intended to be used for pulsed output modulation.

config KL_TPM0_CHANNEL
	int "TPM0 PWM Output Channel"
	default 0
	range 0 5
	depends on KL_TPM0_PWM
	---help---
		If TIM0 is enabled for PWM usage, you also need specifies the timer output
		channel {0,..,5}

config KL_TPM1_PWM
	bool "TPM1 PWM"
	default n
	depends on KL_TPM1
	---help---
		Reserve timer 1 for use by PWM

		Timer devices may be used for different purposes.  One special purpose is
		to generate modulated outputs for such things as motor control.  If KL_TPM1
		is defined then THIS following may also be defined to indicate that
		the timer is intended to be used for pulsed output modulation.

config KL_TPM1_CHANNEL
	int "TPM1 PWM Output Channel"
	default 0
	range 0 1 if ARCH_CHIP_MKL25Z64 || ARCH_CHIP_MKL25Z128 || ARCH_CHIP_MKL26Z128
	range 0 5 if !ARCH_CHIP_MKL25Z64 && !ARCH_CHIP_MKL25Z128 && !ARCH_CHIP_MKL26Z128
	depends on KL_TPM1_PWM
	---help---
		If TIM1 is enabled for PWM usage, you also need specifies the timer output
		channel {0,..,5}

config KL_TPM2_PWM
	bool "TPM2 PWM"
	default n
	depends on KL_TPM2
	---help---
		Reserve timer 2 for use by PWM

		Timer devices may be used for different purposes.  One special purpose is
		to generate modulated outputs for such things as motor control.  If KL_TPM2
		is defined then THIS following may also be defined to indicate that
		the timer is intended to be used for pulsed output modulation.

config KL_TPM2_CHANNEL
	int "TPM2 PWM Output Channel"
	default 0
	range 0 1 if ARCH_CHIP_MKL25Z64 || ARCH_CHIP_MKL25Z128 || ARCH_CHIP_MKL26Z128
	range 0 5 if !ARCH_CHIP_MKL25Z64 && !ARCH_CHIP_MKL25Z128 && !ARCH_CHIP_MKL26Z128
	depends on KL_TPM2_PWM
	---help---
		If TIM2 is enabled for PWM usage, you also need specifies the timer output
		channel {0,..,5}

comment "Kinetis GPIO Interrupt Configuration"

config KL_GPIOIRQ
	bool "GPIO pin interrupts"
	---help---
		Enable support for interrupting GPIO pins

if KL_GPIOIRQ

config KL_PORTAINTS
	bool "GPIOA interrupts"
	---help---
		Enable support for 32 interrupts from GPIO port A pins

config KL_PORTDINTS
	bool "GPIOD interrupts"
	---help---
		Enable support for 32 interrupts from GPIO port D pins

endif
```

## arch/arm/src/lc823450/Kconfig
```kconfig
#
# For a description of the syntax of this configuration file,
# see misc/tools/kconfig-language.txt.
#

comment "LC823450 Configuration Options"

menu "LC823450 Peripheral Support"

config LC823450_IPL2
	bool "IPL2"
	default n

config LC823450_UART0
	bool "UART0"
	select UART0_SERIALDRIVER
	select ARCH_HAVE_SERIAL_TERMIOS
	default n

config LC823450_UART1
	bool "UART1"
	select UART1_SERIALDRIVER
	select ARCH_HAVE_SERIAL_TERMIOS
	default n

config LC823450_UART2
	bool "UART2"
	select UART2_SERIALDRIVER
	select ARCH_HAVE_SERIAL_TERMIOS
	default n

config LC823450_WDT
	bool "Watchdog"
	default n
	select WATCHDOG

config LC823450_SPIFI
	bool "SPI Flash Interface (SPIFI)"
	default n

if LC823450_SPIFI
config LC823450_SPIFI_QUADIO
	bool "SPIFI 4bit access"
	default y
endif

config LC823450_SDIF
	bool "SD/eMMC driver"
	default y

if LC823450_SDIF

config LC823450_SDIF_PATCH
	bool "SD/eMMC driver patch support"
	default n

config LC823450_SDIF_SDC
	bool "SD card support"
	default n

config LC823450_SDC_DMA
	bool "DMA support for eMMC/SD"
	default y
	select ARCH_DMA

endif

config LC823450_MTD
	bool "LC823450 MTD devices"
	default n
	select MTD_PARTITION
	---help---
		Build support for LC823450 MTD eMMC/uSD

if LC823450_MTD

config MTD_DEV_MAX
	int "Max MTD devices"
	default 2

config MTD_DEVNO_EMMC
	int "Device No. for eMMC"
	default 0

config MTD_DEVNO_SDC
	int "Device No. for SD"
	default 1

config MTD_DEVPATH0
	string "Device path for eMMC"
	default "/dev/mtdblock0"

config MTD_DEVPATH1
	string "Device path for SD"
	default "/dev/mtdblock1"

config MTD_CONFIG_DEVPATH
	string "Device path for config"
	default "/dev/mtdblock0p2"

config MTD_RECOVERY_DEVPATH
	string "Device path for recovery"
	default "/dev/mtdblock0p3"

config MTD_KERNEL_DEVPATH
	string "Device path for kernel"
	default "/dev/mtdblock0p4"

config MTD_ETC_DEVPATH
	string "Device path for etc"
	default "/dev/mtdblock0p5"

config MTD_SYSTEM_DEVPATH
	string "Device path for system"
	default "/dev/mtdblock0p6"

config MTD_LOG_DEVPATH
	string "Device path for log"
	default "/dev/mtdblock0p7"

config MTD_CACHE_DEVPATH
	string "Device path for cache"
	default "/dev/mtdblock0p9"

config MTD_CP_DEVPATH
	string "Device path for content on eMMC"
	default "/dev/mtdblock0p10"

config MTD_CP_STARTBLOCK
	int "Start block for content on eMMC"
	default 602112

endif # LC823450 MTD

config LC823450_I2C_TIMEOSEC
	int "I2C timeout (sec)"
	default 1
	range 0 2
	depends on I2C

config LC823450_I2C_TIMEOMS
	int "I2C timeout (msec)"
	default 500
	range 0 999
	depends on I2C

config LC823450_I2C0
	bool "I2C0"
	default n
	depends on I2C

config LC823450_I2C1
	bool "I2C1"
	default n
	depends on I2C

config LC823450_I2S0
	bool "I2S0"
	default n
	depends on I2S

config LC823450_SPI_DMA
	bool "DMA for SPI"
	default n
	select ARCH_DMA

if PWM

config LC823450_PWM0_CH0
	bool "MTM0-Ch0 PWM device"
	default n

config LC823450_PWM0_CH1
	bool "MTM0-Ch1 PWM device"
	default n

config LC823450_PWM1_CH0
	bool "MTM1-Ch0 PWM device"
	default y

config LC823450_PWM1_CH1
	bool "MTM1-Ch1 PWM device"
	default n

endif

choice
	prompt "HS driver current boost"

config LC823450_USBDEV_CUSTOM_HSDSEL_0
	bool "normal"

config LC823450_USBDEV_CUSTOM_HSDSEL_5
	bool "5% boost"

config LC823450_USBDEV_CUSTOM_HSDSEL_10
	bool "10% boost"

endchoice

config LC823450_LSISTBY
	bool "LSI Standby"
	default n

config LC823450_MTM0_TICK
	bool "use MTM0 for tick"
	default n

config LC823450_SLEEP_MODE
	bool "sleep mode"
	default n


config HRT_TIMER
	bool "High resolution timer"
	default n

config DVFS
	bool "Dynamic Voltage and Frequencey Scaling"
	default n

endmenu
```

## arch/arm/src/lpc11xx/Kconfig
```kconfig
#
# For a description of the syntax of this configuration file,
# see the file kconfig-language.txt in the NuttX tools repository.
#

comment "LPC11xx Configuration Options"

choice
	prompt "NXP LPC11XX Chip Selection"
	default ARCH_CHIP_LPC1115
	depends on ARCH_CHIP_LPC11XX

config ARCH_CHIP_LPC1114
	bool "LPC1114"
	select ARCH_FAMILY_LPC111X

config ARCH_CHIP_LPC1115
	bool "LPC1115"
	select ARCH_FAMILY_LPC111X

endchoice

config ARCH_FAMILY_LPC111X
	bool

menu "LPC11xx Peripheral Support"

choice
	prompt "System Clock:"
	default LPC11_INTRCOSC

config LPC11_INTRCOSC
	bool "Internal RC"

config LPC11_MAINOSC
	bool "External Crystal"

endchoice

choice
	prompt "SysTick clock source"
	default LPC11_SYSTICK_CORECLK

config LPC11_SYSTICK_CORECLK
	bool "Cortex-M0 core clock"

config LPC11_SYSTICK_CORECLK_DIV16
	bool "Cortex-M0 core clock divided by 16"

endchoice

config LPC11_PLL
	bool "PLL"
	default y

config LPC11_UART0
	bool "UART0"
	select UART0_SERIALDRIVER
	select ARCH_HAVE_SERIAL_TERMIOS
	default y

config LPC11_CAN0
	bool "CAN0"
	default n

config LPC11_SPI
	bool "SPI"
	default n

config LPC11_SSP0
	bool "SSP0"
	default n

config LPC11_SSP1
	bool "SSP1"
	default n

config LPC11_I2C0
	bool "I2C0"
	default n

config LPC11_TMR0
	bool "Timer 0"
	default n

config LPC11_TMR1
	bool "Timer 1"
	default n

config LPC11_WDT
	bool "WDT"
	default n

config LPC11_ADC
	bool "ADC"
	default n

config LPC11_FLASH
	bool "FLASH"
	default n

endmenu

menu "ADC driver options"
	depends on LPC11_ADC

config LPC11_ADC0_AVERAGE
	int "ADC0 average"
	default 200

config LPC11_ADC0_MASK
	hex "ADC0 mask"
	default 0x01

config LPC11_ADC0_SPS
	int "ADC0 SPS"
	default 1000

config LPC11_ADC_CHANLIST
	bool "Use ADC channel list"
	default n
	---help---
		The errata that states: "A/D Global Data register should not be used
		with burst mode or hardware triggering".  If this option is selected,
		then the ADC driver will grab from the individual channel registers
		rather than from the global data register as this is the stated
		workaround in the errata.

		The ADC interrupt will trigger on conversion complete on the last
		channel listed in the array g_adc_chanlist[] (as opposed to
		triggering interrupt from the global DONE flag).

		If this option is enabled, then the platform specific code must do
		two things:  (1) define LPC11_ADC_NCHANNELS in the configuration file
		and (2) provide an array g_adc_chanlist[] with the channel numbers
		matching the LPC11_ADC0_MASK within the board-specific library.

config LPC11_ADC_BURSTMODE
	bool "One interrupt at the end of all ADC conversions"
	default n
	---help---
		Select this if you want to generate only one interrupt once all
		selected channels has been converted by the ADC

config LPC11_ADC_NCHANNELS
	int "ADC0 number of channels"
	depends on LPC11_ADC_CHANLIST
	default 0
	---help---
		If LPC11_ADC_CHANLIST is enabled, then the platform specific code
		must do two things:  (1) define LPC11_ADC_NCHANNELS in the configuration
		file and (2) provide an array g_adc_chanlist[] with the channel
		numbers matching the LPC11_ADC0_MASK within the board-specific
		library.

endmenu

menu "CAN driver options"
	depends on LPC11_CAN1 || LPC11_CAN2

config LPC11_CAN1_BAUD
	int "CAN1 BAUD"
	depends on LPC11_CAN1
	---help---
		CAN1 BAUD rate.  Required if LPC11_CAN1 is defined.

config LPC11_CAN2_BAUD
	int "CAN2 BAUD"
	depends on LPC11_CAN2
	---help---
		CAN2 BAUD rate.  Required if LPC11_CAN2 is defined.

config LPC11_CAN1_DIVISOR
	int "CAN1 CCLK divisor"
	depends on LPC11_CAN1
	default 4
	---help---
		CAN1 is clocked at CCLK divided by this number. (the CCLK frequency is divided
		by this number to get the CAN clock). Options = {1,2,4,6}. Default: 4.

config LPC11_CAN2_DIVISOR
	int "CAN2 CCLK divisor"
	depends on LPC11_CAN2
	default 4
	---help---
		CAN2 is clocked at CCLK divided by this number. (the CCLK frequency is divided
		by this number to get the CAN clock). Options = {1,2,4,6}. Default: 4.

config LPC11_CAN_TSEG1
	int "TSEG1 quanta"
	default 6
	---help---
		The number of CAN time quanta in segment 1. Default: 6

config LPC11_CAN_TSEG2
	int "TSEG2 quanta"
	default 4
	---help---
		The number of CAN time quanta in segment 2. Default: 7

config LPC11_CAN_SAM
	bool "CAN sampling"
	default n
	---help---
		The bus is sampled 3 times (recommended for low to medium speed buses to spikes on the bus-line).

config CAN_REGDEBUG
	bool "Register level debug"
	depends on DEBUG_CAN_INFO
	default n
	---help---
		Output detailed register-level CAN debug information.  Requires also
		CONFIG_DEBUG_CAN_INFO.

endmenu

config LPC11_GPIOIRQ
	bool "GPIO interrupt support"
	default n
	---help---
		Enable support for GPIO interrupts

menu "I2C driver options"
	depends on LPC11_I2C0 || LPC11_I2C1 || LPC11_I2C2

config  LPC11_I2C0_FREQUENCY
	int "I2C0 frequency"
	depends on LPC11_I2C0
	default 100000

config  LPC11_I2C1_FREQUENCY
	int "I2C1 frequency"
	depends on LPC11_I2C1
	default 100000

config  LPC11_I2C2_FREQUENCY
	int "I2C2 frequency"
	depends on LPC11_I2C2
	default 100000

endmenu
```
