## arch/arm/src/ht32f491x3/Kconfig
```kconfig
#
# For a description of the syntax of this configuration file,
# see the file kconfig-language.txt in the NuttX tools repository.
#

comment "HT32F491x3 Configuration Options"

choice
	prompt "HT32F491x3 Chip Selection"
	default ARCH_CHIP_HT32F49163
	depends on ARCH_CHIP_HT32F491X3

config ARCH_CHIP_HT32F49153
	bool "HT32F49153"
	select ARCH_HAVE_CUSTOM_VECTORS
	---help---
		128 KiB FLASH, 48 KiB SRAM.

config ARCH_CHIP_HT32F49163
	bool "HT32F49163"
	select ARCH_HAVE_CUSTOM_VECTORS
	---help---
		256 KiB FLASH, 48 KiB SRAM.

endchoice

config HT32F491X3_SYSCLK_FREQUENCY
	int "System clock frequency"
	default 8000000
	range 1 150000000
	depends on ARCH_CHIP_HT32F491X3
	---help---
		The reset clock tree runs from the 8 MHz HICK oscillator. Adjust
		this if board-specific CRM/PLL setup changes SYSCLK before the
		generic timer or serial logic runs.

config HT32F491X3_PCLK1_FREQUENCY
	int "APB1 clock frequency"
	default HT32F491X3_SYSCLK_FREQUENCY
	range 1 150000000
	depends on ARCH_CHIP_HT32F491X3
	---help---
		APB1 clock used by USART2 and USART3. The default matches the reset
		configuration where APB1DIV does not divide HCLK.

config HT32F491X3_PCLK2_FREQUENCY
	int "APB2 clock frequency"
	default HT32F491X3_SYSCLK_FREQUENCY
	range 1 150000000
	depends on ARCH_CHIP_HT32F491X3
	---help---
		APB2 clock used by USART1. The default matches the reset
		configuration where APB2DIV does not divide HCLK.

menu "Peripheral Support"

config HT32F491X3_TMR1
	bool "TMR1"
	default n
	---help---
		Enable support for the TMR1 peripheral.

config HT32F491X3_TMR1_PWM
	bool "TMR1 PWM output"
	default n
	depends on HT32F491X3_TMR1 && PWM && !PWM_MULTICHAN
	---help---
		Enable lower-half PWM support on TMR1.

config HT32F491X3_TMR1_CHANNEL
	int "TMR1 PWM channel"
	default 1
	range 1 4
	depends on HT32F491X3_TMR1_PWM
	---help---
		Select which TMR1 channel is exposed through the lower-half PWM
		driver.

config HT32F491X3_TMR2
	bool "TMR2"
	default n
	---help---
		Enable support for the TMR2 peripheral.

config HT32F491X3_TMR2_PWM
	bool "TMR2 PWM output"
	default n
	depends on HT32F491X3_TMR2 && PWM && !PWM_MULTICHAN
	---help---
		Enable lower-half PWM support on TMR2.

config HT32F491X3_TMR2_CHANNEL
	int "TMR2 PWM channel"
	default 1
	range 1 4
	depends on HT32F491X3_TMR2_PWM
	---help---
		Select which TMR2 channel is exposed through the lower-half PWM
		driver.

config HT32F491X3_TMR3
	bool "TMR3"
	default n
	---help---
		Enable support for the TMR3 peripheral.

config HT32F491X3_TMR3_PWM
	bool "TMR3 PWM output"
	default n
	depends on HT32F491X3_TMR3 && PWM && !PWM_MULTICHAN
	---help---
		Enable lower-half PWM support on TMR3.

config HT32F491X3_TMR3_CHANNEL
	int "TMR3 PWM channel"
	default 1
	range 1 4
	depends on HT32F491X3_TMR3_PWM
	---help---
		Select which TMR3 channel is exposed through the lower-half PWM
		driver.

config HT32F491X3_TMR4
	bool "TMR4"
	default n
	---help---
		Enable support for the TMR4 peripheral.

config HT32F491X3_TMR4_PWM
	bool "TMR4 PWM output"
	default n
	depends on HT32F491X3_TMR4 && PWM && !PWM_MULTICHAN
	---help---
		Enable lower-half PWM support on TMR4.

config HT32F491X3_TMR4_CHANNEL
	int "TMR4 PWM channel"
	default 1
	range 1 4
	depends on HT32F491X3_TMR4_PWM
	---help---
		Select which TMR4 channel is exposed through the lower-half PWM
		driver.

config HT32F491X3_TMR6
	bool "TMR6"
	default n
	---help---
		Enable support for the TMR6 peripheral. TMR6 is a basic timer and
		does not provide PWM output channels.

config HT32F491X3_TMR7
	bool "TMR7"
	default n
	---help---
		Enable support for the TMR7 peripheral. TMR7 is a basic timer and
		does not provide PWM output channels.

config HT32F491X3_TMR9
	bool "TMR9"
	default n
	---help---
		Enable support for the TMR9 peripheral.

config HT32F491X3_TMR9_PWM
	bool "TMR9 PWM output"
	default n
	depends on HT32F491X3_TMR9 && PWM && !PWM_MULTICHAN
	---help---
		Enable lower-half PWM support on TMR9.

config HT32F491X3_TMR9_CHANNEL
	int "TMR9 PWM channel"
	default 1
	range 1 2
	depends on HT32F491X3_TMR9_PWM
	---help---
		Select which TMR9 channel is exposed through the lower-half PWM
		driver.

config HT32F491X3_TMR10
	bool "TMR10"
	default n
	---help---
		Enable support for the TMR10 peripheral.

config HT32F491X3_TMR10_PWM
	bool "TMR10 PWM output"
	default n
	depends on HT32F491X3_TMR10 && PWM && !PWM_MULTICHAN
	---help---
		Enable lower-half PWM support on TMR10.

config HT32F491X3_TMR10_CHANNEL
	int "TMR10 PWM channel"
	default 1
	range 1 1
	depends on HT32F491X3_TMR10_PWM
	---help---
		TMR10 exposes a single PWM channel.

config HT32F491X3_TMR11
	bool "TMR11"
	default n
	---help---
		Enable support for the TMR11 peripheral.

config HT32F491X3_TMR11_PWM
	bool "TMR11 PWM output"
	default n
	depends on HT32F491X3_TMR11 && PWM && !PWM_MULTICHAN
	---help---
		Enable lower-half PWM support on TMR11.

config HT32F491X3_TMR11_CHANNEL
	int "TMR11 PWM channel"
	default 1
	range 1 1
	depends on HT32F491X3_TMR11_PWM
	---help---
		TMR11 exposes a single PWM channel.

config HT32F491X3_TMR12
	bool "TMR12"
	default n
	---help---
		Enable support for the TMR12 peripheral.

config HT32F491X3_TMR12_PWM
	bool "TMR12 PWM output"
	default n
	depends on HT32F491X3_TMR12 && PWM && !PWM_MULTICHAN
	---help---
		Enable lower-half PWM support on TMR12.

config HT32F491X3_TMR12_CHANNEL
	int "TMR12 PWM channel"
	default 1
	range 1 2
	depends on HT32F491X3_TMR12_PWM
	---help---
		Select which TMR12 channel is exposed through the lower-half PWM
		driver.

config HT32F491X3_TMR13
	bool "TMR13"
	default n
	---help---
		Enable support for the TMR13 peripheral.

config HT32F491X3_TMR13_PWM
	bool "TMR13 PWM output"
	default n
	depends on HT32F491X3_TMR13 && PWM && !PWM_MULTICHAN
	---help---
		Enable lower-half PWM support on TMR13.

config HT32F491X3_TMR13_CHANNEL
	int "TMR13 PWM channel"
	default 1
	range 1 1
	depends on HT32F491X3_TMR13_PWM
	---help---
		TMR13 exposes a single PWM channel.

config HT32F491X3_TMR14
	bool "TMR14"
	default n
	---help---
		Enable support for the TMR14 peripheral.

config HT32F491X3_TMR14_PWM
	bool "TMR14 PWM output"
	default n
	depends on HT32F491X3_TMR14 && PWM && !PWM_MULTICHAN
	---help---
		Enable lower-half PWM support on TMR14.

config HT32F491X3_TMR14_CHANNEL
	int "TMR14 PWM channel"
	default 1
	range 1 1
	depends on HT32F491X3_TMR14_PWM
	---help---
		TMR14 exposes a single PWM channel.

config HT32F491X3_USART1_SERIALDRIVER
	bool "USART1"
	default y
	select USART1_SERIALDRIVER
	select ARCH_HAVE_SERIAL_TERMIOS
	---help---
		Enable the standard lower-half driver for USART1.

comment "In this current version, USART1 is the only serial peripheral exposed by the esk32 board support."

comment "HT32F491x3 PWM-capable timers are TMR1-4 and TMR9-14; TMR6-7 are basic timers."

comment "esk32 routes TMR3 channels PA6/PA7/PB0/PB1 to /dev/pwm0."

endmenu # "Peripheral Support"
```

## arch/arm/src/imx/Kconfig
```kconfig
#
# For a description of the syntax of this configuration file,
# see misc/tools/kconfig-language.txt.
#

if ARCH_CHIP_IMX

# choice "iMX Chip Selection"

config ARCH_CHIP_IMX1
	bool
	default y

menu "iMX Peripheral Selection"

config IMX_UART1
	bool "UART1"
	default n
	select ARCH_HAVE_UART1

config IMX_UART2
	bool "UART2"
	default n
	select ARCH_HAVE_UART2

config IMX_UART3
	bool "UART2"
	default n
	select ARCH_HAVE_UART3

config IMX_SPI1
	bool "SPI1"
	default n
	select SPI

config IMX_SPI2
	bool "SPI2"
	default n
	select SPI

endmenu # iMX Peripheral Selection

config RAM_NUTTXENTRY
	hex "NuttX entry point"
	default 0x01004000
	---help---
		The virtual address of the NuttX entry point

endif
```

## arch/arm/src/imx1/Kconfig
```kconfig
#
# For a description of the syntax of this configuration file,
# see the file kconfig-language.txt in the NuttX tools repository.
#

if ARCH_CHIP_IMX1

# choice "iMX.1 Chip Selection"

menu "iMX.1 Peripheral Selection"

config IMX1_UART1
	bool "UART1"
	default n
	select UART1_SERIALDRIVER

config IMX1_UART2
	bool "UART2"
	default n
	select UART2_SERIALDRIVER

config IMX1_UART3
	bool "UART3"
	default n
	select UART3_SERIALDRIVER

config IMX1_SPI1
	bool "SPI1"
	default n
	select SPI

config IMX1_SPI2
	bool "SPI2"
	default n
	select SPI

endmenu # iMX Peripheral Selection

config RAM_NUTTXENTRY
	hex "NuttX entry point"
	default 0x01004000
	---help---
		The virtual address of the NuttX entry point

endif # ARCH_CHIP_IMX1
```

## arch/arm/src/imx6/Kconfig
```kconfig
#
# For a description of the syntax of this configuration file,
# see the file kconfig-language.txt in the NuttX tools repository.
#

if ARCH_CHIP_IMX6

menu "iMX.6 Chip Selection"

choice
	prompt "iMX.6 Core Configuration"
	default ARCH_CHIP_IMX6_6QUAD

config ARCH_CHIP_IMX6_6SOLOLITE
	bool "i.MX 6SoloLite"
	select ARMV7A_HAVE_GICv2
	select ARMV7A_HAVE_GTM
	select ARMV7A_HAVE_PTM

config ARCH_CHIP_IMX6_6SOLO
	bool "i.MX 6Solo"
	select ARMV7A_HAVE_GICv2
	select ARMV7A_HAVE_GTM
	select ARMV7A_HAVE_PTM

config ARCH_CHIP_IMX6_6DUALLITE
	bool "i.MX 6DualLite"
	select ARCH_HAVE_MULTICPU
	select ARMV7A_HAVE_GICv2
	select ARMV7A_HAVE_GTM
	select ARMV7A_HAVE_PTM

config ARCH_CHIP_IMX6_6DUAL
	bool "i.MX 6Dual"
	select ARCH_HAVE_MULTICPU
	select ARMV7A_HAVE_GICv2
	select ARMV7A_HAVE_GTM
	select ARMV7A_HAVE_PTM

config ARCH_CHIP_IMX6_6QUAD
	bool "i.MX 6Quad"
	select ARCH_HAVE_MULTICPU
	select ARMV7A_HAVE_GICv2
	select ARMV7A_HAVE_GTM
	select ARMV7A_HAVE_PTM

endchoice # iMX.6 Chip Selection

config IMX6_HAVE_HDCP
	bool "HDCP enabled"
	default n
	---help---
		HDCP - High-bandwidth Digital Content Protection

endmenu # "iMX.6 Chip Selection"

config IMX6_ECSPI
	bool
	default n

menu "iMX.6 Peripheral Selection"

config IMX6_ECSPI1
	bool "ECSPI1"
	default n
	select IMX6_ECSPI

config IMX6_ECSPI2
	bool "ECSPI2"
	default n
	select IMX6_ECSPI

config IMX6_ECSPI3
	bool "ECSPI3"
	default n
	select IMX6_ECSPI

config IMX6_ECSPI4
	bool "ECSPI4"
	default n
	select IMX6_ECSPI

config IMX6_ECSPI5
	bool "ECSPI5"
	default n
	select IMX6_ECSPI

config IMX6_UART1
	bool "UART1"
	default n
	select UART1_SERIALDRIVER
	select ARCH_HAVE_SERIAL_TERMIOS

config IMX6_UART2
	bool "UART2"
	default n
	select UART2_SERIALDRIVER
	select ARCH_HAVE_SERIAL_TERMIOS

config IMX6_UART3
	bool "UART3"
	default n
	select UART3_SERIALDRIVER
	select ARCH_HAVE_SERIAL_TERMIOS

config IMX6_UART4
	bool "UART4"
	default n
	select UART4_SERIALDRIVER
	select ARCH_HAVE_SERIAL_TERMIOS

config IMX6_UART5
	bool "UART5"
	default n
	select UART5_SERIALDRIVER
	select ARCH_HAVE_SERIAL_TERMIOS

config IMX6_SPI1
	bool "SPI1"
	default n
	select SPI

config IMX6_SPI2
	bool "SPI2"
	default n
	select SPI

config IMX6_ENET
	bool "Ethernet"
	default n
	select ARCH_HAVE_PHY
	select ARCH_PHY_INTERRUPT
	select ARCH_HAVE_NETDEV_STATISTICS

endmenu # iMX Peripheral Selection

menu "Ethernet Configuration"
	depends on IMX6_ENET

config IMX_ENET_NRXBUFFERS
	int "Number Rx buffers"
	default 6

config IMX_ENET_NTXBUFFERS
	int "Number Tx buffers"
	default 2

config IMX_ENET_ENHANCEDBD
	bool # not optional
	default n if ARMV7A_DCACHE_DISABLE
	default y if !ARMV7A_DCACHE_DISABLE

config IMX_ENET_NETHIFS
	int  # Not optional
	default 1

config IMX_ENET_PHYINIT
	bool "Board-specific PHY Initialization"
	default n
	---help---
		Some boards require specialized initialization of the PHY before it
		can be used.  This may include such things as configuring GPIOs,
		resetting the PHY, etc.  If CONFIG_IMX_ENET_PHYINIT is defined in
		the configuration then the board specific logic must provide
		imx_phy_boardinitialize();  The i.MX6 ENET driver will call this
		function one time before it first uses the PHY.

config IMX_ENET_WITH_QEMU
	bool "With QEMU"
	default y

endmenu # IMX_ENET

config IMX_DDR_SIZE
	int "Installed DRAM size (bytes)"
	default 268435456

choice
	prompt "i.MX6 Boot Configuration"
	default IMX6_BOOT_SDRAM
	---help---
		The startup code needs to know if the code is running from internal SRAM,
		external SRAM, or CS0-3 in order to initialize properly.  Note that the
		boot device is not specified for cases where the code is copied into
		RAM.

config IMX6_BOOT_OCRAM
	bool "Running from internal OCRAM"
	depends on BOOT_RUNFROMISRAM

config IMX6_BOOT_SDRAM
	bool "Running from external SDRAM"
	depends on BOOT_RUNFROMSDRAM

config IMX6_BOOT_NOR
	bool "Running from external NOR FLASH"
	depends on BOOT_RUNFROMFLASH

config IMX6_BOOT_SRAM
	bool "Running from external SRAM"
	depends on BOOT_RUNFROMEXTSRAM

endchoice # i.MX6 Boot Configuration

config IMX6_DDRCS_PGHEAP
	bool "Include DDR-SDRAM in page cache"
	default y
	depends on IMX6_BOOT_SDRAM && ARCH_ADDRENV
	---help---
		Include a portion of DDR-SDRAM memory in the page cache.

if IMX6_DDRCS_PGHEAP

config IMX6_DDRCS_PGHEAP_OFFSET
	hex "DDR-SDRAM heap offset"
	default 0x0
	---help---
		Preserve this number of bytes at the beginning of SDRAM.  The
		portion of DRAM beginning at this offset from the DDRCS base will
		be added to the heap.

config IMX6_DDRCS_PGHEAP_SIZE
	int "DDR-SDRAM heap size"
	default 0
	---help---
		Add the region of DDR-SDRAM beginning at IMX6_DDRCS_PGHEAP_OFFSET
		and of size IMX6_DDRCS_PGHEAP_SIZE to the heap.

endif # IMX6_DDRCS_PGHEAP

endif # ARCH_CHIP_IMX6
```
