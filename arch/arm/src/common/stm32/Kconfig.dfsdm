## arch/arm/src/common/stm32/Kconfig.memory
```kconfig
#
# STM32 memory configuration options.
#

config STM32_SRAM5_HEAP
	bool "SRAM5 is used for heap"
	depends on STM32_SRAM5
	default n

config STM32_EXTERNAL_RAM
	bool "External RAM on FSMC/FMC"
	depends on STM32_FSMC || STM32_FMC
	select ARCH_HAVE_HEAP2
	---help---
		In addition to internal SRAM, external RAM may be available through the FSMC/FMC.

config STM32_BBSRAM_FILES
	int "Max Files to support in BBSRAM"
	depends on STM32_BBSRAM
	default 4

config STM32_SAVE_CRASHDUMP
	bool "Enable Saving Panic to BBSRAM"
	depends on STM32_BBSRAM

config STM32_DTCMEXCLUDE
	bool "Exclude DTCM SRAM from the heap"
	depends on ARMV7M_HAVE_DTCM
	default LIBC_ARCH_ELF
	---help---
		Exclude DTCM SRAM from the HEAP because it appears to be impossible
		to execute ELF modules from DTCM RAM (REVISIT!).

config STM32_DTCM_PROCFS
	bool "DTCM SRAM PROCFS support"
	depends on ARMV7M_DTCM && FS_PROCFS
	---help---
		Select to build in support for /proc/dtcm.  Reading from /proc/dtcm
		will provide statistics about DTCM memory use similar to what you
		would get from mallinfo() for the user heap.

config STM32_SRAM2_HEAP
	bool "SRAM2 is used for heap"
	depends on STM32_COMMON_SRAM2_OPTIONS
	select STM32_SRAM2_INIT if !ARCH_CHIP_STM32U5 || STM32_SRAM2
	---help---
		The STM32L4 SRAM2 region has special properties (power, protection, parity)
		which may be used by the application for special purposes.  But if these
		special properties are not needed, it may be instead added to the heap for
		use by malloc().
		NOTE: you must also select an appropriate number of memory regions in the
		'Memory Management' section.

config STM32_SRAM2_INIT
	bool "SRAM2 is initialized to zero"
	depends on STM32_COMMON_SRAM2_OPTIONS
	---help---
		The STM32L4 SRAM2 region has parity checking.  However, when the system
		powers on, the memory is in an unknown state, and reads from uninitialized
		memory can trigger parity faults from the random data.  This can be
		avoided by first writing to all locations to force the parity into a valid
		state.
		However, if the SRAM2 is being used for it's battery-backed capability,
		this may be undesirable (because it will destroy the contents).  In that
		case, the board should handle the initialization itself at the appropriate
		time.

config STM32_SRAM3_HEAP
	bool "SRAM3 is used for heap"
	depends on STM32_SRAM3
	default y if ARCH_CHIP_STM32L4 && STM32_STM32L4XR
	---help---
		Add the STM32L4 SRAM3 to the heap for use by malloc().
		NOTE: you must also select an appropriate number of memory regions in the
		'Memory Management' section.

config STM32_CCMEXCLUDE
	bool "Exclude CCM SRAM from the heap"
	default ARCH_DMA || LIBC_ARCH_ELF
	depends on STM32_HAVE_CCM
	---help---
		Exclude CCM SRAM from the HEAP because (1) it cannot be used for DMA
		and (2) it appears to be impossible to execute ELF modules from CCM
		RAM.

config STM32_CCM_PROCFS
	bool "CCM PROCFS support"
	default n
	depends on !DISABLE_MOUNTPOINT && FS_PROCFS && FS_PROCFS_REGISTER
	---help---
		Select to build in support for /proc/ccm.  Reading from /proc/ccm
		will provide statistics about CCM memory use similar to what you
		would get from mallinfo() for the user heap.

comment "STM32WB SRAM2a and SRAM2b Options"
	depends on STM32_HAVE_SRAM2A || STM32_HAVE_SRAM2B

config STM32_SRAM2A_HEAP
	bool "SRAM2a is used for heap"
	depends on STM32_HAVE_SRAM2A
	default n

config STM32_SRAM2A_USER_BASE_OFFSET
	int "SRAM2a user application base offset"
	default 2048
	range 0 32768
	depends on STM32_SRAM2A_HEAP
	---help---
		The beginning part of the SRAM2a memory can be used by RF stack.  The
		available space for the user application can be obtained from the
		release notes for STM32WB coprocessor wireless binaries.

config STM32_SRAM2A_USER_SIZE
	int "SRAM2a user application size"
	default 8192
	range 0 32768
	depends on STM32_SRAM2A_HEAP
	---help---
		The ending part of the SRAM2a memory contains a secure section, which
		cannot be read nor written by CPU1.  The secure start address for the
		SRAM2a memory can be read from the SBRSA option byte.  When CPU2 update
		support required, there must be some free sectors just below the secure
		memory to support CPU2 firmware updates requiring more sectors to be
		secure.

config STM32_SRAM2A_INIT
	bool "SRAM2a is initialized to zero"
	default y
	depends on STM32_SRAM2A_HEAP
	---help---
		The STM32WB SRAM2a region has parity checking.  However, when the system
		powers on, the memory is in an unknown state, and reads from uninitialized
		memory can trigger parity faults from the random data.  This can be
		avoided by first writing to all locations to force the parity into a valid
		state.
		However, if the SRAM2a is being retained in Standby mode, this may be
		undesirable (because it will destroy the contents).  In that case, the board
		should handle the initialization itself at the appropriate time.

config STM32_SRAM2B_HEAP
	bool "SRAM2b is used for heap"
	depends on STM32_HAVE_SRAM2B
	default n

config STM32_SRAM2B_USER_SIZE
	int "SRAM2b user application size"
	default 32768
	range 0 32768
	depends on STM32_SRAM2B_HEAP
	---help---
		For any CPU2 firmware supporting the BLE protocol the ending part of
		the SRAM2b memory contains a secure section, which cannot be read nor
		written by CPU1.  The secure start address for the SRAM2b memory can be
		read from the SNBRSA option byte. When CPU2 update support required,
		there must be some free sectors just below the secure memory to support
		CPU2 firmware updates requiring more sectors to be secure.  The SRAM2b
		memory is all secure for any CPU2 firmware supporting the Thread protocol.

config STM32_SRAM2B_INIT
	bool "SRAM2b is initialized to zero"
	default y
	depends on STM32_SRAM2B_HEAP
	---help---
		The STM32WB SRAM2b region has parity checking.  However, when the system
		powers on, the memory is in an unknown state, and reads from uninitialized
		memory can trigger parity faults from the random data.  This can be
		avoided by first writing to all locations to force the parity into a valid
		state.
```
