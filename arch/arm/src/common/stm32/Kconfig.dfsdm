## arch/arm/src/common/stm32/Kconfig.qspi
```kconfig
#
# STM32 QSPI/OCTOSPI configuration options.
#

choice
	prompt "DMA Channel"
	default STM32_QSPI_DMA_CHAN_1_5
	depends on ARCH_CHIP_STM32L4
	---help---
		You can choose between two DMA channels for use with QSPI:
		either DMA1 channel 5, or DMA2 channel 7.
		If you only see one choice here, it is probably because
		you have not also enabled the associated DMA controller.

config STM32_QSPI_DMA_CHAN_1_5
	bool "DMA1 Channel 5"
	depends on STM32_DMA1 && !STM32_DMAMUX
	---help---
		Use DMA1 channel 5 for QSPI.

config STM32_QSPI_DMA_CHAN_2_7
	bool "DMA2 Channel 7"
	depends on STM32_DMA2 && !STM32_DMAMUX
	---help---
		Use DMA2 channel 7 for QSPI.

endchoice

choice
	prompt "Transfer technique"
	default STM32_QSPI_DMA
	---help---
		You can choose between using polling, interrupts, or DMA to transfer data
		over the QSPI interface.

config STM32_QSPI_POLLING
	bool "Polling"
	---help---
		Use conventional register I/O with status polling to transfer data.

config STM32_QSPI_INTERRUPTS
	bool "Interrupts"
	---help---
		User interrupt driven I/O transfers.

config STM32_QSPI_DMA
	bool "DMA"
	depends on STM32_DMA
	---help---
		Use DMA to improve QSPI transfer performance.

endchoice

choice
	prompt "Bank selection"
	default STM32_QSPI_MODE_BANK1
	---help---
		You can choose between using polling, interrupts, or DMA to transfer data
		over the QSPI interface.

config STM32_QSPI_MODE_BANK1
	bool "Bank 1"

config STM32_QSPI_MODE_BANK2
	bool "Bank 2"

config STM32_QSPI_MODE_DUAL
	bool "Dual Bank"

endchoice

choice
	prompt "DMA Priority"
	depends on STM32_QSPI_DMA && STM32_DMA
	default STM32_QSPI_DMAPRIORITY_MEDIUM
	---help---
		The DMA controller supports priority levels.  You are probably fine
		with the default of 'medium' except for special cases.  In the event
		of contention between to channels at the same priority, the lower
		numbered channel has hardware priority over the higher numbered one.

config STM32_QSPI_DMAPRIORITY_VERYHIGH
	bool "Very High priority"
	depends on STM32_DMA
	---help---
		'Highest' priority.

config STM32_QSPI_DMAPRIORITY_HIGH
	bool "High priority"
	depends on STM32_DMA
	---help---
		'High' priority.

config STM32_QSPI_DMAPRIORITY_MEDIUM
	bool "Medium priority"
	depends on STM32_DMA
	---help---
		'Medium' priority.

config STM32_QSPI_DMAPRIORITY_LOW
	bool "Low priority"
	depends on STM32_DMA
	---help---
		'Low' priority.

endchoice

config STM32_QSPI_FLASH_SIZE
	int "Size of attached serial flash, bytes"
	default 16777216
	range 1 2147483647 if ARCH_CHIP_STM32L4 && STM32_QSPI
	range 1 2147483648 if STM32_COMMON_F7_H7 && STM32_QSPI || ARCH_CHIP_STM32H5 && STM32_QSPI1
	---help---
		The STM32F7 QSPI peripheral requires the size of the Flash be specified

config STM32_QSPI_FIFO_THESHOLD
	int "Number of bytes before asserting FIFO threshold flag"
	default 4
	range 1 16 if STM32_COMMON_F7_H7 && STM32_QSPI || ARCH_CHIP_STM32L4 && STM32_QSPI
	range 1 32 if ARCH_CHIP_STM32H5 && STM32_QSPI1
	---help---
		The STM32F7 QSPI peripheral requires that the FIFO threshold be specified
		I would leave it at the default value of 4 unless you know what you are doing.

config STM32_QSPI_CSHT
	int "Number of cycles Chip Select must be inactive between transactions"
	default 5 if ARCH_CHIP_STM32H5 && STM32_QSPI1
	default 1
	range 1 8 if STM32_COMMON_F7_H7 && STM32_QSPI || ARCH_CHIP_STM32L4 && STM32_QSPI
	range 1 64 if ARCH_CHIP_STM32H5 && STM32_QSPI1
	---help---
		The STM32F7 QSPI peripheral requires that it be specified the minimum number
		of AHB cycles that Chip Select be held inactive between transactions.

config STM32_QSPI_DMATHRESHOLD
	int "QSPI DMA threshold"
	depends on STM32_QSPI_DMA
	default 4
	---help---
		When QSPI DMA is enabled, small DMA transfers will still be performed
		by polling logic.  This value is the threshold below which transfers
		will still be performed by conventional register status polling.

config STM32_QSPI_DMADEBUG
	bool "QSPI DMA transfer debug"
	depends on STM32_QSPI_DMA && DEBUG_SPI && DEBUG_DMA
	---help---
		Enable special debug instrumentation to analyze QSPI DMA data transfers.
		This logic is as non-invasive as possible:  It samples DMA
		registers at key points in the data transfer and then dumps all of
		the registers at the end of the transfer.

config STM32_QSPI_REGDEBUG
	bool "QSPI Register level debug"
	depends on DEBUG_SPI_INFO
	---help---
		Output detailed register-level QSPI device debug information.
		Requires also CONFIG_DEBUG_SPI_INFO.
```

## arch/arm/src/common/stm32/Kconfig.rtc
```kconfig
#
# STM32 common RTC options.
#

choice
	prompt "RTC clock source"
	depends on STM32_RTC
	default STM32_RTC_LSECLOCK

config STM32_RTC_LSECLOCK
	bool "LSE clock"
	---help---
		Drive the RTC with the LSE clock

config STM32_RTC_LSICLOCK
	bool "LSI clock"
	---help---
		Drive the RTC with the LSI clock

config STM32_RTC_HSECLOCK
	bool "HSE clock"
	---help---
		Drive the RTC with the HSE clock, divided down to 1MHz.

endchoice # RTC clock source

config STM32_RTC_MAGIC_REG
	int "BKP register"
	depends on STM32_HAVE_RTC_MAGIC
	default 0
	range 0 19 if STM32_COMMON_LEGACY && STM32_RTC && !STM32_HAVE_RTC_COUNTER
	range 0 31 if STM32_HAVE_RTC_SUBSECONDS || ARCH_CHIP_STM32U5
	---help---
		The BKP register used to store/check the Magic value to determine if
		RTC is already setup

config STM32_RTC_MAGIC
	hex "RTC Magic 1"
	depends on STM32_HAVE_RTC_MAGIC
	default 0xfacefeed
	---help---
		Value used as Magic to determine if the RTC is already setup

config STM32_RTC_MAGIC_TIME_SET
	hex "RTC Magic 2"
	depends on STM32_HAVE_RTC_MAGIC
	default 0xf00dface
	---help---
		Value used as Magic to determine if the RTC has been setup and has
		time set

config STM32_RTC_AUTO_LSECLOCK_START_DRV_CAPABILITY
	bool "Automatically boost the LSE oscillator drive capability level until it starts-up"
	depends on (STM32_COMMON_F7_H7 || STM32_COMMON_L5_U5) && STM32_RTC && STM32_RTC_LSECLOCK
	---help---
		This will cycle through the values from low to high. To avoid
		damaging the crystal. We want to use the lowest setting that gets
		the OSC running. See app note AN2867

			0 = Low drive capability (default)
			1 = Medium high drive capability
			2 = Medium low drive capability
			3 = High drive capability

config STM32_RTC_LSECLOCK_START_DRV_CAPABILITY
	int "LSE oscillator drive capability level at LSE start-up"
	depends on ((STM32_COMMON_F7_H7 || STM32_COMMON_L5_U5) && !STM32_RTC_AUTO_LSECLOCK_START_DRV_CAPABILITY || ARCH_CHIP_STM32L4 || ARCH_CHIP_STM32WB) && STM32_RTC && STM32_RTC_LSECLOCK
	default 0
	range 0 3 if ((STM32_COMMON_F7_H7 || STM32_COMMON_L5_U5) && !STM32_RTC_AUTO_LSECLOCK_START_DRV_CAPABILITY) || ARCH_CHIP_STM32L4 || ARCH_CHIP_STM32WB
	---help---
		0 = Low drive capability (default)
		1 = Medium high drive capability
		2 = Medium low drive capability
		3 = High drive capability

config STM32_RTC_LSECLOCK_RUN_DRV_CAPABILITY
	int "LSE oscillator drive capability level after LSE start-up"
	depends on ((STM32_COMMON_F7_H7 || STM32_COMMON_L5_U5) && !STM32_RTC_AUTO_LSECLOCK_START_DRV_CAPABILITY || ARCH_CHIP_STM32L4 || ARCH_CHIP_STM32WB) && STM32_RTC && STM32_RTC_LSECLOCK && !STM32_COMMON_L5_U5
	default 0
	range 0 3 if ((STM32_COMMON_F7_H7 || STM32_COMMON_L5_U5) && !STM32_RTC_AUTO_LSECLOCK_START_DRV_CAPABILITY) || ARCH_CHIP_STM32L4 || ARCH_CHIP_STM32WB
	---help---
		0 = Low drive capability (default)
		1 = Medium high drive capability
		2 = Medium low drive capability
		3 = High drive capability

config STM32_RTC_LSECLOCK_LOWER_RUN_DRV_CAPABILITY
	bool "Decrease LSE oscillator drive capability after LSE start-up"
	depends on STM32_COMMON_L5_U5 && STM32_RTC && STM32_RTC_LSECLOCK && !STM32_RTC_AUTO_LSECLOCK_START_DRV_CAPABILITY
	---help---
		The LSE oscillator drive capability can remain at the level used
		during LSE start-up at run-time, or it can be reduced to the
		'Low drive capability' once the LSE started up successfully.
```

## arch/arm/src/common/stm32/Kconfig.sai
```kconfig
#
# STM32 common SAI options.
#

choice
	prompt "Operation mode"
	depends on STM32_SAI
	default STM32_SAI_DMA
	---help---
		Select the operation mode the SAI driver should use.

config STM32_SAI_POLLING
	bool "Polling"
	---help---
		The SAI registers are polled for events.

config STM32_SAI_INTERRUPTS
	bool "Interrupt"
	---help---
		Select to enable interrupt driven SAI support.

config STM32_SAI_DMA
	bool "DMA"
	---help---
		Use DMA to improve SAI transfer performance.

endchoice # Operation mode

choice
	prompt "SAI1 synchronization enable"
	depends on STM32_SAI1_A && STM32_SAI1_B
	default STM32_SAI1_BOTH_ASYNC
	---help---
		Select the synchronization mode of the SAI sub-blocks

config STM32_SAI1_BOTH_ASYNC
	bool "Both asynchronous"

config STM32_SAI1_A_SYNC_WITH_B
	bool "Block A is synchronous with Block B"

config STM32_SAI1_B_SYNC_WITH_A
	bool "Block B is synchronous with Block A"

endchoice # SAI1 synchronization enable

choice
	prompt "SAI2 synchronization enable"
	depends on STM32_SAI2_A && STM32_SAI2_B
	default STM32_SAI2_BOTH_ASYNC
	---help---
		Select the synchronization mode of the SAI sub-blocks

config STM32_SAI2_BOTH_ASYNC
	bool "Both asynchronous"

config STM32_SAI2_A_SYNC_WITH_B
	bool "Block A is synchronous with Block B"

config STM32_SAI2_B_SYNC_WITH_A
	bool "Block B is synchronous with Block A"

endchoice # SAI2 synchronization enable

config STM32_SAI1PLL
	bool "SAI1PLL"
	depends on STM32_COMMON_L4_L5_U5
	---help---
		The STM32L4 has a separate PLL for the SAI1 block.
		Set this true and provide configuration parameters in
		board.h to use this PLL.

config STM32_SAI2PLL
	bool "SAI2PLL"
	depends on STM32_COMMON_L4_L5_U5 && STM32_HAVE_SAI2
	---help---
		The STM32L4 has a separate PLL for the SAI2 block.
		Set this true and provide configuration parameters in
		board.h to use this PLL.

config STM32_SAIPLL
	bool "SAIPLL"
	default n
	depends on STM32_HAVE_SAIPLL
	---help---
		The STM32F446 has a separate PLL for the SAI block.
		Set this true and provide configuration parameters in
		board.h to use this PLL.
```

## arch/arm/src/common/stm32/Kconfig.sdadc
```kconfig
#
# STM32 common SDADC options.
#

config STM32_SDADC1_HAVE_DMA
	bool

config STM32_SDADC2_HAVE_DMA
	bool

config STM32_SDADC3_HAVE_DMA
	bool

config STM32_SDADC1_DMA
	bool "SDADC1 DMA"
	depends on STM32_SDADC1 && STM32_SDADC1_HAVE_DMA
	default n
	---help---
		If DMA is selected, then the SDADC may be configured to support
		DMA transfer, which is advisable if multiple channels are read
		or if very high trigger frequencies are used.

config STM32_SDADC2_DMA
	bool "SDADC2 DMA"
	depends on STM32_SDADC2 && STM32_SDADC2_HAVE_DMA
	default n
	---help---
		If DMA is selected, then the SDADC may be configured to support
		DMA transfer, which is advisable if multiple channels are read
		or if very high trigger frequencies are used.

config STM32_SDADC3_DMA
	bool "SDADC3 DMA"
	depends on STM32_SDADC3 && STM32_SDADC3_HAVE_DMA
	default n
	---help---
		If DMA is selected, then the SDADC may be configured to support
		DMA transfer, which is advisable if multiple channels are read
		or if very high trigger frequencies are used.
```

## arch/arm/src/common/stm32/Kconfig.sdio
```kconfig
#
# STM32 common SDIO options.
#

config STM32_SDMMC2_HAVE_DMAPRIO
	bool
	default y if ARCH_CHIP_STM32F7

config STM32_SDIO_CARD
	bool "SDIO Card support"
	depends on STM32_COMMON_LEGACY && STM32_SDIO
	default n
	---help---
		Build in additional support needed only for SDIO cards (vs. SD
		memory cards)

config STM32_SDIO_PULLUP
	bool "Enable internal Pull-Ups"
	depends on STM32_COMMON_LEGACY && STM32_SDIO
	default n
	---help---
		If you are using an external SDCard module that does not have the
		pull-up resistors for the SDIO interface (like the Gadgeteer SD Card
		Module) then enable this option to activate the internal pull-up
		resistors.

config STM32_SDIO_DMA
	bool "Support DMA data transfers"
	default STM32_DMA2
	select SDIO_DMA
	depends on STM32_COMMON_LEGACY && STM32_SDIO
	depends on STM32_DMA2
	---help---
		Support DMA data transfers.  Requires STM32_SDIO and config STM32_DMA2.

config STM32_SDIO_DMAPRIO
	hex "SDIO DMA priority"
	default 0x00001000 if STM32_STM32F10XX
	default 0x00010000 if !STM32_STM32F10XX
	depends on STM32_COMMON_LEGACY && STM32_SDIO
	---help---
		Select SDIO DMA priority.

		For STM32 F1 family, options are: 0x00000000 low, 0x00001000 medium,
		0x00002000 high, 0x00003000 very high.  Default: medium.

		For other STM32's, options are: 0x00000000 low, 0x00010000 medium,
		0x00020000 high, 0x00030000 very high.  Default: medium.

config STM32_SDIO_WIDTH_D1_ONLY
	bool "Use D1 only"
	depends on STM32_COMMON_LEGACY && STM32_SDIO
	default n
	---help---
		Select 1-bit transfer mode.  Default: 4-bit transfer mode.

config STM32_SDMMC_IDMA
	bool "Support IDMA data transfers"
	depends on ARCH_CHIP_STM32H7 && STM32_SDMMC
	default y
	select SDIO_DMA
	---help---
		Support IDMA data transfers.

if STM32_SDMMC

config STM32_SDMMC_XFRDEBUG
	bool "SDMMC transfer debug"
	depends on DEBUG_FS_INFO
	---help---
		Enable special debug instrumentation analyze SDMMC data transfers.
		This logic is as non-invasive as possible:  It samples SDMMC
		registers at key points in the data transfer and then dumps all of
		the registers at the end of the transfer.  If DEBUG_DMA is also
		enabled, then DMA register will be collected as well.  Requires also
		DEBUG_FS and CONFIG_DEBUG_INFO.

config STM32_SDMMC_DMA
	bool "Support DMA data transfers"
	depends on (ARCH_CHIP_STM32F7 || STM32_COMMON_L4_L5_U5) && STM32_SDMMC && STM32_DMA
	select SDIO_DMA
	---help---
		Support DMA data transfers.

config STM32_SDMMC1_DMAPRIO
	hex "SDMMC1 DMA priority"
	depends on (ARCH_CHIP_STM32F7 || STM32_COMMON_L4_L5_U5) && STM32_SDMMC1
	default 0x00010000 if ARCH_CHIP_STM32F7
	default 0x00001000
	---help---
		Select SDMMC1 DMA priority.

		Options are: 0x00000000 low, 0x00010000 medium,
		0x00020000 high, 0x00030000 very high.  Default: medium.

config SDMMC1_WIDTH_D1_ONLY
	bool "Use D1 only on SDMMC1"
	depends on STM32_SDMMC1
	---help---
		Select 1-bit transfer mode.  Default: 4-bit transfer mode.

config SDMMC1_SDIO_MODE
	bool "SDIO Card Support"
	depends on STM32_COMMON_F7_H7 && STM32_SDMMC && STM32_SDMMC1
	---help---
		Build in additional support needed only for SDIO cards (vs. SD
		memory cards)

config SDMMC1_SDIO_PULLUP
	bool "Enable internal Pull-Ups"
	depends on STM32_COMMON_F7_H7 && STM32_SDMMC && STM32_SDMMC1
	---help---
		If you are using an external SDCard module that does not have the
		pull-up resistors for the SDIO interface (like the Gadgeteer SD Card
		Module) then enable this option to activate the internal pull-up
		resistors.

config SDMMC2_WIDTH_D1_ONLY
	bool "Use D1 only on SDMMC2"
	depends on STM32_COMMON_F7_H7 && STM32_SDMMC && STM32_SDMMC2
	---help---
		Select 1-bit transfer mode.  Default: 4-bit transfer mode.

config SDMMC2_SDIO_MODE
	bool "SDIO Card Support"
	depends on STM32_COMMON_F7_H7 && STM32_SDMMC && STM32_SDMMC2
	---help---
		Build in additional support needed only for SDIO cards (vs. SD
		memory cards)

config SDMMC2_SDIO_PULLUP
	bool "Enable internal Pull-Ups"
	depends on STM32_COMMON_F7_H7 && STM32_SDMMC && STM32_SDMMC2
	---help---
		If you are using an external SDCard module that does not have the
		pull-up resistors for the SDIO interface (like the Gadgeteer SD Card
		Module) then enable this option to activate the internal pull-up
		resistors.

config STM32_SDMMC2_DMAPRIO
	hex "SDMMC2 DMA priority"
	default 0x00010000
	depends on STM32_SDMMC2 && STM32_SDMMC2_HAVE_DMAPRIO
	---help---
		Select SDMMC2 DMA priority.

		Options are: 0x00000000 low, 0x00010000 medium,
		0x00020000 high, 0x00030000 very high.  Default: medium.

endif # STM32_SDMMC
```
