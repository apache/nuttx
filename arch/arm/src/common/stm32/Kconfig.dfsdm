## arch/arm/src/common/stm32/Kconfig.dfsdm
```kconfig
#
# STM32 digital filter configuration options.
#

config STM32_ADC1_DFSDM_L4_CHIP
	bool
	default y if STM32_STM32L496XX || STM32_STM32L4XR
	select STM32_ADC1_HAVE_OUTPUT_DFSDM

config STM32_ADC1_DFSDM_L5_CHIP
	bool
	default y if STM32_STM32L596XX || STM32_STM32L5XR
	select STM32_ADC1_HAVE_OUTPUT_DFSDM

config STM32_ADC1_DFSDM_U5_CHIP
	bool
	default y if STM32_STM32U596XX || STM32_STM32U5XR
	select STM32_ADC1_HAVE_OUTPUT_DFSDM

config STM32_DFSDM1_FLT0
	bool "DFSDM1 Filter 0"
	depends on STM32_COMMON_L4_L5_U5 && STM32_DFSDM1
	select STM32_DFSDM

config STM32_DFSDM1_FLT1
	bool "DFSDM1 Filter 1"
	depends on STM32_COMMON_L4_L5_U5 && STM32_DFSDM1
	select STM32_DFSDM

config STM32_DFSDM1_FLT2
	bool "DFSDM1 Filter 2"
	depends on (ARCH_CHIP_STM32L4 && STM32_DFSDM1 && !STM32_STM32L4X3) || (ARCH_CHIP_STM32L5 && STM32_DFSDM1 && !STM32_STM32L5X3) || (ARCH_CHIP_STM32U5 && STM32_DFSDM1 && !STM32_STM32U5X3)
	select STM32_DFSDM

config STM32_DFSDM1_FLT3
	bool "DFSDM1 Filter 3"
	depends on (ARCH_CHIP_STM32L4 && STM32_DFSDM1 && !STM32_STM32L4X3) || (ARCH_CHIP_STM32L5 && STM32_DFSDM1 && !STM32_STM32L5X3) || (ARCH_CHIP_STM32U5 && STM32_DFSDM1 && !STM32_STM32U5X3)
	select STM32_DFSDM

config STM32_DFSDM1_DMA
	bool "DFSDM1 DMA"
	depends on STM32_COMMON_L4_L5_U5 && STM32_DFSDM1 && STM32_DFSDM
	---help---
		If DMA is selected, then the DFSDM may be configured to support
		DMA transfer, which is necessary if multiple channels are read
		or if very high trigger frequencies are used.
```

## arch/arm/src/common/stm32/Kconfig.dma
```kconfig
#
# STM32 DMA configuration options.
#

config STM32_DMA1_HAVE_CHAN8
	bool
	default y if STM32_STM32G47XX

config STM32_DMA2_HAVE_CHAN678
	bool
	default y if STM32_STM32G47XX

config STM32_DMACAPABLE
	bool "Workaround non-DMA capable memory"
	depends on (STM32_COMMON_LEGACY || STM32_COMMON_F7_H7) && ARCH_DMA
	default STM32_STM32F4XXX && !STM32_CCMEXCLUDE if STM32_COMMON_LEGACY && ARCH_DMA
	---help---
		This option enables the DMA interface stm32_dmacapable that can be
		used to check if it is possible to do DMA from the selected address.
		Drivers then may use this information to determine if they should
		attempt the DMA or fall back to a different transfer method.

if STM32_DMA2D

config STM32_DMA2D_NLAYERS
	int "Number DMA2D overlays"
	default 1
	range 1 256
	---help---
		Number of supported DMA2D layer.

config STM32_DMA2D_LAYER_SHARED
	bool "Overlays shared memory region"
	---help---
		Several overlays can share the same memory region.
		Setup a whole memory area (usually multiple size of the visible screen)
		allows image preprocessing before they become visible by blit operation.

config STM32_DMA2D_LAYER_PPLINE
	int "Pixel per line"
	default 1
	range 1 65535
	---help---
		If you are using the DMA2D, then you must provide the pixel per line or
		width of the overlay.

config STM32_DMA2D_FB_BASE
	hex "Framebuffer memory start address"
	default 0
	---help---
		If you are using the DMA2D, then you must provide the address
		of the start of the DMA2D overlays framebuffer. This address will typically
		be in the SRAM or SDRAM memory region of the FSMC/FMC.

config STM32_DMA2D_FB_SIZE
	int "Framebuffer memory size (bytes)"
	default 0
	---help---
		Must be the whole size of all DMA2D overlays.

config STM32_DMA2D_L8
	bool "8 bpp L8 (8-bit CLUT)"
	depends on STM32_FB_CMAP && STM32_LTDC_L1_L8
	default y

config STM32_DMA2D_AL44
	bool "8 bpp AL44 (4-bit alpha + 4-bit CLUT)"
	depends on STM32_FB_CMAP && STM32_LTDC_L1_AL44
	default y

config STM32_DMA2D_AL88
	bool "16 bpp AL88 (8-bit alpha + 8-bit CLUT)"
	depends on STM32_FB_CMAP && STM32_LTDC_L1_AL88
	default y

config STM32_DMA2D_RGB565
	bool "16 bpp RGB 565"
	depends on STM32_LTDC_L1_RGB565
	default y

config STM32_DMA2D_ARGB4444
	bool "16 bpp ARGB 4444"
	depends on STM32_LTDC_L1_ARGB4444
	default y

config STM32_DMA2D_ARGB1555
	bool "16 bpp ARGB 1555"
	depends on STM32_LTDC_L1_ARGB15555
	default y

config STM32_DMA2D_RGB888
	bool "24 bpp RGB 888"
	depends on STM32_LTDC_L1_RGB888
	default y

config STM32_DMA2D_ARGB8888
	bool "32 bpp ARGB 8888"
	depends on STM32_LTDC_L1_ARGB8888
	default y

config STM32_DMA2D_REGDEBUG
	bool "DMA2D Register level debug"
	depends on DEBUG_INFO && DEBUG_LCD
	---help---
		Output detailed register-level DMA2D device debug information.

endif # STM32_DMA2D

config STM32_DMACAPABLE_ASSUME_CACHE_ALIGNED
	bool "Do not disqualify DMA capability based on cache alignment"
	depends on STM32_COMMON_F7_H7 && STM32_DMACAPABLE && ARMV7M_DCACHE && !ARMV7M_DCACHE_WRITETHROUGH
	---help---
		This option configures the stm32_dmacapable to not disqualify
		DMA operations on memory that is not dcache aligned based solely
		on the starting address and byte count.

		Use this when ALL buffer extents are known to be aligned, but the
		the count does not use the complete buffer.
```

## arch/arm/src/common/stm32/Kconfig.dts
```kconfig
#
# STM32 Digital Temperature Sensor (DTS) configuration options.
#

config STM32_DTS_REFCLK_LSE
	bool "Use LSE (32.768 kHz crystal) as DTS reference clock"
	default n
	---help---
		Select the low-speed external (LSE) oscillator as the reference clock
		for the DTS.  When enabled, DTS_CFGR1.REFCLK_SEL=1 and the driver will
		measure FM(T) pulses over N LSE cycles.

		If disabled, the DTS will use the APB-bus clock (PCLK) as the reference
		(REFCLK_SEL=0) and you must supply a valid HSREF_CLK_DIV to keep the
		calibration prescaler ≤ 1 MHz.

config STM32_DTS_SMP_TIME
	int "DTS sampling time (TS1_SMP_TIME[3:0])"
	default 1
	range 1 15
	---help---
		Number of reference-clock cycles (PCLK or LSE) counted per
		DTS measurement.  Valid range 1 (1 cycle) through 15 (15 cycles).

config STM32_DTS_TRIGGER
	int "DTS hardware trigger source (TS1_INTRIG_SEL[3:0])"
	default 0
	---help---
		If non-zero, DTS will start measurements on the rising edge of
		the selected hardware line.  Values match RM0481 Table 275:
		0=Software Trigger, 1=LPTIM1_CH1, 
		2=LPTIM2_CH1, 3=LPTIM3_CH1, 4=EXTI13, 5-15 are reserved.

config STM32_DTS_LOW_THRESHOLD
	int "DTS low-threshold (°C)"
	default 0
	---help---
		The temperature (in whole °C) below which the DTS window comparator will
		assert the low-threshold flag (TS1_ITLF).  To disable, set equal to 0.

config STM32_DTS_HIGH_THRESHOLD
	int "DTS high-threshold (°C)"
	default 100
	---help---
		The temperature (in whole °C) above which the DTS window comparator will
		assert the high-threshold flag (TS1_ITHF).  Must be >= LOW_THRESHOLD.

config STM32_DTS_ITEN_ITEF
	bool "Enable DTS end-of-measurement interrupt (TS1_ITEF)"
	default y
	---help---
		Enable the synchronous “end of measurement” interrupt for the
		digital temperature sensor.  When set, the driver will attach
		and unmask TS1_ITEF and will call your ISR on every fresh sample.

config STM32_DTS_ITEN_ITLF
	bool "Enable DTS low-threshold interrupt (TS1_ITLF)"
	default n
	---help---
		Enable the synchronous “low threshold crossed” interrupt for the
		digital temperature sensor.  When set, the driver will unmask
		TS1_ITLF so you can get notified whenever the measured value
		drops below your programmed low-threshold.

config STM32_DTS_ITEN_ITHF
	bool "Enable DTS high-threshold interrupt (TS1_ITHF)"
	default n
	---help---
		Enable the synchronous “high threshold crossed” interrupt for the
		digital temperature sensor.  When set, the driver will unmask
		TS1_ITHF so you can get notified whenever the measured value
		exceeds your programmed high-threshold.

config STM32_DTS_AITEN_AITEF
	bool "Enable DTS asynchronous end-of-measurement interrupt (TS1_AITEF)"
	depends on STM32_DTS_REFCLK_LSE
	default n
	---help---
		Enable the asynchronous end-of-measurement interrupt.  This will
		set TS1_AITEEN in DTS_ITENR and cause an _asynchronous_ wakeup
		event when a conversion completes (in Stop/Sleep modes).

config STM32_DTS_AITEN_AITLF
	bool "Enable DTS asynchronous low-threshold interrupt (TS1_AITLF)"
	depends on STM32_DTS_REFCLK_LSE
	default n
	---help---
		Enable the asynchronous low-threshold comparator interrupt.  This
		will set TS1_AITLEN in DTS_ITENR and generate a wakeup event
		when the measurement drops below your low threshold.

config STM32_DTS_AITEN_AITHF
	bool "Enable DTS asynchronous high-threshold interrupt (TS1_AITHF)"
	depends on STM32_DTS_REFCLK_LSE
	default n
	---help---
		Enable the asynchronous high-threshold comparator interrupt.  This
		will set TS1_AITHEN in DTS_ITENR and generate a wakeup event
		when the measurement exceeds your high threshold.
```
