## arch/arm/src/common/stm32/Kconfig.flash
```kconfig
#
# STM32 flash configuration options.
#

# Common STM32 flash size designator options.

config STM32_FLASH_CONFIG_DEFAULT
	bool "Default or device-derived flash size"
	default n

config STM32_FLASH_CONFIG_4
	bool "Flash size designator 4, 16 KiB"
	default n

config STM32_FLASH_CONFIG_6
	bool "Flash size designator 6, 32 KiB"
	default n

config STM32_FLASH_CONFIG_8
	bool "Flash size designator 8, 64 KiB"
	default n

config STM32_FLASH_CONFIG_B
	bool "Flash size designator B, 128 KiB"
	default n

config STM32_FLASH_CONFIG_C
	bool "Flash size designator C, 256 KiB"
	default n

config STM32_FLASH_CONFIG_C_320
	bool "STM32WB flash size designator C, 320 KiB variant"
	default n

config STM32_FLASH_CONFIG_D
	bool "Flash size designator D, 384 KiB"
	default n

config STM32_FLASH_CONFIG_E
	bool "Flash size designator E, 512 KiB"
	default n

config STM32_FLASH_CONFIG_F
	bool "Flash size designator F, 768 KiB"
	default n

config STM32_FLASH_CONFIG_G
	bool "Flash size designator G, 1024 KiB"
	default n

config STM32_FLASH_CONFIG_I
	bool "Flash size designator I, 2048 KiB"
	default n

config STM32_FLASH_CONFIG_Y
	bool "Flash size designator Y, 640 KiB"
	default n

config STM32_FLASH_CONFIG_Z
	bool "Legacy STM32 flash size designator Z"
	default n

config STM32_FLASH_OVERRIDE
	bool "Override Flash Designator" if ARCH_CHIP_STM32G0 || ARCH_CHIP_STM32C0
	default y if ARCH_CHIP_STM32F7 || STM32_COMMON_F7_H7_H5
	default y if STM32_COMMON_L4_H5_L5_U5 || ARCH_CHIP_STM32WB
	default y if ARCH_CHIP_STM32WL5
	default n

choice
	prompt "Override Flash Size Designator"
	depends on STM32_FLASH_OVERRIDE
	default STM32_FLASH_OVERRIDE_DEFAULT
	---help---
		STM32 parts numbering ends with a number or letter that designates
		the internal FLASH size.  Select "Default" to use the size from
		the selected chip.  Select another designator only when the part
		variant differs from the listed chip selection.

config STM32_FLASH_OVERRIDE_DEFAULT
	bool "Default"

config STM32_FLASH_OVERRIDE_6
	bool "6 32KiB"

config STM32_FLASH_OVERRIDE_8
	bool "8 64KiB"

config STM32_FLASH_OVERRIDE_B
	bool "B 128KiB"

config STM32_FLASH_OVERRIDE_C
	bool "C 256KiB"

config STM32_FLASH_OVERRIDE_C_320
	bool "C 320KiB"

config STM32_FLASH_OVERRIDE_E
	bool "E 512KiB"

config STM32_FLASH_OVERRIDE_G
	bool "G 1024KiB"

config STM32_FLASH_OVERRIDE_I
	bool "I 2048KiB"

config STM32_FLASH_OVERRIDE_Y
	bool "Y 640KiB"

endchoice # Override Flash Size Designator

config STM32_FLASH_ART_ACCELERATOR
	bool "Flash ART Accelerator"
	depends on STM32_HAVE_FLASH_ART_ACCELERATOR
	default n
	---help---
		ART Accelerator on the flash memory ITCM interface accelerates code execution
		with a system of instruction prefetch and cache lines.

		Enable if code and/or read-only data is accessed through ITCM bus instead of
		AXIM bus.

config STM32_FLASH_PREFETCH
	bool "Enable FLASH Pre-fetch"
	depends on STM32_STM32F20XX || STM32_STM32F4XXX || STM32_COMMON_L4_H5_L5_U5 || ARCH_CHIP_STM32WB
	default STM32_STM32F427 || STM32_STM32F429 || STM32_STM32F446
	default y
	---help---
		Enable FLASH prefetch in F2 and F4 parts (FLASH pre-fetch is always enabled
		on F1 parts).  Some early revisions of F4 parts do not support FLASH pre-fetch
		properly and enabling this option may interfere with ADC accuracy.

config STM32_FLASH_WORKAROUND_DATA_CACHE_CORRUPTION_ON_RWW
	bool "Workaround for FLASH data cache corruption"
	depends on STM32_FLASH_DCACHE && (STM32_STM32F20XX || STM32_STM32F4XXX || (ARCH_CHIP_STM32L4 && (STM32_STM32L4X5 || STM32_STM32L4X6 || STM32_STM32L4XR)))
	---help---
		Enable the workaround to fix flash data cache corruption when reading
		from one flash bank while writing on other flash bank.  See your STM32
		errata to check if your STM32 is affected by this problem.

config STM32_PROGMEM
	bool "Flash PROGMEM support"
	depends on STM32_COMMON_F0_L0_G0_C0 && ARCH_HAVE_PROGMEM || STM32_COMMON_F7_H7_H5
	select MTD if STM32_COMMON_F0_L0_G0_C0 && ARCH_HAVE_PROGMEM
	select MTD_PROGMEM if STM32_COMMON_F0_L0_G0_C0 && ARCH_HAVE_PROGMEM
	---help---
		Add progmem support, start block and end block options are provided to
		obtain a uniform flash memory mapping.

config STM32_FLASH_ICACHE
	bool "Enable FLASH Instruction Cache"
	default y
	depends on STM32_HAVE_FLASH_ICACHE
	---help---
		Enable the FLASH instruction cache.

config STM32_FLASH_DCACHE
	bool "Enable FLASH Data Cache"
	default y
	depends on STM32_HAVE_FLASH_DCACHE
	---help---
		Enable the FLASH data cache.
```

## arch/arm/src/common/stm32/Kconfig.foc
```kconfig
#
# STM32 common FOC options.
#

config STM32_FOC_HAVE_ADC_CHAN0_WORKAROUND
	bool

config STM32_FOC_USE_TIM1
	bool
	select STM32_TIM1
	select STM32_TIM1_PWM
	select STM32_TIM1_CHANNEL1
	select STM32_TIM1_CHANNEL2
	select STM32_TIM1_CHANNEL3
	select STM32_TIM1_CHANNEL4 if STM32_FOC_ADC_CCR4
	select STM32_TIM1_CH1OUT
	select STM32_TIM1_CH2OUT
	select STM32_TIM1_CH3OUT
	select STM32_TIM1_CH4OUT if STM32_FOC_ADC_CCR4
	select STM32_TIM1_CH1NOUT if STM32_FOC_HAS_PWM_COMPLEMENTARY
	select STM32_TIM1_CH2NOUT if STM32_FOC_HAS_PWM_COMPLEMENTARY
	select STM32_TIM1_CH3NOUT if STM32_FOC_HAS_PWM_COMPLEMENTARY
	---help---
		The TIM1 generates PWM for the FOC

config STM32_FOC_USE_TIM8
	bool
	select STM32_TIM8
	select STM32_TIM8_PWM
	select STM32_TIM8_CHANNEL1
	select STM32_TIM8_CHANNEL2
	select STM32_TIM8_CHANNEL3
	select STM32_TIM8_CHANNEL4 if STM32_FOC_ADC_CCR4
	select STM32_TIM8_CH1OUT
	select STM32_TIM8_CH2OUT
	select STM32_TIM8_CH3OUT
	select STM32_TIM8_CH4OUT if STM32_FOC_ADC_CCR4
	select STM32_TIM8_CH1NOUT if STM32_FOC_HAS_PWM_COMPLEMENTARY
	select STM32_TIM8_CH2NOUT if STM32_FOC_HAS_PWM_COMPLEMENTARY
	select STM32_TIM8_CH3NOUT if STM32_FOC_HAS_PWM_COMPLEMENTARY
	---help---
		The TIM8 generates PWM for the FOC

config STM32_FOC_USE_ADC1
	bool
	select STM32_ADC1
	select STM32_ADC1_SCAN if ARCH_CHIP_STM32F7 || STM32_HAVE_IP_ADC_M3M4_V1
	select STM32_ADC1_JEXTSEL

config STM32_FOC_USE_ADC2
	bool
	select STM32_ADC2
	select STM32_ADC2_SCAN if ARCH_CHIP_STM32F7 || STM32_HAVE_IP_ADC_M3M4_V1
	select STM32_ADC2_JEXTSEL

config STM32_FOC_USE_ADC3
	bool
	select STM32_ADC3
	select STM32_ADC3_SCAN if ARCH_CHIP_STM32F7 || STM32_HAVE_IP_ADC_M3M4_V1
	select STM32_ADC3_JEXTSEL

#
#

choice
	prompt "FOC ADC trigger selection"
	depends on STM32_FOC
	default STM32_FOC_ADC_TRGO

config STM32_FOC_ADC_CCR4
	bool "FOC uses CCR4 as ADC trigger"
	---help---
		This option uses the software frequency prescaler and is
		not possible for 4-phase output.

config STM32_FOC_ADC_TRGO
	bool "FOC uses TRGO as ADC trigger"
	depends on STM32_HAVE_IP_ADC_M3M4_V2 || ARCH_CHIP_STM32F7 || (STM32_HAVE_IP_ADC_M3M4_V1 && !STM32_FOC_FOC1)
	select STM32_PWM_TRGO
	---help---
		This option allows you to use higher PWM frequency and works for 4-phase output.
		It is not possible for ADC IPv1 if FOC1 enabled (no T8TRGO in JEXTSEL).

endchoice # "FOC ADC trigger selection"

choice
	prompt "FOC0 device ADC selection"
	depends on STM32_FOC_FOC0
	default STM32_FOC_FOC0_ADC1

config STM32_FOC_FOC0_ADC1
	bool "FOC0 uses ADC1"
	depends on STM32_HAVE_ADC1
	select STM32_FOC_USE_ADC1

config STM32_FOC_FOC0_ADC2
	bool "FOC0 uses ADC2"
	depends on STM32_HAVE_ADC2
	select STM32_FOC_USE_ADC2

config STM32_FOC_FOC0_ADC3
	bool "FOC0 uses ADC3"
	depends on STM32_HAVE_ADC3
	select STM32_FOC_USE_ADC3

config STM32_FOC_FOC0_ADC4
	bool "FOC0 uses ADC4"
	depends on STM32_HAVE_ADC4
	select STM32_FOC_USE_ADC4

endchoice # "FOC0 device ADC selection"

choice
	prompt "FOC1 device ADC selection"
	depends on STM32_FOC_FOC1
	default STM32_FOC_FOC1_ADC2

config STM32_FOC_FOC1_ADC1
	bool "FOC1 uses ADC1"
	depends on STM32_HAVE_ADC1
	select STM32_FOC_USE_ADC1

config STM32_FOC_FOC1_ADC2
	bool "FOC1 uses ADC2"
	depends on STM32_HAVE_ADC2
	select STM32_FOC_USE_ADC2

config STM32_FOC_FOC1_ADC3
	bool "FOC1 uses ADC3"
	depends on STM32_HAVE_ADC3
	select STM32_FOC_USE_ADC3

config STM32_FOC_FOC1_ADC4
	bool "FOC1 uses ADC4"
	depends on STM32_HAVE_ADC4
	select STM32_FOC_USE_ADC4

endchoice # "FOC0 device ADC selection"

menuconfig STM32_FOC
	bool "STM32 lower-half FOC support"
	depends on STM32_HAVE_COMMON_FOC || ARCH_CHIP_STM32F7
	depends on MOTOR_FOC
	select ARCH_IRQPRIO
	select STM32_ADC
	select STM32_PWM_MULTICHAN
	select STM32_PWM_LL_OPS
	select STM32_ADC_LL_OPS
	select STM32_ADC_CHANGE_SAMPLETIME
	select STM32_ADC_NO_STARTUP_CONV

config STM32_FOC_FOC0
	bool "FOC0 device (TIM1 for PWM modulation)"
	depends on STM32_FOC && STM32_HAVE_TIM1
	select STM32_FOC_USE_TIM1
	---help---
		Enable support for FOC0 device that uses TIM1 for PWM modulation

config STM32_FOC_FOC1
	bool "FOC1 device (TIM8 for PWM modulation)"
	depends on STM32_FOC && STM32_HAVE_TIM8
	select STM32_FOC_USE_TIM8
	---help---
		Enable support for FOC1 device that uses TIM8 for PWM modulation

config STM32_FOC_HAS_PWM_COMPLEMENTARY
	bool "FOC PWM has complementary outputs"
	depends on STM32_FOC
	---help---
		Enable complementary outputs for the FOC PWM (sometimes called 6-PWM mode)

# hidden variables and automatic configuration

if STM32_FOC

config STM32_FOC_USE_ADC4
	bool
	default n
	select STM32_ADC4
	select STM32_ADC3_JEXTSEL

config STM32_FOC_G4_ADCCHAN0_WORKAROUND
	bool "FOC G4 ADC channel 0 unwanted conversion workaround"
	default n
	depends on STM32_FOC_HAVE_ADC_CHAN0_WORKAROUND
	---help---
		Some STM32G4 family chips have an issue that causes unwanted ADC channel 0
		conversion when a regular conversion is interrupted by an injected conversion.
		This FOC implementation uses injected conversion to sample phase currents
		and allows user to use regular conversion as an auxiliary analog conversion.
		In this case, there is a certain probability that regular conversion will be
		interrupted by an injected conversion that will lead to an incorrect reading
		of phase currents.

		This workaround inserts a dummy conversion at the beginning of the injected
		sequence. For more details look at the chip errata documents.

endif #STM32_FOC
```

## arch/arm/src/common/stm32/Kconfig.gpio
```kconfig
#
# STM32 GPIO configuration options.
#

config STM32_GPIO_HAVE_PORTD
	bool

config STM32_GPIO_HAVE_PORTE
	bool
```
