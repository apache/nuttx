## arch/arm/src/common/stm32/Kconfig.i2c
```kconfig
#
# STM32 I2C configuration options.
#

# TODO: generalize H5 specific options !

config STM32_I2C_SLAVE
	bool
	default n

menu "I2C Configuration H5-specific"
	depends on STM32_HAVE_I2C_H5

menu "Clock Selection"

choice
	depends on STM32_I2C1
	prompt "I2C1 Input Clock Selection"
	default STM32_I2C1_CLK_PCLK1

config STM32_I2C1_CLK_CSI
	bool "CSI"

config STM32_I2C1_CLK_HSI
	bool "HSI"

config STM32_I2C1_CLK_PCLK1
	bool "PCLK1"

config STM32_I2C1_CLK_PLL3R
	bool "PLL3R"

endchoice # I2C1 Input Clock Selection

choice
	depends on STM32_I2C2
	prompt "I2C2 Input Clock Selection"
	default STM32_I2C2_CLK_PCLK1

config STM32_I2C2_CLK_CSI
	bool "CSI"

config STM32_I2C2_CLK_HSI
	bool "HSI"

config STM32_I2C2_CLK_PCLK1
	bool "PCLK1"

config STM32_I2C2_CLK_PLL3R
	bool "PLL3R"

endchoice # I2C2 Input Clock Selection

choice
	depends on STM32_I2C3
	prompt "I2C3 Input Clock Selection"
	default STM32_I2C3_CLK_PCLK3

config STM32_I2C3_CLK_CSI
	bool "CSI"

config STM32_I2C3_CLK_HSI
	bool "HSI"

config STM32_I2C3_CLK_PCLK3
	bool "PCLK3"

config STM32_I2C3_CLK_PLL3R
	bool "PLL3R"

endchoice # I2C3 Input Clock Selection

choice
	depends on STM32_I2C4
	prompt "I2C4 Input Clock Selection"
	default STM32_I2C4_CLK_PCLK3

config STM32_I2C4_CLK_CSI
	bool "CSI"

config STM32_I2C4_CLK_HSI
	bool "HSI"

config STM32_I2C4_CLK_PCLK3
	bool "PCLK3"

config STM32_I2C4_CLK_PLL3R
	bool "PLL3R"

endchoice # I2C4 Input Clock Selection

endmenu # Clock Selection

menu "Rise/Fall Override"

config STM32_I2C1_RF_OVERRIDE
	bool "I2C1"
	default n
	depends on STM32_I2C1

config STM32_I2C2_RF_OVERRIDE
	bool "I2C2"
	default n
	depends on STM32_I2C2

config STM32_I2C3_RF_OVERRIDE
	bool "I2C3"
	default n
	depends on STM32_I2C3

config STM32_I2C4_RF_OVERRIDE
	bool "I2C4"
	default n
	depends on STM32_I2C4

menu "Rise/Fall Values"

config STM32_I2C1_RISE
	int "I2C1 Rise Time (ns)"
	range 0 1000
	default 20
	depends on STM32_I2C1_RF_OVERRIDE

config STM32_I2C1_FALL
	int "I2C1 Fall Time (ns)"
	range 0 300
	default 20
	depends on STM32_I2C1_RF_OVERRIDE

config STM32_I2C2_RISE
	int "I2C2 Rise Time (ns)"
	range 0 1000
	default 20
	depends on STM32_I2C2_RF_OVERRIDE

config STM32_I2C2_FALL
	int "I2C2 Fall Time (ns)"
	range 0 300
	default 20
	depends on STM32_I2C2_RF_OVERRIDE

config STM32_I2C3_RISE
	int "I2C3 Rise Time (ns)"
	range 0 1000
	default 20
	depends on STM32_I2C3_RF_OVERRIDE

config STM32_I2C3_FALL
	int "I2C3 Fall Time (ns)"
	range 0 300
	default 20
	depends on STM32_I2C3_RF_OVERRIDE

config STM32_I2C4_RISE
	int "I2C4 Rise Time (ns)"
	range 0 1000
	default 20
	depends on STM32_I2C4_RF_OVERRIDE

config STM32_I2C4_FALL
	int "I2C4 Fall Time (ns)"
	range 0 300
	default 20
	depends on STM32_I2C4_RF_OVERRIDE

endmenu # Rise/Fall Values

endmenu # Rise/Fall Override

menu "Filtering"

menu "Digital Filters"

config STM32_I2C1_DNF
	int "I2C1 Digital Noise Filter"
	range 0 15
	default 0
	depends on STM32_I2C1

config STM32_I2C2_DNF
	int "I2C2 Digital Noise Filter"
	range 0 15
	default 0
	depends on STM32_I2C2

config STM32_I2C3_DNF
	int "I2C3 Digital Noise Filter"
	range 0 15
	default 0
	depends on STM32_I2C3

config STM32_I2C4_DNF
	int "I2C4 Digital Noise Filter"
	range 0 15
	default 0
	depends on STM32_I2C4

endmenu # Digital Filters

menu "Analog Filters"

config STM32_I2C1_ANFOFF
	int "Turn off I2C1 Analog Filter (0=on, 1=off)"
	default 1
	range 0 1
	depends on STM32_I2C1

config STM32_I2C2_ANFOFF
	int "Turn off I2C2 Analog Filter (0=on, 1=off)"
	default 1
	range 0 1
	depends on STM32_I2C2

config STM32_I2C3_ANFOFF
	int "Turn off I2C3 Analog Filter (0=on, 1=off)"
	default 1
	range 0 1
	depends on STM32_I2C3

config STM32_I2C4_ANFOFF
	int "Turn off I2C4 Analog Filter (0=on, 1=off)"
	default 1
	range 0 1
	depends on STM32_I2C4

endmenu # Analog Filters

endmenu # Filtering

endmenu # "I2C Configuration"

if !STM32_HAVE_I2C_H5

config STM32_I2C_DYNTIMEO
	bool "Use dynamic timeouts"
	depends on STM32_I2C

config STM32_I2C_DYNTIMEO_USECPERBYTE
	int "Timeout Microseconds per Byte"
	depends on STM32_I2C && STM32_I2C_DYNTIMEO
	default 500

config STM32_I2C_DYNTIMEO_STARTSTOP
	int "Timeout for Start/Stop (Milliseconds)"
	depends on STM32_I2C && STM32_I2C_DYNTIMEO
	default 1000

config STM32_I2CTIMEOSEC
	int "Timeout seconds"
	depends on STM32_I2C
	default 0

config STM32_I2CTIMEOMS
	int "Timeout Milliseconds"
	depends on STM32_I2C && !STM32_I2C_DYNTIMEO
	default 500

config STM32_I2CTIMEOTICKS
	int "Timeout for Done and Stop (ticks)"
	depends on STM32_I2C && !STM32_I2C_DYNTIMEO
	default 500

config STM32_I2C_ALT
	bool "Alternate I2C implementation"
	default STM32F1_PERFORMANCELINE
	depends on !STM32_STM32F30XX && STM32_COMMON_LEGACY
	---help---
		This selection enables an alternative I2C driver.  This alternate
		driver implements some rather complex workarounds for errata against
		the STM32 F103 "Performance Line".  This selection is an option
		because: (1) It has not yet been fully verified and (2) It is not
		certain that he scope of this workaround is needed only for the F103.

config STM32_I2C_DUTY16_9
	bool "Frequency with Tlow/Thigh = 16/9"
	default n
	depends on STM32_I2C && STM32_COMMON_LEGACY

config STM32_I2C_DMA
	bool "I2C DMA Support"
	default n
	depends on STM32_I2C && STM32_STM32F4XXX && STM32_DMA1 && !I2C_POLLED
	---help---
		This option enables the DMA for I2C transfers.
		Note: The user can define CONFIG_I2C_DMAPRIO: a custom priority value for the
		I2C dma streams, else the default priority level is set to medium.

menu "I2C Slave Configuration"
	depends on STM32_I2C_SLAVE

config STM32_I2C_SLAVE_DEFAULT_TX
	hex "Default TX byte to be sent when the TX buffer is empty"
	default 0xFF

config STM32_I2C_SLAVE_USEWQ
	bool "Use work queue to delegate the isr completion status"
	default n
	---help---
		With the current upperhalf I2C slave driver implementation, the user
		should delegate the callback completion status using a work queue.
		However, work queues introduce a delay, so in certain scenarios
		it is better to use a custom driver without using a work queue.

config STM32_I2C_SLAVE_RETRANSFER
	bool "The frame is retransferred when stop is issued beforehand"
	default n
	---help---
		If stop is issued before the whole frame is transferred,
		the tx pointer is reset to 0.

endmenu

endif # !STM32_HAVE_I2C_H5
```

## arch/arm/src/common/stm32/Kconfig.ipcc
```kconfig
#
# STM32 common IPCC options.
#

config STM32_IPCC_CHAN1_RX_SIZE
	int "Channel 1 RX size"
	default 256
	depends on STM32_IPCC
	---help---
		Size of the receive buffer. Another CPU will write to this buffer and
		the currently running CPU will read from it.

config STM32_IPCC_CHAN1_TX_SIZE
	int "Channel 1 TX size"
	default 256
	depends on STM32_IPCC
	---help---
		Size of the send buffer. Another CPU will read from this buffer and
		the currently running CPU will write to it.

config STM32_IPCC_CHAN2
	bool "Enable channel 2"
	depends on STM32_IPCC

if STM32_IPCC_CHAN2

config STM32_IPCC_CHAN2_RX_SIZE
	int "Channel 2 RX size"
	default 256

config STM32_IPCC_CHAN2_TX_SIZE
	int "Channel 2 TX size"
	default 256

config STM32_IPCC_CHAN3
	bool "Enable channel 3"

if STM32_IPCC_CHAN3

config STM32_IPCC_CHAN3_RX_SIZE
	int "Channel 3 RX size"
	default 256

config STM32_IPCC_CHAN3_TX_SIZE
	int "Channel 3 TX size"
	default 256

config STM32_IPCC_CHAN4
	bool "Enable channel 4"

if STM32_IPCC_CHAN4

config STM32_IPCC_CHAN4_RX_SIZE
	int "Channel 4 RX size"
	default 256

config STM32_IPCC_CHAN4_TX_SIZE
	int "Channel 4 TX size"
	default 256

config STM32_IPCC_CHAN5
	bool "Enable channel 5"

if STM32_IPCC_CHAN5

config STM32_IPCC_CHAN5_RX_SIZE
	int "Channel 5 RX size"
	default 256

config STM32_IPCC_CHAN5_TX_SIZE
	int "Channel 5 TX size"
	default 256

config STM32_IPCC_CHAN6
	bool "Enable channel 6"

if STM32_IPCC_CHAN6

config STM32_IPCC_CHAN6_RX_SIZE
	int "Channel 6 RX size"
	default 256

config STM32_IPCC_CHAN6_TX_SIZE
	int "Channel 6 TX size"
	default 256

endif # STM32_IPCC_CHAN2
endif # STM32_IPCC_CHAN3
endif # STM32_IPCC_CHAN4
endif # STM32_IPCC_CHAN5
endif # STM32_IPCC_CHAN6
```

## arch/arm/src/common/stm32/Kconfig.lpuart
```kconfig
#
# STM32 common LPUART options.
#

config LPUART1_RXDMA
	bool
	depends on STM32_LPUART1 && LPUART1_SERIALDRIVER && STM32_DMA
	---help---
	In high data rate usage, Rx DMA may eliminate Rx overrun errors

choice
	prompt "LPUART1 Driver Configuration"
	depends on STM32_LPUART1
	default STM32_LPUART1_SERIALDRIVER

config STM32_LPUART1_SERIALDRIVER
	bool "Standard serial driver"
	select LPUART1_SERIALDRIVER
	select ARCH_HAVE_SERIAL_TERMIOS
	select STM32_SERIALDRIVER

config STM32_LPUART1_1WIREDRIVER
	bool "1-Wire driver"
	select STM32_1WIREDRIVER

endchoice # LPUART1 Driver Configuration

config LPUART1_RS485
	bool "RS-485 on LPUART1"
	depends on STM32_LPUART1 && LPUART1_SERIALDRIVER
	---help---
		Enable RS-485 interface on LPUART1. Your board config will have to
		provide GPIO_LPUART1_RS485_DIR pin definition. Currently it cannot be
		used with LPUART1_RXDMA.

if LPUART1_RS485

config LPUART1_RS485_DIR_POLARITY
	int "LPUART1 RS-485 DIR pin polarity"
	default 1
	range 0 1
	---help---
		Polarity of DIR pin for RS-485 on LPUART1. Set to state on DIR pin which
		enables TX (0 - low / nTXEN, 1 - high / TXEN).

endif # LPUART1_RS485

if STM32_LPUART1_SERIALDRIVER

config LPUART1_TXDMA
	bool "LPUART1 Tx DMA"
	default n
	depends on STM32_DMA1
	---help---
		In high data rate usage, Tx DMA may reduce CPU load

endif # STM32_LPUART1_SERIALDRIVER

config LPUART1_UNCONFIG_RX_ON_CLOSE
	bool "Unconfigure LPUART1 RX pin on close"
	depends on STM32_HAVE_USART_UNCONFIG_ON_CLOSE && LPUART1_SERIALDRIVER

config LPUART1_UNCONFIG_TX_ON_CLOSE
	bool "Unconfigure LPUART1 TX pin on close"
	depends on STM32_HAVE_USART_UNCONFIG_ON_CLOSE && LPUART1_SERIALDRIVER

config LPUART1_UNCONFIG_DIR_ON_CLOSE
	bool "Unconfigure LPUART1 DIR pin on close"
	depends on STM32_HAVE_USART_UNCONFIG_ON_CLOSE && LPUART1_SERIALDRIVER && LPUART1_RS485
```

## arch/arm/src/common/stm32/Kconfig.ltdc
```kconfig
#
# STM32 common LTDC options.
#

choice
	prompt "Layer 1 color format"
	depends on STM32_LTDC
	default STM32_LTDC_L1_RGB565

config STM32_LTDC_L1_L8
	bool "8 bpp L8 (8-bit CLUT)"
	depends on STM32_FB_CMAP

config STM32_LTDC_L1_AL44
	bool "8 bpp AL44 (4-bit alpha + 4-bit CLUT)"
	depends on STM32_FB_CMAP

config STM32_LTDC_L1_AL88
	bool "16 bpp AL88 (8-bit alpha + 8-bit CLUT)"
	depends on STM32_FB_CMAP

config STM32_LTDC_L1_RGB565
	bool "16 bpp RGB 565"
	depends on !STM32_FB_CMAP

config STM32_LTDC_L1_ARGB4444
	bool "16 bpp ARGB 4444"
	depends on !STM32_FB_CMAP

config STM32_LTDC_L1_ARGB1555
	bool "16 bpp ARGB 1555"
	depends on !STM32_FB_CMAP

config STM32_LTDC_L1_RGB888
	bool "24 bpp RGB 888"
	depends on !STM32_FB_CMAP

config STM32_LTDC_L1_ARGB8888
	bool "32 bpp ARGB 8888"
	depends on !STM32_FB_CMAP

endchoice # Layer 1 color format

choice
	prompt "Layer 2 (top layer) color format"
	depends on STM32_LTDC && STM32_LTDC_L2
	default STM32_LTDC_L2_RGB565

config STM32_LTDC_L2_L8
	bool "8 bpp L8 (8-bit CLUT)"
	depends on STM32_LTDC_L1_L8

config STM32_LTDC_L2_AL44
	bool "8 bpp AL44 (4-bit alpha + 4-bit CLUT)"
	depends on STM32_LTDC_L1_AL44

config STM32_LTDC_L2_AL88
	bool "16 bpp AL88 (8-bit alpha + 8-bit CLUT)"
	depends on STM32_LTDC_L1_AL88

config STM32_LTDC_L2_RGB565
	bool "16 bpp RGB 565"
	depends on STM32_LTDC_L1_RGB565

config STM32_LTDC_L2_ARGB4444
	bool "16 bpp ARGB 4444"
	depends on STM32_LTDC_L1_ARGB4444

config STM32_LTDC_L2_ARGB1555
	bool "16 bpp ARGB 1555"
	depends on STM32_LTDC_L1_ARGB1555

config STM32_LTDC_L2_RGB888
	bool "24 bpp RGB 888"
	depends on STM32_LTDC_L1_RGB888

config STM32_LTDC_L2_ARGB8888
	bool "32 bpp ARGB 8888"
	depends on STM32_LTDC_L1_ARGB8888

endchoice # Layer 2 color format

if STM32_LTDC

config STM32_LTDC_BACKLIGHT
	bool "Backlight support"
	default y

config STM32_LTDC_DEFBACKLIGHT
	hex "Default backlight level"
	default 0xf0

config STM32_LTDC_BACKCOLOR
	hex "Background color"
	default 0x0
	---help---
		This is the background color that will be used as the LTDC
		background layer color.  It is an RGB888 format value.

config STM32_LTDC_DITHER
	bool "Dither support"

config STM32_LTDC_FB_DOUBLE_BUFFER
	bool "Enable double buffering"
	depends on ARCH_CHIP_STM32H7
	default n
	---help---
		Enable double buffering to allow updates to the framebuffer while
		the display is being refreshed.  This configuration requires two
		framebuffers: one active and one inactive.  When the display
		refreshes, the active and inactive framebuffers are swapped,
		enabling smooth and flicker-free updates.

if STM32_LTDC_DITHER

config STM32_LTDC_DITHER_RED
	int "Dither red width"
	range 0 7
	default 2
	---help---
		This is the dither red width.

config STM32_LTDC_DITHER_GREEN
	int "Dither green width"
	range 0 7
	default 2
	---help---
		This is the dither green width.

config STM32_LTDC_DITHER_BLUE
	int "Dither blue width"
	range 0 7
	default 2
	---help---
		This is the dither blue width.

endif # STM32_LTDC_DITHER

config STM32_LTDC_FB_BASE
	hex "Framebuffer memory start address"
	default 0
	---help---
		If you are using the LTDC, then you must provide the address
		of the start of the framebuffer.  This address will typically
		be in the SRAM or SDRAM memory region of the FSMC/FMC.

config STM32_LTDC_FB_SIZE
	int "Framebuffer memory size (bytes)"
	default 0
	---help---
		Must be the whole size of the active LTDC layer.

config STM32_LTDC_L1_CHROMAKEYEN
	bool "Enable chromakey support for layer 1"
	default y

config STM32_LTDC_L1_CHROMAKEY
	hex "Layer L1 initial chroma key"
	default 0x00000000

config STM32_LTDC_L1_COLOR
	hex "Layer L1 default color"
	default 0x00000000

config STM32_LTDC_L2
	bool "Enable Layer 2 support"
	default y

if STM32_LTDC_L2

config STM32_LTDC_L2_COLOR
	hex "Layer L2 default color"
	default 0x00000000

config STM32_LTDC_L2_CHROMAKEYEN
	bool "Enable chromakey support for layer 2"
	default y

config STM32_LTDC_L2_CHROMAKEY
	hex "Layer L2 initial chroma key"
	default 0x00000000

endif # STM32_LTDC_L2

config STM32_FB_CMAP
	bool "Color map support"
	default y
	select FB_CMAP
	---help---
		Enabling color map support is necessary for LTDC L8 format.

config STM32_FB_TRANSPARENCY
	bool "Transparency color map support"
	depends on STM32_FB_CMAP
	default y
	select FB_TRANSPARENCY
	---help---
		Enabling transparency color map support is necessary for LTDC L8 format.

config STM32_LTDC_REGDEBUG
	bool "LTDC Register level debug"
	depends on (STM32_COMMON_LEGACY && DEBUG_INFO && DEBUG_LCD) || STM32_COMMON_F7_H7
	---help---
		Output detailed register-level LTDC device debug information.

endif # STM32_LTDC

config STM32_LTDC_USE_DSI
	bool "Use DSI as display connection"
	depends on STM32_COMMON_F7_H7 && STM32_LTDC && STM32_DSIHOST
	---help---
		Select this if your display is connected via DSI.
		Deselect option if your display is connected via digital
		RGB+HSYNC+VSYNC

if STM32_LCD

choice
	prompt "Segment LCD Clock Source"
	default LCD_LSECLOCK

config LCD_LSICLOCK
	bool "Internal Low Speed Clock"

config LCD_LSECLOCK
	bool "External Low Speed Clock"

config LCD_HSECLOCK
	bool "External High Speed Clock"

endchoice

endif # STM32_LCD
```
