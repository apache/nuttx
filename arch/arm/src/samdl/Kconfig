## arch/arm/src/stm32l5/Kconfig
```kconfig
#
# For a description of the syntax of this configuration file,
# see the file kconfig-language.txt in the NuttX tools repository.
#

if ARCH_CHIP_STM32L5

comment "STM32L5 Configuration Options"

config STM32_L5_PERIPHERALS
	bool
	default y
	select STM32_HAVE_RTC_SUBSECONDS
	select STM32_HAVE_RTC_MAGIC
	select STM32_HAVE_RTC
	select STM32_HAVE_PWR
	select STM32_HAVE_SPI1
	select STM32_HAVE_SPI2
	select STM32_HAVE_SPI3
	select STM32_HAVE_SYSCFG

choice
	prompt "STM32 L5 Chip Selection"
	default ARCH_CHIP_STM32L552ZE
	depends on ARCH_CHIP_STM32L5

config ARCH_CHIP_STM32L552ZE
	bool "STM32L552ZE"
	select STM32_STM32L562XX
	select STM32_FLASH_CONFIG_E
	select STM32L5_IO_CONFIG_Z
	---help---
		STM32 L5 Cortex M33, 512 Kb FLASH, 256 Kb SRAM

config ARCH_CHIP_STM32L562QE
	bool "STM32L562QE"
	select STM32_STM32L562XX
	select STM32_FLASH_CONFIG_E
	select STM32L5_IO_CONFIG_Q
	---help---
		STM32 L5 Cortex M33, 512 Kb FLASH, 256 Kb SRAM

endchoice # STM32 L5 Chip Selection

# Chip families:

# STM32L552 and STM32L562 devices documented in RM0439
config STM32_STM32L562XX
	bool
	default n
	select ARCH_HAVE_FPU
	select STM32_HAVE_LPUART1
	select STM32_HAVE_USART1
	select STM32_HAVE_USART2
	select STM32_HAVE_USART3
	select STM32_HAVE_UART4
	select STM32_HAVE_UART5

# Pin/package configurations

config STM32L5_IO_CONFIG_K
	# Package designator K
	bool
	default n

config STM32L5_IO_CONFIG_T
	# Package designator T
	bool
	default n

config STM32L5_IO_CONFIG_C
	# Package designator C
	bool
	default n

config STM32L5_IO_CONFIG_R
	# Package designator R
	bool
	default n

config STM32L5_IO_CONFIG_J
	# Package designator J
	bool
	default n

config STM32L5_IO_CONFIG_M
	# Package designator M
	bool
	default n

config STM32L5_IO_CONFIG_V
	# Package designator V
	bool
	default n

config STM32L5_IO_CONFIG_Q
	# Package designator Q
	bool
	default n

config STM32L5_IO_CONFIG_Z
	# Package designator Z
	bool
	default n

config STM32L5_IO_CONFIG_A
	# Package designator A
	bool
	default n

endif # ARCH_CHIP_STM32L5
```

## arch/arm/src/stm32u5/Kconfig
```kconfig
#
# For a description of the syntax of this configuration file,
# see the file kconfig-language.txt in the NuttX tools repository.
#

if ARCH_CHIP_STM32U5

comment "STM32U5 Configuration Options"

config STM32_U5_PERIPHERALS
	bool
	default y
	select STM32_HAVE_COMP
	select STM32_HAVE_CRS
	select STM32_HAVE_DAC1
	select STM32_HAVE_DMA2D
	select STM32_HAVE_FMAC
	select STM32_HAVE_FSMC
	select STM32_HAVE_HASH
	select STM32_HAVE_I2C1
	select STM32_HAVE_I2C2
	select STM32_HAVE_I2C3
	select STM32_HAVE_I2C4
	select STM32_HAVE_LPTIM1
	select STM32_HAVE_LPTIM3
	select STM32_HAVE_LPTIM4
	select STM32_HAVE_LPUART1
	select STM32_HAVE_OTGFS if STM32_STM32U535XX || CONFIG_STM32_STM32U545XX || STM32_STM32U575XX || STM32_STM32U585XX
	select STM32_HAVE_RNG
	select STM32_HAVE_SAI1
	select STM32_HAVE_SAI2
	select STM32_HAVE_SDMMC1
	select STM32_HAVE_SDMMC2
	select STM32_HAVE_SPI1
	select STM32_HAVE_SPI2
	select STM32_HAVE_SPI3
	select STM32_HAVE_SYSCFG
	select STM32_HAVE_TSC
	select STM32_HAVE_UART4
	select STM32_HAVE_UART5
	select STM32_HAVE_USART1
	select STM32_HAVE_USART2
	select STM32_HAVE_USART3
	select STM32_HAVE_GPADMA1
	select STM32_HAVE_MDF1
	select STM32_HAVE_FLASH
	select STM32_HAVE_RAMCFG
	select STM32_HAVE_GTZC1
	select STM32_HAVE_GTZC2
	select STM32_HAVE_DCACHE1
	select STM32_HAVE_SRAM1
	select STM32_HAVE_SRAM2
	select STM32_HAVE_SRAM3
	select STM32_HAVE_SRAM5
	select STM32_HAVE_DCMI_PSSI
	select STM32_HAVE_PKA
	select STM32_HAVE_SAES
	select STM32_HAVE_OCTOSPIM
	select STM32_HAVE_OTFDEC1
	select STM32_HAVE_OTFDEC2
	select STM32_HAVE_OCTOSPI1
	select STM32_HAVE_OCTOSPI2
	select STM32_HAVE_LPGPIO1
	select STM32_HAVE_LPDMA1
	select STM32_HAVE_ADF1
	select STM32_HAVE_UCPD1
	select STM32_HAVE_VREF
	select STM32_HAVE_RTCAPB
	select STM32_HAVE_RTC_MAGIC
	select STM32_HAVE_CRC
	select STM32_HAVE_PWR
	select STM32_HAVE_BKPSRAM
	select STM32_HAVE_IP_WDG_M3M4_V1

choice
	prompt "STM32 U5 Chip Selection"
	default ARCH_CHIP_STM32U585AI
	depends on ARCH_CHIP_STM32U5

config ARCH_CHIP_STM32U585AI
	bool "STM32U585AI"
	select STM32_STM32U585XX
	select STM32_FLASH_CONFIG_I
	select STM32U5_IO_CONFIG_A
	---help---
		STM32 U5 Cortex M33, 2048 Kb FLASH, 768 Kb SRAM

config ARCH_CHIP_STM32U5A5ZJT
	bool "STM32U5A5ZJT"
	select STM32_STM32U5A5XX
	select STM32U5_IO_CONFIG_A
	---help---
	STM32 U5 Cortex M33, 4096 Kb FLASH, 2500 Kb SRAM, tqfp144

endchoice # STM32 U5 Chip Selection

# Chip families:

# STM32U575 and STM32U585 devices documented in RM0456
config STM32_STM32U5A5XX
	bool
	default n
	select STM32_HAVE_OTGHS
	select ARCH_HAVE_FPU
	select STM32_HAVE_AES
	select STM32_HAVE_CORDIC
	select STM32_HAVE_IP_AES_M3M4_V1
	select STM32_HAVE_IP_CORDIC_M3M4_V1
	select STM32_HAVE_LPUART1
	select STM32_HAVE_USART1
	select STM32_HAVE_USART2
	select STM32_HAVE_USART3
	select STM32_HAVE_UART4
	select STM32_HAVE_UART5
	select STM32_HAVE_FDCAN1
	select STM32_HAVE_TIM1
	select STM32_HAVE_TIM2
	select STM32_HAVE_TIM3
	select STM32_HAVE_TIM4
	select STM32_HAVE_TIM5
	select STM32_HAVE_TIM6
	select STM32_HAVE_TIM7
	select STM32_HAVE_TIM8
	select STM32_HAVE_TIM15
	select STM32_HAVE_TIM16
	select STM32_HAVE_TIM17
	select STM32_HAVE_I2C5
	select STM32_HAVE_I2C6

# STM32U575 and STM32U585 devices documented in RM0456
config STM32_STM32U585XX
	bool
	default n
	select ARCH_HAVE_FPU
	select STM32_HAVE_AES
	select STM32_HAVE_CORDIC
	select STM32_HAVE_IP_AES_M3M4_V1
	select STM32_HAVE_IP_CORDIC_M3M4_V1
	select STM32_HAVE_LPUART1
	select STM32_HAVE_USART1
	select STM32_HAVE_USART2
	select STM32_HAVE_USART3
	select STM32_HAVE_UART4
	select STM32_HAVE_UART5
	select STM32_HAVE_FDCAN1
	select STM32_HAVE_TIM1
	select STM32_HAVE_TIM2
	select STM32_HAVE_TIM3
	select STM32_HAVE_TIM4
	select STM32_HAVE_TIM5
	select STM32_HAVE_TIM6
	select STM32_HAVE_TIM7
	select STM32_HAVE_TIM8
	select STM32_HAVE_TIM15
	select STM32_HAVE_TIM16
	select STM32_HAVE_TIM17

# Pin/package configurations

config STM32U5_IO_CONFIG_K
	# Package designator K
	bool
	default n

config STM32U5_IO_CONFIG_T
	# Package designator T
	bool
	default n

config STM32U5_IO_CONFIG_C
	# Package designator C
	bool
	default n

config STM32U5_IO_CONFIG_R
	# Package designator R
	bool
	default n

config STM32U5_IO_CONFIG_J
	# Package designator J
	bool
	default n

config STM32U5_IO_CONFIG_M
	# Package designator M
	bool
	default n

config STM32U5_IO_CONFIG_V
	# Package designator V
	bool
	default n

config STM32U5_IO_CONFIG_Q
	# Package designator Q
	bool
	default n

config STM32U5_IO_CONFIG_Z
	# Package designator Z
	bool
	default n

config STM32U5_IO_CONFIG_A
	# Package designator A
	bool
	default n

endif # ARCH_CHIP_STM32U5
```

## arch/arm/src/stm32wb/Kconfig
```kconfig
#
# For a description of the syntax of this configuration file,
# see the file kconfig-language.txt in the NuttX tools repository.
#

if ARCH_CHIP_STM32WB

comment "STM32WB Configuration Options"

config STM32_WB_PERIPHERALS
	bool
	default ARCH_CHIP_STM32WB
	select STM32_HAVE_BLE
	select STM32_HAVE_DMA1
	select STM32_HAVE_MBOX
	select STM32_HAVE_IPCC
	select STM32_HAVE_SRAM2A
	select STM32_HAVE_SRAM2B
	select STM32_HAVE_I2C1
	select STM32_HAVE_LPTIM1
	select STM32_HAVE_LPUART1 if STM32_HAVE_LPUART
	select STM32_HAVE_RTC_SUBSECONDS
	select STM32_HAVE_RTC_MAGIC
	select STM32_HAVE_RTC
	select STM32_HAVE_CRC
	select STM32_HAVE_PWR
	select STM32_HAVE_SPI1
	select STM32_HAVE_SYSCFG
	select STM32_HAVE_USART1

choice
	prompt "STM32 WB Chip Selection"
	default ARCH_CHIP_STM32WB55RG
	depends on ARCH_CHIP_STM32WB

config ARCH_CHIP_STM32WB10CC
	bool "STM32WB10CC"
	select STM32_STM32WB10
	select STM32WB_IO_CONFIG_C
	select STM32_FLASH_CONFIG_C_320
	---help---
		STM32 WB Cortex M4, 320 Kb FLASH, 12+32+4 Kb SRAM

config ARCH_CHIP_STM32WB15CC
	bool "STM32WB15CC"
	select STM32_STM32WB15
	select STM32WB_IO_CONFIG_C
	select STM32_FLASH_CONFIG_C_320
	---help---
		STM32 WB Cortex M4, 320 Kb FLASH, 12+32+4 Kb SRAM

config ARCH_CHIP_STM32WB30CE
	bool "STM32WB30CE"
	select STM32_STM32WB30
	select STM32WB_IO_CONFIG_C
	select STM32_FLASH_CONFIG_E
	---help---
		STM32 WB Cortex M4, 512 Kb FLASH, 32+32+32 Kb SRAM

config ARCH_CHIP_STM32WB50CG
	bool "STM32WB50CG"
	select STM32_STM32WB50
	select STM32WB_IO_CONFIG_C
	select STM32_FLASH_CONFIG_G
	---help---
		STM32 WB Cortex M4, 1024 Kb FLASH, 64+32+32 Kb SRAM

config ARCH_CHIP_STM32WB35CC
	bool "STM32WB35CC"
	select STM32_STM32WB35
	select STM32WB_IO_CONFIG_C
	select STM32_FLASH_CONFIG_C
	---help---
		STM32 WB Cortex M4, 256 Kb FLASH, 32+32+32 Kb SRAM

config ARCH_CHIP_STM32WB35CE
	bool "STM32WB35CE"
	select STM32_STM32WB35
	select STM32WB_IO_CONFIG_C
	select STM32_FLASH_CONFIG_E
	---help---
		STM32 WB Cortex M4, 512 Kb FLASH, 32+32+32 Kb SRAM

config ARCH_CHIP_STM32WB55CC
	bool "STM32WB55CC"
	select STM32_STM32WB55
	select STM32WB_IO_CONFIG_C
	select STM32_FLASH_CONFIG_C
	---help---
		STM32 WB Cortex M4, 256 Kb FLASH, 64+32+32 Kb SRAM

config ARCH_CHIP_STM32WB55RC
	bool "STM32WB55RC"
	select STM32_STM32WB55
	select STM32WB_IO_CONFIG_R
	select STM32_FLASH_CONFIG_C
	---help---
		STM32 WB Cortex M4, 256 Kb FLASH, 64+32+32 Kb SRAM

config ARCH_CHIP_STM32WB55VC
	bool "STM32WB55VC"
	select STM32_STM32WB55
	select STM32WB_IO_CONFIG_V
	select STM32_FLASH_CONFIG_C
	---help---
		STM32 WB Cortex M4, 256 Kb FLASH, 64+32+32 Kb SRAM

config ARCH_CHIP_STM32WB55CE
	bool "STM32WB55CE"
	select STM32_STM32WB55
	select STM32WB_IO_CONFIG_C
	select STM32_FLASH_CONFIG_E
	---help---
		STM32 WB Cortex M4, 512 Kb FLASH, 192+32+32 Kb SRAM

config ARCH_CHIP_STM32WB55RE
	bool "STM32WB55RE"
	select STM32_STM32WB55
	select STM32WB_IO_CONFIG_R
	select STM32_FLASH_CONFIG_E
	---help---
		STM32 WB Cortex M4, 512 Kb FLASH, 192+32+32 Kb SRAM

config ARCH_CHIP_STM32WB55VE
	bool "STM32WB55VE"
	select STM32_STM32WB55
	select STM32WB_IO_CONFIG_V
	select STM32_FLASH_CONFIG_E
	---help---
		STM32 WB Cortex M4, 512 Kb FLASH, 192+32+32 Kb SRAM

config ARCH_CHIP_STM32WB55VY
	bool "STM32WB55VY"
	select STM32_STM32WB55
	select STM32WB_IO_CONFIG_V
	select STM32_FLASH_CONFIG_Y
	---help---
		STM32 WB Cortex M4, 640 Kb FLASH, 192+32+32 Kb SRAM

config ARCH_CHIP_STM32WB55CG
	bool "STM32WB55CG"
	select STM32_STM32WB55
	select STM32WB_IO_CONFIG_C
	select STM32_FLASH_CONFIG_G
	---help---
		STM32 WB Cortex M4, 1024 Kb FLASH, 192+32+32 Kb SRAM

config ARCH_CHIP_STM32WB55RG
	bool "STM32WB55RG"
	select STM32_STM32WB55
	select STM32WB_IO_CONFIG_R
	select STM32_FLASH_CONFIG_G
	---help---
		STM32 WB Cortex M4, 1024 Kb FLASH, 192+32+32 Kb SRAM

config ARCH_CHIP_STM32WB55VG
	bool "STM32WB55VG"
	select STM32_STM32WB55
	select STM32WB_IO_CONFIG_V
	select STM32_FLASH_CONFIG_G
	---help---
		STM32 WB Cortex M4, 1024 Kb FLASH, 192+32+32 Kb SRAM

endchoice # STM32 WB Chip Selection

# Chip product lines

config STM32_STM32WB10
	# STM32WB10 Value Line
	bool
	default n
	select STM32_HAVE_TIM1
	select STM32_HAVE_TIM2
	select STM32_HAVE_TSC

config STM32_STM32WB15
	# STM32WB15 Standard Line
	bool
	default n
	select STM32_HAVE_TIM1
	select STM32_HAVE_TIM2
	select STM32_HAVE_TSC
	select STM32_HAVE_LPUART
	select STM32_HAVE_SMPS if !ARCH_CHIP_STM32WB15CCUXE

config STM32_STM32WB30
	# STM32WB30 Value Line
	bool
	default n
	select STM32_HAVE_HSI48
	select STM32_HAVE_TIM1
	select STM32_HAVE_TIM2
	select STM32_HAVE_TIM16
	select STM32_HAVE_TIM17

config STM32_STM32WB50
	# STM32WB50 Value Line
	bool
	default n
	select STM32_HAVE_HSI48
	select STM32_HAVE_TIM1
	select STM32_HAVE_TIM2
	select STM32_HAVE_TIM16
	select STM32_HAVE_TIM17

config STM32_STM32WB35
	# STM32WB35 Standard Line
	bool
	default n
	select STM32_HAVE_HSI48
	select STM32_HAVE_DMA2
	select STM32_HAVE_TIM1
	select STM32_HAVE_TIM2
	select STM32_HAVE_TIM16
	select STM32_HAVE_TIM17
	select STM32_HAVE_I2C3
	select STM32_HAVE_QSPI
	select STM32_HAVE_USB
	select STM32_HAVE_SAI
	select STM32_HAVE_COMP
	select STM32_HAVE_SMPS

config STM32_STM32WB55
	# STM32WB55 Standard Line
	bool
	default n
	select STM32_HAVE_HSI48
	select STM32_HAVE_DMA2
	select STM32_HAVE_TIM1
	select STM32_HAVE_TIM2
	select STM32_HAVE_TIM16
	select STM32_HAVE_TIM17
	select STM32_HAVE_I2C3
	select STM32_HAVE_SPI2 if STM32WB_IO_CONFIG_R || STM32WB_IO_CONFIG_V
	select STM32_HAVE_QSPI
	select STM32_HAVE_USB
	select STM32_HAVE_SAI
	select STM32_HAVE_COMP
	select STM32_HAVE_LPUART
	select STM32_HAVE_TSC if STM32WB_IO_CONFIG_R || STM32WB_IO_CONFIG_V
	select STM32_HAVE_LCD
	select STM32_HAVE_SMPS

# Pin/package configurations

config STM32WB_IO_CONFIG_C
	# UFQFPN48 package
	bool
	default n
	select STM32_GPIO_HAVE_PORTE

config STM32WB_IO_CONFIG_C_48E
	# UFQFPN48E package
	bool
	default n
	select STM32_GPIO_HAVE_PORTE

config STM32WB_IO_CONFIG_C_49
	# WLCSP49 package
	bool
	default n

config STM32WB_IO_CONFIG_R
	# VFQFPN68 package
	bool
	default n
	select STM32_GPIO_HAVE_PORTD
	select STM32_GPIO_HAVE_PORTE

config STM32WB_IO_CONFIG_V
	# WLCSP100 and UFBGA129 packages
	bool
	default n
	select STM32_GPIO_HAVE_PORTD
	select STM32_GPIO_HAVE_PORTE

endif # ARCH_CHIP_STM32WB
```

## arch/arm/src/stm32wl5/Kconfig
```kconfig
#
# For a description of the syntax of this configuration file,
# see the file kconfig-language.txt in the NuttX tools repository.
#

if ARCH_CHIP_STM32WL5

comment "STM32WL5 Configuration Options"

config STM32_WL5_PERIPHERALS
	bool
	default ARCH_CHIP_STM32WL5
	select STM32_HAVE_SYSCFG
	select STM32_HAVE_IPCC

choice
	prompt "STM32 WL5 Chip Selection"
	default ARCH_CHIP_STM32WL55JC_CPU1
	depends on ARCH_CHIP_STM32WL5

config ARCH_CHIP_STM32WL55JC_CPU1
	bool "STM32WL55JC (cpu1)"
	select STM32_STM32WL5XXX_CPU1
	select STM32_STM32WL5XXX
	select STM32_FLASH_CONFIG_C
	---help---
		STM32 WL5 Cortex M4 (cpu1), 256kiB FLASH, 64kiB SRAM

config ARCH_CHIP_STM32WL55JC_CPU2
	bool "STM32WL55JC (cpu2)"
	select STM32_STM32WL5XXX_CPU2
	select STM32_STM32WL5XXX
	select STM32_FLASH_CONFIG_C
	---help---
		STM32 WL5 Cortex M0 (cpu2), 256kiB FLASH, 64kiB SRAM

endchoice # STM32 WL5 Chip Selection

# Chip product lines

config STM32_STM32WL5XXX
	bool

config STM32_STM32WL5XXX_CPU1
	bool
	default y
	select STM32_HAVE_USART1
	select STM32_HAVE_USART2
	select STM32_HAVE_LPUART1
	select STM32_HAVE_SPI1
	select STM32_HAVE_SPI2S2

endif # ARCH_CHIP_STM32WL5
```
