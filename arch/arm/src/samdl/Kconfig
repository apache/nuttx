## arch/arm/src/stm32f2/Kconfig
```kconfig
#
# For a description of the syntax of this configuration file,
# see the file kconfig-language.txt in the NuttX tools repository.
#
comment "STM32 F2 configuration"

if ARCH_CHIP_STM32F2

choice
	prompt "STM32F2 Chip Selection"
	depends on ARCH_CHIP_STM32F2

config ARCH_CHIP_STM32F205RG
	bool "STM32F205RG"
	select STM32_STM32F20XX
	select STM32_STM32F205

config ARCH_CHIP_STM32F207VC
	bool "STM32F207VC"
	select STM32_STM32F20XX
	select STM32_STM32F207

config ARCH_CHIP_STM32F207VE
	bool "STM32F207VE"
	select STM32_STM32F20XX
	select STM32_STM32F207

config ARCH_CHIP_STM32F207VF
	bool "STM32F207VF"
	select STM32_STM32F20XX
	select STM32_STM32F207

config ARCH_CHIP_STM32F207VG
	bool "STM32F207VG"
	select STM32_STM32F20XX
	select STM32_STM32F207

config ARCH_CHIP_STM32F207IC
	bool "STM32F207IC"
	select STM32_STM32F20XX
	select STM32_STM32F207

config ARCH_CHIP_STM32F207IE
	bool "STM32F207IE"
	select STM32_STM32F20XX
	select STM32_STM32F207

config ARCH_CHIP_STM32F207IF
	bool "STM32F207IF"
	select STM32_STM32F20XX
	select STM32_STM32F207

config ARCH_CHIP_STM32F207IG
	bool "STM32F207IG"
	select STM32_STM32F20XX
	select STM32_STM32F207

config ARCH_CHIP_STM32F207ZC
	bool "STM32F207ZC"
	select STM32_STM32F20XX
	select STM32_STM32F207

config ARCH_CHIP_STM32F207ZE
	bool "STM32F207ZE"
	select STM32_STM32F20XX
	select STM32_STM32F207

config ARCH_CHIP_STM32F207ZF
	bool "STM32F207ZF"
	select STM32_STM32F20XX
	select STM32_STM32F207

config ARCH_CHIP_STM32F207ZG
	bool "STM32F207ZG"
	select STM32_STM32F20XX
	select STM32_STM32F207

endchoice

endif

config STM32_STM32F20XX
	bool
	default n
	select STM32_HAVE_DMA1
	select STM32_HAVE_DMA2
	select ARCH_CORTEXM3
	select STM32_HAVE_DCMI
	select STM32_HAVE_USART1
	select STM32_HAVE_USART2
	select STM32_HAVE_FLASH_ICACHE
	select STM32_HAVE_FLASH_DCACHE
	select STM32_HAVE_CRYP
	select STM32_HAVE_HASH
	select STM32_HAVE_I2C1
	select STM32_HAVE_OTGFS
	select STM32_HAVE_OTGHS
	select STM32_HAVE_SPI1
	select STM32_HAVE_USART3
	select STM32_HAVE_UART4
	select STM32_HAVE_UART5
	select STM32_HAVE_USART6
	select STM32_HAVE_SYSCFG
	select STM32_HAVE_TIM1
	select STM32_HAVE_TIM2
	select STM32_HAVE_TIM3
	select STM32_HAVE_TIM4
	select STM32_HAVE_TIM5
	select STM32_HAVE_TIM6
	select STM32_HAVE_TIM7
	select STM32_HAVE_TIM8
	select STM32_HAVE_TIM9
	select STM32_HAVE_TIM10
	select STM32_HAVE_TIM11
	select STM32_HAVE_TIM12
	select STM32_HAVE_TIM13
	select STM32_HAVE_TIM14
	select STM32_HAVE_ADC2
	select STM32_HAVE_ADC3
	select STM32_HAVE_DAC1
	select STM32_HAVE_I2C2
	select STM32_HAVE_I2C3
	select STM32_HAVE_CAN1
	select STM32_HAVE_CAN2
	select STM32_HAVE_RNG
	select STM32_HAVE_SPI2
	select STM32_HAVE_SPI3
	select STM32_HAVE_IOCOMPENSATION
	select STM32_HAVE_IP_AES_M3M4_V1 if STM32_HAVE_AES
	select STM32_HAVE_IP_BBSRAM_M3M4_V1
	select STM32_HAVE_IP_BKP_M3M4_V1
	select STM32_HAVE_IP_CAN_BXCAN_M3M4_V1
	select STM32_HAVE_IP_CCM_M3M4_V1 if STM32_HAVE_CCM
	select STM32_HAVE_IP_CRYPTO_M3M4_V1
	select STM32_HAVE_IP_DBGMCU_M3M4_V2
	select STM32_HAVE_IP_ADC_M3M4_V1
	select STM32_HAVE_COMMON_FOC
	select STM32_HAVE_IP_DCMI_V1
	select STM32_HAVE_IP_DAC_M3M4_V1
	select STM32_HAVE_IP_DFUMODE_M3M4_V1
	select STM32_HAVE_IP_DMA_V2
	select STM32_HAVE_IP_DMA_V2_STREAM
	select STM32_HAVE_ETHERNET if STM32_HAVE_ETHMAC
	select STM32_HAVE_IP_EXTI_V1
	select STM32_HAVE_IP_ETHMAC_M3M4_V1 if STM32_HAVE_ETHMAC
	select STM32_HAVE_IP_FLASH_M3M4_V1
	select STM32_HAVE_IP_FLASH_M3M4_F2F4
	select STM32_HAVE_IP_FMC_M3M4_V1 if STM32_HAVE_FMC
	select STM32_HAVE_IP_FREERUN_M3M4_V1
	select STM32_HAVE_IP_FSMC_M3M4_V1 if STM32_HAVE_FSMC
	select STM32_HAVE_IP_GPIO_M3M4_V1
	select STM32_HAVE_IP_I2C_M3M4_V1
	select STM32_HAVE_IP_I2S_M3M4_V1
	select STM32_HAVE_IP_ONESHOT_M3M4_V1
	select STM32_HAVE_IP_OTGFS_M3M4_V1 if STM32_HAVE_OTGFS
	select STM32_HAVE_IP_OTGHS_M3M4_V1
	select STM32_HAVE_IP_PWR_M3M4_V1
	select STM32_HAVE_IP_RNG_M3M4_V1 if STM32_HAVE_RNG
	select STM32_HAVE_IP_RTC_M3M4_V1
	select STM32_HAVE_IP_RTCC_M3M4_V1
	select STM32_HAVE_RTC_MAGIC
	select STM32_HAVE_RTC
	select STM32_HAVE_CRC
	select STM32_HAVE_PWR
	select STM32_HAVE_BKPSRAM
	select STM32_HAVE_IP_SDIO_M3M4_V1
	select STM32_HAVE_IP_SPI_V2
	select STM32_HAVE_IP_SYSCFG_M3M4_V1
	select STM32_HAVE_IP_TIMERS_M3M4_V1
	select STM32_HAVE_IP_USART_V2
	select STM32_HAVE_IP_USBDEV_M3M4_V1 if STM32_HAVE_USBDEV
	select STM32_HAVE_IP_USBFS_M3M4_V1 if STM32_HAVE_USBFS
	select STM32_HAVE_IP_WDG_M3M4_V1

config STM32_STM32F205
	bool
	default n

config STM32_STM32F207
	bool
	default n
	select STM32_HAVE_FSMC
	select STM32_HAVE_ETHMAC
```
