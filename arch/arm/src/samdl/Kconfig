## arch/arm/src/stm32f0l0g0/Kconfig
```kconfig
#
# For a description of the syntax of this configuration file,
# see the file kconfig-language.txt in the NuttX tools repository.
#

comment "STM32F0/L0/G0 Configuration Options"

config STM32_F0L0G0_PERIPHERALS
	bool
	default y
	depends on ARCH_CHIP_STM32F0 || ARCH_CHIP_STM32L0 || ARCH_CHIP_STM32G0 || ARCH_CHIP_STM32C0
	select STM32_HAVE_COMP
	select STM32_HAVE_I2C1
	select STM32_HAVE_SPI1
	select STM32_HAVE_SYSCFG
	select STM32_HAVE_USART1
	select STM32_HAVE_USART2

choice
	prompt "ST STM32F0/L0/G0 Chip Selection"
	default ARCH_CHIP_STM32F051R8 if ARCH_CHIP_STM32F0
	default ARCH_CHIP_STM32L073RZ if ARCH_CHIP_STM32L0
	default ARCH_CHIP_STM32G071RB if ARCH_CHIP_STM32G0
	default ARCH_CHIP_STM32C071RB if ARCH_CHIP_STM32C0
	depends on ARCH_CHIP_STM32F0 || ARCH_CHIP_STM32L0 || ARCH_CHIP_STM32G0 || ARCH_CHIP_STM32C0

config ARCH_CHIP_STM32F030C6
	bool "STM32F030C6"
	select STM32_STM32F03X
	select STM32_VALUELINE
	depends on ARCH_CHIP_STM32F0

config ARCH_CHIP_STM32F030C8
	bool "STM32F030C8"
	select STM32_STM32F03X
	select STM32_VALUELINE
	depends on ARCH_CHIP_STM32F0

config ARCH_CHIP_STM32F030CC
	bool "STM32F030CC"
	select STM32_STM32F03X
	select STM32_VALUELINE
	depends on ARCH_CHIP_STM32F0

config ARCH_CHIP_STM32F030F4
	bool "STM32F030F4"
	select STM32_STM32F03X
	select STM32_VALUELINE
	depends on ARCH_CHIP_STM32F0

config ARCH_CHIP_STM32F030K6
	bool "STM32F030K6"
	select STM32_STM32F03X
	select STM32_VALUELINE
	depends on ARCH_CHIP_STM32F0

config ARCH_CHIP_STM32F030R8
	bool "STM32F030R8"
	select STM32_STM32F03X
	select STM32_VALUELINE
	depends on ARCH_CHIP_STM32F0

config ARCH_CHIP_STM32F030RC
	bool "STM32F030RC"
	select STM32_STM32F03X
	select STM32_VALUELINE
	depends on ARCH_CHIP_STM32F0

config ARCH_CHIP_STM32F031C4
	bool "STM32F031C4"
	select STM32_STM32F03X
	select STM32_ACCESSLINE
	depends on ARCH_CHIP_STM32F0

config ARCH_CHIP_STM32F031C6
	bool "STM32F031C6"
	select STM32_STM32F03X
	select STM32_ACCESSLINE
	depends on ARCH_CHIP_STM32F0

config ARCH_CHIP_STM32F031E6
	bool "STM32F031E6"
	select STM32_STM32F03X
	select STM32_ACCESSLINE
	depends on ARCH_CHIP_STM32F0

config ARCH_CHIP_STM32F031F4
	bool "STM32F031F4"
	select STM32_STM32F03X
	select STM32_ACCESSLINE
	depends on ARCH_CHIP_STM32F0

config ARCH_CHIP_STM32F031F6
	bool "STM32F031F6"
	select STM32_STM32F03X
	select STM32_ACCESSLINE
	depends on ARCH_CHIP_STM32F0

config ARCH_CHIP_STM32F031G4
	bool "STM32F031G4"
	select STM32_STM32F03X
	select STM32_ACCESSLINE
	depends on ARCH_CHIP_STM32F0

config ARCH_CHIP_STM32F031G6
	bool "STM32F031G6"
	select STM32_STM32F03X
	select STM32_ACCESSLINE
	depends on ARCH_CHIP_STM32F0

config ARCH_CHIP_STM32F031K4
	bool "STM32F031K4"
	select STM32_STM32F03X
	select STM32_ACCESSLINE
	depends on ARCH_CHIP_STM32F0

config ARCH_CHIP_STM32F031K6
	bool "STM32F031K6"
	select STM32_STM32F03X
	select STM32_ACCESSLINE
	depends on ARCH_CHIP_STM32F0

config ARCH_CHIP_STM32F038C6
	bool "STM32F038C6"
	select STM32_STM32F03X
	select STM32_LOWVOLTLINE
	depends on ARCH_CHIP_STM32F0

config ARCH_CHIP_STM32F038E6
	bool "STM32F038E6"
	select STM32_STM32F03X
	select STM32_LOWVOLTLINE
	depends on ARCH_CHIP_STM32F0

config ARCH_CHIP_STM32F038F6
	bool "STM32F038F6"
	select STM32_STM32F03X
	select STM32_LOWVOLTLINE
	depends on ARCH_CHIP_STM32F0

config ARCH_CHIP_STM32F038G6
	bool "STM32F038G6"
	select STM32_STM32F03X
	select STM32_LOWVOLTLINE
	depends on ARCH_CHIP_STM32F0

config ARCH_CHIP_STM32F038K6
	bool "STM32F038K6"
	select STM32_STM32F03X
	select STM32_LOWVOLTLINE
	depends on ARCH_CHIP_STM32F0

config ARCH_CHIP_STM32F042C4
	bool "STM32F042C4"
	select STM32_STM32F04X
	select STM32_USBLINE
	depends on ARCH_CHIP_STM32F0

config ARCH_CHIP_STM32F042C6
	bool "STM32F042C6"
	select STM32_STM32F04X
	select STM32_USBLINE
	depends on ARCH_CHIP_STM32F0

config ARCH_CHIP_STM32F042F4
	bool "STM32F042F4"
	select STM32_STM32F04X
	select STM32_USBLINE
	depends on ARCH_CHIP_STM32F0

config ARCH_CHIP_STM32F042F6
	bool "STM32F042F6"
	select STM32_STM32F04X
	select STM32_USBLINE
	depends on ARCH_CHIP_STM32F0

config ARCH_CHIP_STM32F042G4
	bool "STM32F042G4"
	select STM32_STM32F04X
	select STM32_USBLINE
	depends on ARCH_CHIP_STM32F0

config ARCH_CHIP_STM32F042G6
	bool "STM32F042G6"
	select STM32_STM32F04X
	select STM32_USBLINE
	depends on ARCH_CHIP_STM32F0

config ARCH_CHIP_STM32F042K4
	bool "STM32F042K4"
	select STM32_STM32F04X
	select STM32_USBLINE
	depends on ARCH_CHIP_STM32F0

config ARCH_CHIP_STM32F042K6
	bool "STM32F042K6"
	select STM32_STM32F04X
	select STM32_USBLINE
	depends on ARCH_CHIP_STM32F0

config ARCH_CHIP_STM32F042T6
	bool "STM32F042T6"
	select STM32_STM32F04X
	select STM32_USBLINE
	depends on ARCH_CHIP_STM32F0

config ARCH_CHIP_STM32F048C6
	bool "STM32F048C6"
	select STM32_STM32F04X
	select STM32_LOWVOLTLINE
	depends on ARCH_CHIP_STM32F0

config ARCH_CHIP_STM32F048G6
	bool "STM32F048G6"
	select STM32_STM32F04X
	select STM32_LOWVOLTLINE
	depends on ARCH_CHIP_STM32F0

config ARCH_CHIP_STM32F048T6
	bool "STM32F048T6"
	select STM32_STM32F04X
	select STM32_LOWVOLTLINE
	depends on ARCH_CHIP_STM32F0

config ARCH_CHIP_STM32F051C4
	bool "STM32F051C4"
	select STM32_STM32F05X
	select STM32_ACCESSLINE
	depends on ARCH_CHIP_STM32F0

config ARCH_CHIP_STM32F051C6
	bool "STM32F051C6"
	select STM32_STM32F05X
	select STM32_ACCESSLINE
	depends on ARCH_CHIP_STM32F0

config ARCH_CHIP_STM32F051C8
	bool "STM32F051C8"
	select STM32_STM32F05X
	select STM32_ACCESSLINE
	depends on ARCH_CHIP_STM32F0

config ARCH_CHIP_STM32F051K4
	bool "STM32F051K4"
	select STM32_STM32F05X
	select STM32_ACCESSLINE
	depends on ARCH_CHIP_STM32F0

config ARCH_CHIP_STM32F051K6
	bool "STM32F051K6"
	select STM32_STM32F05X
	select STM32_ACCESSLINE
	depends on ARCH_CHIP_STM32F0

config ARCH_CHIP_STM32F051K8
	bool "STM32F051K8"
	select STM32_STM32F05X
	select STM32_ACCESSLINE
	depends on ARCH_CHIP_STM32F0

config ARCH_CHIP_STM32F051R4
	bool "STM32F051R4"
	select STM32_STM32F05X
	select STM32_ACCESSLINE
	depends on ARCH_CHIP_STM32F0

config ARCH_CHIP_STM32F051R6
	bool "STM32F051R6"
	select STM32_STM32F05X
	select STM32_ACCESSLINE
	depends on ARCH_CHIP_STM32F0

config ARCH_CHIP_STM32F051R8
	bool "STM32F051R8"
	select STM32_STM32F05X
	select STM32_ACCESSLINE
	depends on ARCH_CHIP_STM32F0

config ARCH_CHIP_STM32F051T8
	bool "STM32F051T8"
	select STM32_STM32F05X
	select STM32_ACCESSLINE
	depends on ARCH_CHIP_STM32F0

config ARCH_CHIP_STM32F058C8
	bool "STM32F058C8"
	select STM32_STM32F05X
	select STM32_LOWVOLTLINE
	depends on ARCH_CHIP_STM32F0

config ARCH_CHIP_STM32F058R8
	bool "STM32F058R8"
	select STM32_STM32F05X
	select STM32_LOWVOLTLINE
	depends on ARCH_CHIP_STM32F0

config ARCH_CHIP_STM32F058T8
	bool "STM32F058T8"
	select STM32_STM32F05X
	select STM32_LOWVOLTLINE
	depends on ARCH_CHIP_STM32F0

config ARCH_CHIP_STM32F070C6
	bool "STM32F070C6"
	select STM32_STM32F07X
	select STM32_VALUELINE
	depends on ARCH_CHIP_STM32F0

config ARCH_CHIP_STM32F070CB
	bool "STM32F070CB"
	select STM32_STM32F07X
	select STM32_VALUELINE
	depends on ARCH_CHIP_STM32F0

config ARCH_CHIP_STM32F070F6
	bool "STM32F070F6"
	select STM32_STM32F07X
	select STM32_VALUELINE
	depends on ARCH_CHIP_STM32F0

config ARCH_CHIP_STM32F070RB
	bool "STM32F070RB"
	select STM32_STM32F07X
	select STM32_VALUELINE
	depends on ARCH_CHIP_STM32F0

config ARCH_CHIP_STM32F071C8
	bool "STM32F071C8"
	select STM32_STM32F07X
	select STM32_ACCESSLINE
	depends on ARCH_CHIP_STM32F0

config ARCH_CHIP_STM32F071CB
	bool "STM32F071CB"
	select STM32_STM32F07X
	select STM32_ACCESSLINE
	depends on ARCH_CHIP_STM32F0

config ARCH_CHIP_STM32F071RB
	bool "STM32F071RB"
	select STM32_STM32F07X
	select STM32_ACCESSLINE
	depends on ARCH_CHIP_STM32F0

config ARCH_CHIP_STM32F071V8
	bool "STM32F071V8"
	select STM32_STM32F07X
	select STM32_ACCESSLINE
	depends on ARCH_CHIP_STM32F0

config ARCH_CHIP_STM32F071VB
	bool "STM32F071VB"
	select STM32_STM32F07X
	select STM32_ACCESSLINE
	depends on ARCH_CHIP_STM32F0

config ARCH_CHIP_STM32F072C8
	bool "STM32F072C8"
	select STM32_STM32F07X
	select STM32_USBLINE
	depends on ARCH_CHIP_STM32F0

config ARCH_CHIP_STM32F072CB
	bool "STM32F072CB"
	select STM32_STM32F07X
	select STM32_USBLINE
	depends on ARCH_CHIP_STM32F0

config ARCH_CHIP_STM32F072R8
	bool "STM32F072R8"
	select STM32_STM32F07X
	select STM32_USBLINE
	depends on ARCH_CHIP_STM32F0

config ARCH_CHIP_STM32F072RB
	bool "STM32F072RB"
	select STM32_STM32F07X
	select STM32_USBLINE
	depends on ARCH_CHIP_STM32F0

config ARCH_CHIP_STM32F072V8
	bool "STM32F072V8"
	select STM32_STM32F07X
	select STM32_USBLINE
	depends on ARCH_CHIP_STM32F0

config ARCH_CHIP_STM32F072VB
	bool "STM32F072VB"
	select STM32_STM32F07X
	select STM32_USBLINE
	depends on ARCH_CHIP_STM32F0

config ARCH_CHIP_STM32F078CB
	bool "STM32F078CB"
	select STM32_STM32F07X
	select STM32_LOWVOLTLINE
	depends on ARCH_CHIP_STM32F0

config ARCH_CHIP_STM32F078RB
	bool "STM32F078RB"
	select STM32_STM32F07X
	select STM32_LOWVOLTLINE
	depends on ARCH_CHIP_STM32F0

config ARCH_CHIP_STM32F078VB
	bool "STM32F078VB"
	select STM32_STM32F07X
	select STM32_LOWVOLTLINE
	depends on ARCH_CHIP_STM32F0

config ARCH_CHIP_STM32F091CB
	bool "STM32F091CB"
	select STM32_STM32F09X
	select STM32_ACCESSLINE
	depends on ARCH_CHIP_STM32F0

config ARCH_CHIP_STM32F091CC
	bool "STM32F091CC"
	select STM32_STM32F09X
	select STM32_ACCESSLINE
	depends on ARCH_CHIP_STM32F0

config ARCH_CHIP_STM32F091RB
	bool "STM32F091RB"
	select STM32_STM32F09X
	select STM32_ACCESSLINE
	depends on ARCH_CHIP_STM32F0

config ARCH_CHIP_STM32F091RC
	bool "STM32F091RC"
	select STM32_STM32F09X
	select STM32_ACCESSLINE
	depends on ARCH_CHIP_STM32F0

config ARCH_CHIP_STM32F091VB
	bool "STM32F091VB"
	select STM32_STM32F09X
	select STM32_ACCESSLINE
	depends on ARCH_CHIP_STM32F0

config ARCH_CHIP_STM32F091VC
	bool "STM32F091VC"
	select STM32_STM32F09X
	select STM32_ACCESSLINE
	depends on ARCH_CHIP_STM32F0

config ARCH_CHIP_STM32F098CC
	bool "STM32F098CC"
	select STM32_STM32F09X
	select STM32_LOWVOLTLINE
	depends on ARCH_CHIP_STM32F0

config ARCH_CHIP_STM32F098RC
	bool "STM32F098RC"
	select STM32_STM32F09X
	select STM32_LOWVOLTLINE
	depends on ARCH_CHIP_STM32F0

config ARCH_CHIP_STM32F098VC
	bool "STM32F098VC"
	select STM32_STM32F09X
	select STM32_LOWVOLTLINE
	depends on ARCH_CHIP_STM32F0

config ARCH_CHIP_STM32G070CB
	bool "STM32G070CB"
	select STM32_STM32G070
	select STM32_FLASH_CONFIG_B
	depends on ARCH_CHIP_STM32G0

config ARCH_CHIP_STM32G070KB
	bool "STM32G070KB"
	select STM32_STM32G070
	select STM32_FLASH_CONFIG_B
	depends on ARCH_CHIP_STM32G0

config ARCH_CHIP_STM32G070RB
	bool "STM32G070RB"
	select STM32_STM32G070
	select STM32_FLASH_CONFIG_B
	depends on ARCH_CHIP_STM32G0

config ARCH_CHIP_STM32G071EB
	bool "STM32G071EB"
	select STM32_STM32G071
	select STM32_FLASH_CONFIG_B
	depends on ARCH_CHIP_STM32G0

config ARCH_CHIP_STM32G071G8
	bool "STM32G071G8"
	select STM32_STM32G071
	select STM32_FLASH_CONFIG_8
	depends on ARCH_CHIP_STM32G0

config ARCH_CHIP_STM32G071GB
	bool "STM32G071GB"
	select STM32_STM32G071
	select STM32_FLASH_CONFIG_B
	depends on ARCH_CHIP_STM32G0

config ARCH_CHIP_STM32G071G8XN
	bool "STM32G071G8XN"
	select STM32_STM32G071
	select STM32_FLASH_CONFIG_8
	depends on ARCH_CHIP_STM32G0

config ARCH_CHIP_STM32G071GBXN
	bool "STM32G071GBXN"
	select STM32_STM32G071
	select STM32_FLASH_CONFIG_B
	depends on ARCH_CHIP_STM32G0

config ARCH_CHIP_STM32G071K8
	bool "STM32G071K8"
	select STM32_STM32G071
	select STM32_FLASH_CONFIG_8
	depends on ARCH_CHIP_STM32G0

config ARCH_CHIP_STM32G071KB
	bool "STM32G071KB"
	select STM32_STM32G071
	select STM32_FLASH_CONFIG_B
	depends on ARCH_CHIP_STM32G0

config ARCH_CHIP_STM32G071K8XN
	bool "STM32G071K8XN"
	select STM32_STM32G071
	select STM32_FLASH_CONFIG_8
	depends on ARCH_CHIP_STM32G0

config ARCH_CHIP_STM32G071KBXN
	bool "STM32G071KBXN"
	select STM32_STM32G071
	select STM32_FLASH_CONFIG_B
	depends on ARCH_CHIP_STM32G0

config ARCH_CHIP_STM32G071C8
	bool "STM32G071C8"
	select STM32_STM32G071
	select STM32_FLASH_CONFIG_8
	depends on ARCH_CHIP_STM32G0

config ARCH_CHIP_STM32G071CB
	bool "STM32G071CB"
	select STM32_STM32G071
	select STM32_FLASH_CONFIG_B
	depends on ARCH_CHIP_STM32G0

config ARCH_CHIP_STM32G071R8
	bool "STM32G071R8"
	select STM32_STM32G071
	select STM32_FLASH_CONFIG_8
	depends on ARCH_CHIP_STM32G0

config ARCH_CHIP_STM32G071RB
	bool "STM32G071RB"
	select STM32_STM32G071
	select STM32_FLASH_CONFIG_B
	depends on ARCH_CHIP_STM32G0

config ARCH_CHIP_STM32G0B1KB
	bool "STM32G0B1KB"
	select STM32_STM32G0B1
	select STM32_FLASH_CONFIG_B
	depends on ARCH_CHIP_STM32G0

config ARCH_CHIP_STM32G0B1CB
	bool "STM32G0B1CB"
	select STM32_STM32G0B1
	select STM32_FLASH_CONFIG_B
	depends on ARCH_CHIP_STM32G0

config ARCH_CHIP_STM32G0B1RB
	bool "STM32G0B1RB"
	select STM32_STM32G0B1
	select STM32_FLASH_CONFIG_B
	depends on ARCH_CHIP_STM32G0

config ARCH_CHIP_STM32G0B1MB
	bool "STM32G0B1MB"
	select STM32_STM32G0B1
	select STM32_FLASH_CONFIG_B
	depends on ARCH_CHIP_STM32G0

config ARCH_CHIP_STM32G0B1VB
	bool "STM32G0B1VB"
	select STM32_STM32G0B1
	select STM32_FLASH_CONFIG_B
	depends on ARCH_CHIP_STM32G0

config ARCH_CHIP_STM32G0B1KC
	bool "STM32G0B1KC"
	select STM32_STM32G0B1
	select STM32_FLASH_CONFIG_C
	depends on ARCH_CHIP_STM32G0

config ARCH_CHIP_STM32G0B1CC
	bool "STM32G0B1CC"
	select STM32_STM32G0B1
	select STM32_FLASH_CONFIG_C
	depends on ARCH_CHIP_STM32G0

config ARCH_CHIP_STM32G0B1RC
	bool "STM32G0B1RC"
	select STM32_STM32G0B1
	select STM32_FLASH_CONFIG_C
	depends on ARCH_CHIP_STM32G0

config ARCH_CHIP_STM32G0B1MC
	bool "STM32G0B1MC"
	select STM32_STM32G0B1
	select STM32_FLASH_CONFIG_C
	depends on ARCH_CHIP_STM32G0

config ARCH_CHIP_STM32G0B1VC
	bool "STM32G0B1VC"
	select STM32_STM32G0B1
	select STM32_FLASH_CONFIG_C
	depends on ARCH_CHIP_STM32G0

config ARCH_CHIP_STM32G0B1KE
	bool "STM32G0B1KE"
	select STM32_STM32G0B1
	select STM32_FLASH_CONFIG_E
	depends on ARCH_CHIP_STM32G0

config ARCH_CHIP_STM32G0B1CE
	bool "STM32G0B1CE"
	select STM32_STM32G0B1
	select STM32_FLASH_CONFIG_E
	depends on ARCH_CHIP_STM32G0

config ARCH_CHIP_STM32G0B1RE
	bool "STM32G0B1RE"
	select STM32_STM32G0B1
	select STM32_FLASH_CONFIG_E
	depends on ARCH_CHIP_STM32G0

config ARCH_CHIP_STM32G0B1NE
	bool "STM32G0B1NE"
	select STM32_STM32G0B1
	select STM32_FLASH_CONFIG_E
	depends on ARCH_CHIP_STM32G0

config ARCH_CHIP_STM32G0B1ME
	bool "STM32G0B1ME"
	select STM32_STM32G0B1
	select STM32_FLASH_CONFIG_E
	depends on ARCH_CHIP_STM32G0

config ARCH_CHIP_STM32G0B1VE
	bool "STM32G0B1VE"
	select STM32_STM32G0B1
	select STM32_FLASH_CONFIG_E
	depends on ARCH_CHIP_STM32G0

config ARCH_CHIP_STM32L053C8
	bool "STM32L053C8"
	select ARCH_CHIP_STM32L053XX
	depends on ARCH_CHIP_STM32L0

config ARCH_CHIP_STM32L053R8
	bool "STM32L053R8"
	select ARCH_CHIP_STM32L053XX
	depends on ARCH_CHIP_STM32L0

config ARCH_CHIP_STM32L071K8
	bool "STM32L071K8"
	select ARCH_CHIP_STM32L071XX
	depends on ARCH_CHIP_STM32L0

config ARCH_CHIP_STM32L071KB
	bool "STM32L071KB"
	select ARCH_CHIP_STM32L071XX
	depends on ARCH_CHIP_STM32L0

config ARCH_CHIP_STM32L071KZ
	bool "STM32L071KZ"
	select ARCH_CHIP_STM32L071XX
	depends on ARCH_CHIP_STM32L0

config ARCH_CHIP_STM32L071C8
	bool "STM32L071C8"
	select ARCH_CHIP_STM32L071XX
	select STM32_HAVE_USART5
	select STM32_HAVE_SPI2
	select STM32_HAVE_I2C3
	depends on ARCH_CHIP_STM32L0

config ARCH_CHIP_STM32L071CB
	bool "STM32L071CB"
	select ARCH_CHIP_STM32L071XX
	select STM32_HAVE_USART5
	select STM32_HAVE_SPI2
	select STM32_HAVE_I2C3
	depends on ARCH_CHIP_STM32L0

config ARCH_CHIP_STM32L071CZ
	bool "STM32L071CZ"
	select ARCH_CHIP_STM32L071XX
	select STM32_HAVE_USART5
	select STM32_HAVE_SPI2
	select STM32_HAVE_I2C3
	depends on ARCH_CHIP_STM32L0

config ARCH_CHIP_STM32L071V8
	bool "STM32L071V8"
	select ARCH_CHIP_STM32L071XX
	select STM32_HAVE_USART5
	select STM32_HAVE_SPI2
	select STM32_HAVE_I2C3
	depends on ARCH_CHIP_STM32L0

config ARCH_CHIP_STM32L071VB
	bool "STM32L071VB"
	select ARCH_CHIP_STM32L071XX
	select STM32_HAVE_USART5
	select STM32_HAVE_SPI2
	select STM32_HAVE_I2C3
	depends on ARCH_CHIP_STM32L0

config ARCH_CHIP_STM32L071VZ
	bool "STM32L071VZ"
	select ARCH_CHIP_STM32L071XX
	select STM32_HAVE_USART5
	select STM32_HAVE_SPI2
	select STM32_HAVE_I2C3
	depends on ARCH_CHIP_STM32L0

config ARCH_CHIP_STM32L071RB
	bool "STM32L071RB"
	select ARCH_CHIP_STM32L071XX
	select STM32_HAVE_USART5
	select STM32_HAVE_SPI2
	select STM32_HAVE_I2C3
	depends on ARCH_CHIP_STM32L0

config ARCH_CHIP_STM32L071RZ
	bool "STM32L071RZ"
	select ARCH_CHIP_STM32L071XX
	select STM32_HAVE_USART5
	select STM32_HAVE_SPI2
	select STM32_HAVE_I2C3
	depends on ARCH_CHIP_STM32L0

config ARCH_CHIP_STM32L072V8
	bool "STM32L072V8"
	select ARCH_CHIP_STM32L072XX
	select STM32_HAVE_SPI2
	select STM32_HAVE_I2C3
	depends on ARCH_CHIP_STM32L0

config ARCH_CHIP_STM32L072VB
	bool "STM32L072VB"
	select ARCH_CHIP_STM32L072XX
	select STM32_HAVE_SPI2
	select STM32_HAVE_I2C3
	depends on ARCH_CHIP_STM32L0

config ARCH_CHIP_STM32L072VZ
	bool "STM32L072VZ"
	select ARCH_CHIP_STM32L072XX
	select STM32_HAVE_SPI2
	select STM32_HAVE_I2C3
	depends on ARCH_CHIP_STM32L0

config ARCH_CHIP_STM32L072KB
	bool "STM32L072KB"
	select ARCH_CHIP_STM32L072XX
	depends on ARCH_CHIP_STM32L0

config ARCH_CHIP_STM32L072KZ
	bool "STM32L072KZ"
	select ARCH_CHIP_STM32L072XX
	depends on ARCH_CHIP_STM32L0

config ARCH_CHIP_STM32L072CB
	bool "STM32L072CB"
	select ARCH_CHIP_STM32L072XX
	select STM32_HAVE_SPI2
	select STM32_HAVE_I2C3
	depends on ARCH_CHIP_STM32L0

config ARCH_CHIP_STM32L072CZ
	bool "STM32L072CZ"
	select ARCH_CHIP_STM32L072XX
	select STM32_HAVE_SPI2
	select STM32_HAVE_I2C3
	depends on ARCH_CHIP_STM32L0

config ARCH_CHIP_STM32L072RB
	bool "STM32L072RB"
	select ARCH_CHIP_STM32L072XX
	select STM32_HAVE_SPI2
	select STM32_HAVE_I2C3
	depends on ARCH_CHIP_STM32L0

config ARCH_CHIP_STM32L072RZ
	bool "STM32L072RZ"
	select ARCH_CHIP_STM32L072XX
	select STM32_HAVE_SPI2
	select STM32_HAVE_I2C3
	depends on ARCH_CHIP_STM32L0

config ARCH_CHIP_STM32L073V8
	bool "STM32L073V8"
	select ARCH_CHIP_STM32L073XX
	depends on ARCH_CHIP_STM32L0

config ARCH_CHIP_STM32L073VB
	bool "STM32L073VB"
	select ARCH_CHIP_STM32L073XX
	depends on ARCH_CHIP_STM32L0

config ARCH_CHIP_STM32L073VZ
	bool "STM32L073VZ"
	select ARCH_CHIP_STM32L073XX
	depends on ARCH_CHIP_STM32L0

config ARCH_CHIP_STM32L073CB
	bool "STM32L073CB"
	select ARCH_CHIP_STM32L073XX
	depends on ARCH_CHIP_STM32L0

config ARCH_CHIP_STM32L073CZ
	bool "STM32L073CZ"
	select ARCH_CHIP_STM32L073XX
	depends on ARCH_CHIP_STM32L0

config ARCH_CHIP_STM32L073RB
	bool "STM32L073RB"
	select ARCH_CHIP_STM32L073XX
	depends on ARCH_CHIP_STM32L0

config ARCH_CHIP_STM32L073RZ
	bool "STM32L073RZ"
	select ARCH_CHIP_STM32L073XX
	depends on ARCH_CHIP_STM32L0

config ARCH_CHIP_STM32C051D8
	bool "STM32C051D8"
	select ARCH_CHIP_STM32C051XX
	select STM32_FLASH_CONFIG_8

config ARCH_CHIP_STM32C051F6
	bool "STM32C051F6"
	select ARCH_CHIP_STM32C051XX
	select STM32_FLASH_CONFIG_6

config ARCH_CHIP_STM32C051F8
	bool "STM32C051F8"
	select ARCH_CHIP_STM32C051XX
	select STM32_FLASH_CONFIG_8

config ARCH_CHIP_STM32C051G6
	bool "STM32C051G6"
	select ARCH_CHIP_STM32C051XX
	select STM32_FLASH_CONFIG_6

config ARCH_CHIP_STM32C051G8
	bool "STM32C051G8"
	select ARCH_CHIP_STM32C051XX
	select STM32_FLASH_CONFIG_8

config ARCH_CHIP_STM32C051K6
	bool "STM32C051K6"
	select ARCH_CHIP_STM32C051XX
	select STM32_FLASH_CONFIG_6

config ARCH_CHIP_STM32C051K8
	bool "STM32C051K8"
	select ARCH_CHIP_STM32C051XX
	select STM32_FLASH_CONFIG_8

config ARCH_CHIP_STM32C051C6
	bool "STM32C051C6"
	select ARCH_CHIP_STM32C051XX
	select STM32_FLASH_CONFIG_6

config ARCH_CHIP_STM32C051C8
	bool "STM32C051C8"
	select ARCH_CHIP_STM32C051XX
	select STM32_FLASH_CONFIG_8

config ARCH_CHIP_STM32C071F8
	bool "STM32C071F8"
	select ARCH_CHIP_STM32C071XX
	select STM32_FLASH_CONFIG_8

config ARCH_CHIP_STM32C071FB
	bool "STM32C071FB"
	select ARCH_CHIP_STM32C071XX
	select STM32_FLASH_CONFIG_B

config ARCH_CHIP_STM32C071G8
	bool "STM32C071G8"
	select ARCH_CHIP_STM32C071XX
	select STM32_FLASH_CONFIG_8

config ARCH_CHIP_STM32C071GB
	bool "STM32C071GB"
	select ARCH_CHIP_STM32C071XX
	select STM32_FLASH_CONFIG_B

config ARCH_CHIP_STM32C071K8
	bool "STM32C071K8"
	select ARCH_CHIP_STM32C071XX
	select STM32_FLASH_CONFIG_8

config ARCH_CHIP_STM32C071KB
	bool "STM32C071KB"
	select ARCH_CHIP_STM32C071XX
	select STM32_FLASH_CONFIG_B

config ARCH_CHIP_STM32C071C8
	bool "STM32C071C8"
	select ARCH_CHIP_STM32C071XX
	select STM32_FLASH_CONFIG_8

config ARCH_CHIP_STM32C071CB
	bool "STM32C071CB"
	select ARCH_CHIP_STM32C071XX
	select STM32_FLASH_CONFIG_B

config ARCH_CHIP_STM32C071R8
	bool "STM32C071R8"
	select ARCH_CHIP_STM32C071XX
	select STM32_FLASH_CONFIG_8

config ARCH_CHIP_STM32C071RB
	bool "STM32C071RB"
	select ARCH_CHIP_STM32C071XX
	select STM32_FLASH_CONFIG_B

config ARCH_CHIP_STM32C091FB
	bool "STM32C091FB"
	select ARCH_CHIP_STM32C091XX
	select STM32_FLASH_CONFIG_B

config ARCH_CHIP_STM32C091FC
	bool "STM32C091FC"
	select ARCH_CHIP_STM32C091XX
	select STM32_FLASH_CONFIG_C

config ARCH_CHIP_STM32C091EC
	bool "STM32C091EC"
	select ARCH_CHIP_STM32C091XX
	select STM32_FLASH_CONFIG_C

config ARCH_CHIP_STM32C091GB
	bool "STM32C091GB"
	select ARCH_CHIP_STM32C091XX
	select STM32_FLASH_CONFIG_B

config ARCH_CHIP_STM32C091GC
	bool "STM32C091GC"
	select ARCH_CHIP_STM32C091XX
	select STM32_FLASH_CONFIG_C

config ARCH_CHIP_STM32C091KB
	bool "STM32C091KB"
	select ARCH_CHIP_STM32C091XX
	select STM32_FLASH_CONFIG_B

config ARCH_CHIP_STM32C091KC
	bool "STM32C091KC"
	select ARCH_CHIP_STM32C091XX
	select STM32_FLASH_CONFIG_C

config ARCH_CHIP_STM32C091CB
	bool "STM32C091CB"
	select ARCH_CHIP_STM32C091XX
	select STM32_FLASH_CONFIG_B

config ARCH_CHIP_STM32C091CC
	bool "STM32C091CC"
	select ARCH_CHIP_STM32C091XX
	select STM32_FLASH_CONFIG_C

config ARCH_CHIP_STM32C091RB
	bool "STM32C091RB"
	select ARCH_CHIP_STM32C091XX
	select STM32_FLASH_CONFIG_B

config ARCH_CHIP_STM32C091RC
	bool "STM32C091RC"
	select ARCH_CHIP_STM32C091XX
	select STM32_FLASH_CONFIG_C

config ARCH_CHIP_STM32C092FB
	bool "STM32C092FB"
	select ARCH_CHIP_STM32C092XX
	select STM32_FLASH_CONFIG_B

config ARCH_CHIP_STM32C092FC
	bool "STM32C092FC"
	select ARCH_CHIP_STM32C092XX
	select STM32_FLASH_CONFIG_C

config ARCH_CHIP_STM32C092EC
	bool "STM32C092EC"
	select ARCH_CHIP_STM32C092XX
	select STM32_FLASH_CONFIG_C

config ARCH_CHIP_STM32C092GB
	bool "STM32C092GB"
	select ARCH_CHIP_STM32C092XX
	select STM32_FLASH_CONFIG_B

config ARCH_CHIP_STM32C092GC
	bool "STM32C092GC"
	select ARCH_CHIP_STM32C092XX
	select STM32_FLASH_CONFIG_C

config ARCH_CHIP_STM32C092KB
	bool "STM32C092KB"
	select ARCH_CHIP_STM32C092XX
	select STM32_FLASH_CONFIG_B

config ARCH_CHIP_STM32C092KC
	bool "STM32C092KC"
	select ARCH_CHIP_STM32C092XX
	select STM32_FLASH_CONFIG_C

config ARCH_CHIP_STM32C092CB
	bool "STM32C092CB"
	select ARCH_CHIP_STM32C092XX
	select STM32_FLASH_CONFIG_B

config ARCH_CHIP_STM32C092CC
	bool "STM32C092CC"
	select ARCH_CHIP_STM32C092XX
	select STM32_FLASH_CONFIG_C

config ARCH_CHIP_STM32C092RB
	bool "STM32C092RB"
	select ARCH_CHIP_STM32C092XX
	select STM32_FLASH_CONFIG_B

config ARCH_CHIP_STM32C092RC
	bool "STM32C092RC"
	select ARCH_CHIP_STM32C092XX
	select STM32_FLASH_CONFIG_C

endchoice # ST STM32F0/L0/G0/C0 Chip Selection

# Flash configurations

config STM32_FLASH_OVERRIDE
	bool "Override Flash Designator"
	default n

config STM32_STM32F0
	bool
	default n
	select STM32_HAVE_USART3
	select STM32_HAVE_USART4
	select STM32_HAVE_TIM1
	select STM32_HAVE_TIM2
	select STM32_HAVE_TIM3
	select STM32_HAVE_TIM6
	select STM32_HAVE_TIM7
	select STM32_HAVE_TIM14
	select STM32_HAVE_TIM15
	select STM32_HAVE_TIM16
	select STM32_HAVE_TIM17
	select STM32_HAVE_ADC1_DMA
	select STM32_HAVE_IP_USART_V1
	select STM32_HAVE_IP_EXTI_V1

config STM32_STM32G0
	bool
	default n
	select STM32_HAVE_ADC1_DMA
	select STM32_HAVE_DMAMUX
	select STM32_HAVE_IP_USART_V2
	select STM32_HAVE_IP_EXTI_V2
	select STM32_HAVE_TIM1
	select STM32_HAVE_TIM3
	select STM32_HAVE_TIM14
	select STM32_HAVE_TIM16
	select STM32_HAVE_TIM17
	select STM32_HAVE_I2C2
	select ARCH_HAVE_PROGMEM

config STM32_STM32L0
	bool
	default n
	select STM32_ENERGYLITE
	select STM32_HAVE_LCD
	select STM32_HAVE_VREFINT
	select STM32_HAVE_ADC1_DMA
	select STM32_HAVE_IP_USART_V1
	select STM32_HAVE_IP_EXTI_V1

config STM32_STM32C0
	bool
	default n
	select STM32_HAVE_SPI2
	select STM32_HAVE_I2C2
	select STM32_HAVE_DMAMUX
	select STM32_HAVE_ADC1_DMA
	select STM32_HAVE_IP_USART_V2
	select STM32_HAVE_IP_EXTI_V2
	select STM32_HAVE_TIM1
	select STM32_HAVE_TIM2
	select STM32_HAVE_TIM3
	select STM32_HAVE_TIM14
	select STM32_HAVE_TIM16
	select STM32_HAVE_TIM17
	select ARCH_HAVE_PROGMEM

config STM32_STM32F03X
	bool
	default n
	select STM32_STM32F0

config STM32_STM32F04X
	bool
	default n
	select STM32_STM32F0
	select STM32_HAVE_HSI48

config STM32_STM32F05X
	bool
	default n
	select STM32_STM32F0
	select STM32_HAVE_DMA2

config STM32_STM32F07X
	bool
	default n
	select STM32_STM32F0
	select STM32_HAVE_HSI48
	select STM32_HAVE_DMA2

config STM32_STM32F09X
	bool
	default n
	select STM32_STM32F0
	select STM32_HAVE_HSI48
	select STM32_HAVE_DMA2

config STM32_STM32G030
	bool
	default n
	select STM32_STM32G0
	select STM32_STM32G03X

config STM32_STM32G031
	bool
	default n
	select STM32_STM32G0
	select STM32_STM32G03X
	select STM32_HAVE_LPUART1

config STM32_STM32G03X
	bool
	default n

config STM32_STM32G041
	bool
	default n
	select STM32_STM32G0
	select STM32_HAVE_RNG
	select STM32_HAVE_AES
	select STM32_HAVE_LPUART1

config STM32_STM32G050
	bool
	default n
	select STM32_STM32G0
	select STM32_STM32G05X

config STM32_STM32G051
	bool
	default n
	select STM32_STM32G0
	select STM32_STM32G05X
	select STM32_HAVE_DAC1
	select STM32_HAVE_COMP1
	select STM32_HAVE_COMP2
	select STM32_HAVE_TIM15
	select STM32_HAVE_LPUART1

config STM32_STM32G05X
	bool
	default n
	select STM32_HAVE_TIM6
	select STM32_HAVE_TIM7

config STM32_STM32G061
	bool
	default n
	select STM32_STM32G0
	select STM32_HAVE_RNG
	select STM32_HAVE_AES
	select STM32_HAVE_DAC1
	select STM32_HAVE_COMP1
	select STM32_HAVE_COMP2
	select STM32_HAVE_TIM6
	select STM32_HAVE_TIM7
	select STM32_HAVE_TIM15
	select STM32_HAVE_LPUART1

config STM32_STM32G070
	bool
	default n
	select STM32_STM32G0
	select STM32_STM32G07X

config STM32_STM32G071
	bool
	default n
	select STM32_STM32G0
	select STM32_STM32G07X
	select STM32_HAVE_DAC1
	select STM32_HAVE_COMP1
	select STM32_HAVE_COMP2
	select STM32_HAVE_CEC
	select STM32_HAVE_LPUART1

config STM32_STM32G07X
	bool
	default n
	select STM32_HAVE_USART3
	select STM32_HAVE_USART4
	select STM32_HAVE_TIM6
	select STM32_HAVE_TIM7
	select STM32_HAVE_TIM15
	select STM32_HAVE_UCPD1
	select STM32_HAVE_UCPD2

config STM32_STM32G081
	bool
	default n
	select STM32_STM32G0
	select STM32_HAVE_USART3
	select STM32_HAVE_USART4
	select STM32_HAVE_RNG
	select STM32_HAVE_AES
	select STM32_HAVE_DAC1
	select STM32_HAVE_COMP1
	select STM32_HAVE_COMP2
	select STM32_HAVE_TIM6
	select STM32_HAVE_TIM7
	select STM32_HAVE_TIM15
	select STM32_HAVE_UCPD1
	select STM32_HAVE_UCPD2
	select STM32_HAVE_CEC
	select STM32_HAVE_LPUART1

config STM32_STM32G0B0
	bool
	default n
	select STM32_STM32G0
	select STM32_STM32G0BX

config STM32_STM32G0B1
	bool
	default n
	select STM32_STM32G0
	select STM32_STM32G0BX
	select STM32_HAVE_DAC1
	select STM32_HAVE_COMP1
	select STM32_HAVE_COMP2
	select STM32_HAVE_COMP3
	select STM32_HAVE_FDCAN1
	select STM32_HAVE_FDCAN2
	select STM32_HAVE_CEC

config STM32_STM32G0BX
	bool
	default n
	select STM32_HAVE_DMA2
	select STM32_HAVE_USART3
	select STM32_HAVE_USART4
	select STM32_HAVE_USART5
	select STM32_HAVE_USART6
	select STM32_HAVE_LPUART1
	select STM32_HAVE_LPUART2
	select STM32_HAVE_CRS
	select STM32_HAVE_TIM4
	select STM32_HAVE_TIM6
	select STM32_HAVE_TIM7
	select STM32_HAVE_TIM15
	select STM32_HAVE_I2C3
	select STM32_HAVE_SPI3
	select STM32_HAVE_I2S2
	select STM32_HAVE_USBDEV
	select STM32_HAVE_UCPD1
	select STM32_HAVE_UCPD2
	select STM32_HAVE_HSI48

config STM32_STM32G0C1
	bool
	default n
	select STM32_STM32G0
	select STM32_HAVE_DMA2
	select STM32_HAVE_USART3
	select STM32_HAVE_USART4
	select STM32_HAVE_USART5
	select STM32_HAVE_USART6
	select STM32_HAVE_CRS
	select STM32_HAVE_RNG
	select STM32_HAVE_AES
	select STM32_HAVE_DAC1
	select STM32_HAVE_COMP1
	select STM32_HAVE_COMP2
	select STM32_HAVE_COMP3
	select STM32_HAVE_TIM4
	select STM32_HAVE_TIM6
	select STM32_HAVE_TIM7
	select STM32_HAVE_TIM15
	select STM32_HAVE_I2C3
	select STM32_HAVE_SPI3
	select STM32_HAVE_I2S2
	select STM32_HAVE_LPUART2
	select STM32_HAVE_USBDEV
	select STM32_HAVE_UCPD1
	select STM32_HAVE_UCPD2
	select STM32_HAVE_FDCAN1
	select STM32_HAVE_FDCAN2
	select STM32_HAVE_CEC
	select STM32_HAVE_HSI48

config STM32_ACCESSLINE
	bool
	default n
	select STM32_HAVE_USART5
	select STM32_HAVE_CAN1
	select STM32_HAVE_SPI2

config STM32_LOWVOLTLINE
	bool
	default n
	select STM32_HAVE_USART5
	select STM32_HAVE_CAN1
	select STM32_HAVE_SPI2

config STM32_USBLINE
	bool
	default n
	select STM32_HAVE_HSI48
	select STM32_HAVE_CAN1
	select STM32_HAVE_SPI2
	select STM32_HAVE_USBDEV

config ARCH_CHIP_STM32L053XX
	bool
	select STM32_STM32L0

config ARCH_CHIP_STM32L071XX
	bool
	select STM32_STM32L0
	select STM32_HAVE_RNG
	select STM32_HAVE_HSI48
	select STM32_HAVE_USART4

config ARCH_CHIP_STM32L072XX
	bool
	select STM32_STM32L0
	select STM32_HAVE_RNG
	select STM32_HAVE_HSI48
	select STM32_HAVE_USART4
	select STM32_HAVE_USART5
	select STM32_HAVE_I2C2
	select STM32_HAVE_USBDEV

config ARCH_CHIP_STM32L073XX
	bool
	select STM32_STM32L0
	select STM32_HAVE_RNG
	select STM32_HAVE_HSI48
	select STM32_HAVE_USART4
	select STM32_HAVE_USART5
	select STM32_HAVE_SPI2
	select STM32_HAVE_I2C2
	select STM32_HAVE_I2C3
	select STM32_HAVE_USBDEV

config ARCH_CHIP_STM32C051XX
	bool
	select STM32_STM32C0

config ARCH_CHIP_STM32C071XX
	bool
	select STM32_STM32C0
	select STM32_HAVE_USBDEV

config ARCH_CHIP_STM32C091XX
	bool
	select STM32_STM32C0
	select STM32_HAVE_USART3
	select STM32_HAVE_USART4
	select STM32_HAVE_TIM15

config ARCH_CHIP_STM32C092XX
	bool
	select STM32_STM32C0
	select STM32_HAVE_USART3
	select STM32_HAVE_USART4
	select STM32_HAVE_FDCAN1

choice
	prompt "SysTick clock source"
	default STM32_SYSTICK_CORECLK

config STM32_SYSTICK_CORECLK
	bool "Cortex-M0 core clock"

config STM32_SYSTICK_CORECLK_DIV16
	bool "Cortex-M0 core clock divided by 16"

endchoice # SysTick clock source

menu "STM32 Peripheral Support"

# These "hidden" settings determine whether a peripheral option is available
# for the selected MCU

config STM32_HAVE_VREFINT
	bool
	default n

config STM32_HAVE_USART4
	bool
	default n

config STM32_HAVE_USART5
	bool
	default n

config STM32_HAVE_USART7
	bool
	default n

config STM32_HAVE_USART8
	bool
	default n

config STM32_HAVE_LPUART2
	bool
	default n

config STM32_HAVE_ADC_OVERSAMPLE
	bool
	default STM32_STM32L0 || STM32_STM32G0 || STM32_STM32C0

config STM32_HAVE_CEC
	bool
	default n

config STM32_HAVE_SDIO
	bool
	default n

config STM32_HAVE_I2S2
	bool
	default n

config STM32_HAVE_UCPD1
	bool
	default n

config STM32_HAVE_UCPD2
	bool
	default n

# These are STM32 peripherals IP blocks

config STM32_HAVE_IP_USART_V1
	bool
	default n

config STM32_HAVE_IP_USART_V2
	bool
	default n

config STM32_HAVE_IP_EXTI_V1
	bool
	default n

config STM32_HAVE_IP_EXTI_V2
	bool
	default n

# These are the peripheral selections proper

config STM32_VREFINT
	bool "Enable VREFINT"
	default n
	depends on STM32_HAVE_VREFINT

config STM32_USART4
	bool "USART4"
	default n
	depends on STM32_HAVE_USART4
	select STM32_USART

config STM32_USART5
	bool "USART5"
	default n
	depends on STM32_HAVE_USART5
	select STM32_USART

config STM32_USART7
	bool "USART7"
	default n
	depends on STM32_HAVE_USART7
	select STM32_USART

config STM32_USART8
	bool "USART8"
	default n
	depends on STM32_HAVE_USART8
	select STM32_USART

endmenu # STM32 Peripheral Support

menu "ADC Configuration"
	depends on STM32_ADC

config STM32_ADC1_CONTINUOUS
	bool "Enable ADC1 Continuous Conversion Mode"
	default n
	depends on STM32_ADC1
	---help---
		If enabled, the ADC will operate in continuous conversion mode.
		Otherwise, it will perform single conversions.
		Note: Continuous and discontinuous mode cannot be defined at
		      the same time

endmenu # ADC Configuration
```
