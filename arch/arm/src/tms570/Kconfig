## arch/ceva/Kconfig
```kconfig
#
# For a description of the syntax of this configuration file,
# see the file kconfig-language.txt in the NuttX tools repository.
#

if ARCH_CEVA
comment "CEVA Options"

config ARCH_XC5
	bool
	default n
	---help---
		CEVA-XC5 is a licensable DSP and memory subsystem (MSS) platform
		designed for advanced wireless communication, with low power and
		flexible architecture support for both legacy and next-generation
		wireless standards.

config ARCH_XM6
	bool
	default n
	select ARCH_HAVE_HARDFAULT_DEBUG
	select ARCH_HAVE_MPU
	select ARCH_HAVE_MULTICPU
	---help---
		CEVA-XM6 is a licensable DSP and memory subsystem (MSS) platform
		targeted for high-performance computer vision and image-processing
		applications that provide very high processing power while
		maintaining a small footprint and low power consumption.

config ARCH_FAMILY
	string
	default "xc5"		if ARCH_XC5
	default "xm6"		if ARCH_XM6

config ARCH_ITCM_SIZE
	int "ITCM Size"

config ARCH_DTCM_SIZE
	int "DTCM Size"

config CEVA_ICACHE
	bool "Use I-Cache"
	default n
	select ARCH_ICACHE

config CEVA_DCACHE
	bool "Use D-Cache"
	default n
	select ARCH_DCACHE

config ARCH_NR_FPUS
	int "FPU Number"
	default 1
	depends on ARCH_HAVE_FPU
	---help---
		Built-in support for the number of Floating Point Unit.
		Check your chip specifications first; not all CEVA chips
		support the FPU.

config ARCH_MPU
	bool "MPU support"
	default n
	depends on ARCH_HAVE_MPU
	select ARCH_USE_MPU
	---help---
		Built-in support for the CEVA Memory Protection Unit (MPU).
		Also used to configure the cache and memory attribute.

config ARCH_HAVE_VINTC
	bool
	default n

config ARCH_HARDFAULT_IRQ
	int "Hard Fault IRQ Number"
	default -1

config ARCH_NR_MEMORY
	int "Memory Block Number"
	default 1

config ARCH_NR_USER_MEMORY
	int "User Memory Block Number"
	depends on BUILD_PROTECTED
	default 1

config ARCH_DEFAULT_HEAP
	int "Default Heap Index"
	default 0

config ARCH_USER_DEFAULT_HEAP
	int "User Default Heap Index"
	depends on BUILD_PROTECTED
	default 0

config ARCH_STACK_HEAP
	int "Stack Heap Index"
	default 0

config ARCH_KERNEL_STACK_HEAP
	int "Kernel Stack Heap Index"
	depends on MM_KERNEL_HEAP
	default 0

config ARCH_RTL_MAJOR
	int "RTL Version Major Number"

config ARCH_RTL_MINOR
	int "RTL Version Minor Number"

config ARCH_RTL_REVISION
	int "RTL Version Revision Number"

config ARCH_HAVE_HARDFAULT_DEBUG
	bool
	default n

config DEBUG_HARDFAULT
	bool "Verbose Hard-Fault Debug"
	default n
	depends on ARCH_HAVE_HARDFAULT_DEBUG && DEBUG_ALERT
	---help---
		Enables verbose debug output when a hard fault occurs.  This verbose
		output is sometimes helpful when debugging difficult hard fault problems,
		but may be more than you typically want to see.

if ARCH_XC5
source arch/ceva/src/xc5/Kconfig
endif
if ARCH_XM6
source arch/ceva/src/xm6/Kconfig
endif

endif # ARCH_CEVA
```

## arch/ceva/src/xc5/Kconfig
```kconfig
#
# For a description of the syntax of this configuration file,
# see the file kconfig-language.txt in the NuttX tools repository.
#

comment "XC5 Configuration Options"

config XC5_PSU_ENABLE
	bool "Enable power management of XC5"
	---help---
		Doze or idle mode of xc5 power managerment.
```

## arch/ceva/src/xm6/Kconfig
```kconfig
#
# For a description of the syntax of this configuration file,
# see the file kconfig-language.txt in the NuttX tools repository.
#

comment "XM6 Configuration Options"

config ARCH_XM6_BUG001
	bool "Enable bug 001 workaround"
	---help---
		Read CEVA-XM6 Bug List for more information
```

## arch/dm320/defconfig
```kconfig
############################################################
# defconfig
#
#   Copyright (C) 2007 Gregory Nutt. All rights reserved.
#   Author: Gregory Nutt <spudmonkey@racsa.co.cr>
#
# Redistribution and use in source and binary forms, with or without
# modification, are permitted provided that the following conditions
# are met:
#
# 1. Redistributions of source code must retain the above copyright
#    notice, this list of conditions and the following disclaimer.
# 2. Redistributions in binary form must reproduce the above copyright
#    notice, this list of conditions and the following disclaimer in
#    the documentation and/or other materials provided with the
#    distribution.
# 3. Neither the name Gregory Nutt nor the names of its contributors may be
#    used to endorse or promote products derived from this software
#    without specific prior written permission.
#
# THIS SOFTWARE IS PROVIDED BY THE COPYRIGHT HOLDERS AND CONTRIBUTORS
# "AS IS" AND ANY EXPRESS OR IMPLIED WARRANTIES, INCLUDING, BUT NOT
# LIMITED TO, THE IMPLIED WARRANTIES OF MERCHANTABILITY AND FITNESS
# FOR A PARTICULAR PURPOSE ARE DISCLAIMED. IN NO EVENT SHALL THE
# COPYRIGHT OWNER OR CONTRIBUTORS BE LIABLE FOR ANY DIRECT, INDIRECT,
# INCIDENTAL, SPECIAL, EXEMPLARY, OR CONSEQUENTIAL DAMAGES (INCLUDING,
# BUT NOT LIMITED TO, PROCUREMENT OF SUBSTITUTE GOODS OR SERVICES; LOSS
# OF USE, DATA, OR PROFITS; OR BUSINESS INTERRUPTION) HOWEVER CAUSED
# AND ON ANY THEORY OF LIABILITY, WHETHER IN CONTRACT, STRICT
# LIABILITY, OR TORT (INCLUDING NEGLIGENCE OR OTHERWISE) ARISING IN
# ANY WAY OUT OF THE USE OF THIS SOFTWARE, EVEN IF ADVISED OF THE
# POSSIBILITY OF SUCH DAMAGE.
#
############################################################
#
# architecture selection
#
# CONFIG_ARCH - identifies the arch subdirectory
# CONFIG_ARCH_name - for use in C code
# CONFIG_ROM_VECTORS - unique to dm320
# CONFIG_DRAM_SIZE - Describes the installed DRAM.
# CONFIG_ARCH_STACKDUMP - Do stack dumps after assertions
#
CONFIG_ARCH=dm320
CONFIG_ARCH_DM320=y
CONFIG_ROM_VECTORS=n
CONFIG_DRAM_SIZE=0x01000000
CONFIG_DRAM_NUTTXENTRY=0x01008000
CONFIG_ARCH_STACKDUMP=y

#
# DM320 specific device driver settings
#
# CONFIG_UARTn_SERIAL_CONSOLE - selects the UARTn for the
#   console and ttys0 (default is the UART0).
# CONFIG_UARTn_RXBUFSIZE - Characters are buffered as received.
#   This specific the size of the receive buffer
# CONFIG_UARTn_TXBUFSIZE - Characters are buffered before
#   being sent.  This specific the size of the transmit buffer
# CONFIG_UARTn_BAUD - The configure BAUD of the UART.  Must be
# CONFIG_UARTn_BITS - The number of bits.  Must be either 7 or 8.
# CONFIG_UARTn_PARTIY - 0=no parity, 1=odd parity, 2=even parity
# CONFIG_UARTn_2STOP - Two stop bits
#
CONFIG_UART0_SERIAL_CONSOLE=y
CONFIG_UART1_SERIAL_CONSOLE=n
CONFIG_UART0_TXBUFSIZE=256
CONFIG_UART1_TXBUFSIZE=256
CONFIG_UART0_RXBUFSIZE=256
CONFIG_UART1_RXBUFSIZE=256
CONFIG_UART0_BAUD=115200
CONFIG_UART1_BAUD=115200
CONFIG_UART0_BITS=8
CONFIG_UART1_BITS=8
CONFIG_UART0_PARITY=0
CONFIG_UART1_PARITY=0
CONFIG_UART0_2STOP=0
CONFIG_UART1_2STOP=0

#
# General OS setup
#
# CONFIG_EXAMPLE - identifies the subdirectory in examples
#   that will be used in the build
# CONFIG_DEBUG - enables built-in debug options
# CONFIG_DEBUG_VERBOSE - enables verbose debug output
# CONFIG_MM_REGIONS - If the architecture includes multiple
#   regions of memory to allocate from, this specifies the
#   number of memory regions that the memory manager must
#   handle and enables the API mm_addregion(start, end);
# CONFIG_HAVE_LOWPUTC - architecture supports low-level, boot
#   time console output
# CONFIG_RR_INTERVAL - The round robin timeslice will be set
#   this number of milliseconds;  Round robin scheduling can
#   be disabled by setting this value to zero.
# CONFIG_SCHED_INSTRUMENTATION - enables instrumentation in 
#   scheduler to monitor system performance
# CONFIG_TASK_NAME_SIZE - Spcifies that maximum size of a
#   task name to save in the TCB.  Useful if scheduler
#   instrumentation is selected.  Set to zero to disable.
# CONFIG_START_YEAR, CONFIG_START_MONTH, CONFIG_START_DAY -
#   Used to initialize the internal time logic.
# CONFIG_JULIAN_TIME - Enables Julian time conversions
# CONFIG_DEV_CONSOLE - Set if architecture-specific logic
#   provides /dev/console.  Enables stdout, stderr, stdin.
#
CONFIG_EXAMPLE=ostest
CONFIG_DEBUG=n
CONFIG_DEBUG_VERBOSE=n
CONFIG_MM_REGIONS=1
CONFIG_ARCH_LOWPUTC=y
CONFIG_RR_INTERVAL=200
CONFIG_SCHED_INSTRUMENTATION=n
CONFIG_TASK_NAME_SIZE=0
CONFIG_START_YEAR=2007
CONFIG_START_MONTH=2
CONFIG_START_DAY=13
CONFIG_JULIAN_TIME=n
CONFIG_DEV_CONSOLE=y

#
# The following can be used to disable categories of
# APIs supported by the OS.  If the compiler supports
# weak functions, then it should not be necessary to
# disable functions unless you want to restrict usage
# of those APIs.
#
# There are certain dependency relationships in these
# features.
#
# o mq_notify logic depends on signals to awaken tasks
#   waiting for queues to become full or empty.
# o pthread_condtimedwait() depends on signals to wake
#   up waiting tasks.
#
CONFIG_DISABLE_CLOCK=n
CONFIG_DISABLE_POSIX_TIMERS=n
CONFIG_DISABLE_PTHREAD=n
CONFIG_DISABLE_SIGNALS=n
CONFIG_DISABLE_MQUEUE=n

#
# Misc libc settings
#
# CONFIG_NOPRINTF_FIELDWIDTH - sprintf-related logic is a
#   little smaller if we do not support fieldwidthes
#
CONFIG_NOPRINTF_FIELDWIDTH=n

#
# Allow for architecture optimized implementations
#
# The architecture can provide optimized versions of the
# following to improve sysem performance
#
CONFIG_ARCH_MEMCPY=n
CONFIG_ARCH_MEMCMP=n
CONFIG_ARCH_MEMMOVE=n
CONFIG_ARCH_MEMSET=n
CONFIG_ARCH_STRCMP=n
CONFIG_ARCH_STRCPY=n
CONFIG_ARCH_STRNCPY=n
CONFIG_ARCH_STRLEN=n
CONFIG_ARCH_BZERO=n
CONFIG_ARCH_KMALLOC=n
CONFIG_ARCH_KZMALLOC=n
CONFIG_ARCH_KFREE=n

#
# General build options
#
# CONFIG_RRLOAD_BINARY - make the rrload binary format used with
#   BSPs from www.ridgerun.com
#
CONFIG_RRLOAD_BINARY=n

#
# Sizes of configurable things (0 disables)
#
# CONFIG_MAX_TASKS - The maximum number of simultaneously
#   active tasks.  This value must be a power of two.
# CONFIG_MAX_TASK_ARGS - This controls the maximum number of
#   of parameters that a task may receive (i.e., maxmum value
#   of 'argc')
# CONFIG_NPTHREAD_KEYS - The number of items of thread-
#   specific data that can be retained
# CONFIG_NFILE_DESCRIPTORS - The maximum number of file
#   descriptors (one for each open)
# CONFIG_NFILE_STREAMS - The maximum number of streams that
#   can be fopen'ed
# CONFIG_NAME_MAX - The maximum size of a file name.
# CONFIG_STDIO_BUFFER_SIZE - Size of the buffer to allocate
#   on fopen. (Only if CONFIG_NFILE_STREAMS > 0)
# CONFIG_NUNGET_CHARS - Number of characters that can be
#   buffered by ungetc() (Only if CONFIG_NFILE_STREAMS > 0)
# CONFIG_PREALLOC_MQ_MSGS - The number of pre-allocated message
#   structures.  The system manages a pool of preallocated
#   message structures to minimize dynamic allocations
# CONFIG_MQ_MAXMSGSIZE - Message structures are allocated with
#   a fixed payload size given by this settin (does not include
#   other message structure overhead.
# CONFIG_MAX_WDOGPARMS - Maximum number of parameters that
#   can be passed to a watchdog handler
# CONFIG_PREALLOC_WDOGS - The number of pre-allocated watchdog
#   structures.  The system manages a pool of preallocated
#   watchdog structures to minimize dynamic allocations
# CONFIG_PREALLOC_TIMERS - The number of pre-allocated POSIX
#   timer structures.  The system manages a pool of preallocated
#   timer structures to minimize dynamic allocations.  Set to
#   zero for all dynamic allocations.
#
CONFIG_MAX_TASKS=64
CONFIG_MAX_TASK_ARGS=4
CONFIG_NPTHREAD_KEYS=4
CONFIG_NFILE_DESCRIPTORS=32
CONFIG_NFILE_STREAMS=16
CONFIG_NAME_MAX=32
CONFIG_STDIO_BUFFER_SIZE=1024
CONFIG_NUNGET_CHARS=2
CONFIG_PREALLOC_MQ_MSGS=32
CONFIG_MQ_MAXMSGSIZE=32
CONFIG_MAX_WDOGPARMS=4
CONFIG_PREALLOC_WDOGS=32
CONFIG_PREALLOC_TIMERS=8

#
# Stack and heap information
#
# CONFIG_BOOT_FROM_FLASH - Some configurations support XIP
#   operation from FLASH.
# CONFIG_CUSTOM_STACK - The up_ implementation will handle
#   all stack operations outside of the nuttx model.
# CONFIG_STACK_POINTER - The initial stack pointer (arm7tdmi only)
# CONFIG_PROC_STACK_SIZE - The size of the initial stack
# CONFIG_PTHREAD_STACK_MIN - Minimum pthread stack size
# CONFIG_PTHREAD_STACK_DEFAULT - Default pthread stack size
# CONFIG_HEAP_BASE - The beginning of the heap
# CONFIG_HEAP_SIZE - The size of the heap
#
CONFIG_BOOT_FROM_FLASH=n
CONFIG_CUSTOM_STACK=n
CONFIG_STACK_POINTER=
CONFIG_PROC_STACK_SIZE=4096
CONFIG_PTHREAD_STACK_MIN=256
CONFIG_PTHREAD_STACK_DEFAULT=4096
CONFIG_HEAP_BASE=
CONFIG_HEAP_SIZE=
```

## arch/hc/Kconfig
```kconfig
#
# For a description of the syntax of this configuration file,
# see the file kconfig-language.txt in the NuttX tools repository.
#

if ARCH_HC

choice
	prompt "HC chip selection"
	default ARCH_CHIP_MCS92S12NEC64

config ARCH_CHIP_MCS92S12NEC64
	bool "MCS92S12NEC64"
	select ARCH_HSC12
	select MM_SMALL
	---help---
		Motorola/Freescale MCS92S12NEC64 (M9S12)

config ARCH_CHIP_HC_CUSTOM
	bool "Custom HC chip"
	select ARCH_CHIP_CUSTOM
	---help---
		Select this option if there is no directory for the chip under arch/hc/src/.

endchoice

config ARCH_HSC12
	bool
	default n

config ARCH_CHIP
	string
	default "m9s12"		if ARCH_CHIP_MCS92S12NEC64

source arch/hc/src/m9s12/Kconfig

endif # ARCH_HC
```

## arch/hc/src/m9s12/Kconfig
```kconfig
#
# For a description of the syntax of this configuration file,
# see the file kconfig-language.txt in the NuttX tools repository.
#

if ARCH_HSC12
comment "M9S12 Configuration Options"

menu "M9S12 Peripheral Selection"

config HCS12_SCI0
	bool "SCI0"
	default n
	select SCI0_SERIALDRIVER

config HCS12_SCI1
	bool "SCI1"
	default n
	select SCI1_SERIALDRIVER

endmenu # M9S12 Peripheral Selection

menu "HSC12 Build Options"

config HCS12_SERIALMON
	bool "Freescale serial bootloader"
	default n
	---help---
		Indicates that the target systems uses the Freescale serial
		bootloader.

config HCS12_NONBANKED
	bool "Non-banked"
	default n
	---help---
		Indicates that the target systems does not support banking.
		Only short calls are made; one fixed page is presented in the
		paging window.  Only 48Kb of FLASH is usable in this configuration:
		pages 3e, 3d, then 3f will appear as a contiguous address space
		in memory.

endmenu # HSC12 Build Options

config HCS12_GPIOIRQ
	bool "GPIO interrupt support"
	default n
	depends on EXPERIMENTAL
	---help---
		Enable support for GPIO interrupts (not implemented)

endif # ARCH_HSC12
```
