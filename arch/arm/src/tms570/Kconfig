## arch/arm64/src/rk3399/Kconfig
```kconfig
#
# For a description of the syntax of this configuration file,
# see the file kconfig-language.txt in the NuttX tools repository.
#

if ARCH_CHIP_RK3399

menu "Rockchip RK3399 Peripheral Selection"

config RK3399_UART
	bool "UART 0"
	default n
	select UART0_SERIALDRIVER
	select ARCH_HAVE_SERIAL_TERMIOS
	---help---
		Select to enable support for UART0.

config RK3399_UART1
	bool "UART 1"
	default n
	select UART1_SERIALDRIVER
	select ARCH_HAVE_SERIAL_TERMIOS
	---help---
		Select to enable support for UART1.

config RK3399_UART2
	bool "UART 2"
	default y
	select UART2_SERIALDRIVER
	select ARCH_HAVE_SERIAL_TERMIOS
	---help---
		Select to enable support for UART2.

config RK3399_UART3
	bool "UART 3"
	default n
	select UART3_SERIALDRIVER
	select ARCH_HAVE_SERIAL_TERMIOS
	---help---
		Select to enable support for UART3.

config RK3399_UART4
	bool "UART 4"
	default n
	select UART4_SERIALDRIVER
	select ARCH_HAVE_SERIAL_TERMIOS
	---help---
		Select to enable support for UART4.

endmenu # Rockchip RK3399 Peripheral Selection

endif # ARCH_CHIP_RK3399
```

## arch/arm64/src/zynq-mpsoc/Kconfig
```kconfig
#
# For a description of the syntax of this configuration file,
# see the file kconfig-language.txt in the NuttX tools repository.
#

if ARCH_CHIP_ZYNQ_MPSOC

config XPAR_CPU_CORTEXA53_0_CPU_CLK_FREQ_HZ
	int "Zynq Mpsoc cpu clock"
	default 1199988037
	---help---
		Canonical definitions for cpu PSU_CORTEXA53_0.
		
config XPAR_CPU_CORTEXA53_0_TIMESTAMP_CLK_FREQ
	int "Zynq Mpsoc peripheral clock"
	default 99999001
	---help---
		Canonical definitions for peripheral PSU_CORTEXA53_0.

menu "XILINX ZYNQ_MPSOC Peripheral Selection"

config ZYNQ_MPSOC_UART0
	bool "UART 0"
	default y
	select UART0_SERIALDRIVER
	select ARCH_HAVE_SERIAL_TERMIOS
	---help---
		Select to enable support for UART0.

config ZYNQ_MPSOC_UART1
	bool "UART 1"
	default n
	select UART1_SERIALDRIVER
	select ARCH_HAVE_SERIAL_TERMIOS
	---help---
		Select to enable support for UART1.

config ZYNQ_ENET
	bool "Ethernet"
	default n
	select ARCH_HAVE_PHY
	select ARCH_HAVE_NETDEV_STATISTICS

endmenu # XILINX ZYNQ_MPSOC Peripheral Selection

menu "Ethernet Configuration"
	depends on ZYNQ_ENET

choice
	prompt "ZYNQ Ethernet Interface"
	default ZYNQ_ENET4
	depends on ZYNQ_ENET

config ZYNQ_ENET1
	bool "ENET 1"

config ZYNQ_ENET2
	bool "ENET 2"

config ZYNQ_ENET3
	bool "ENET 3"

config ZYNQ_ENET4
	bool "ENET 4"

endchoice # ZYNQ Ethernet Interface

config ZYNQ_GMAC_NRXBUFFERS
	int "Number of RX buffers"
	default 16
	range 16 256
	---help---
		GMAC buffer memory is segmented into 128 byte units (not
		configurable).  This setting provides the number of such 128 byte
		units used for reception.  This is also equal to the number of RX
		descriptors that will be allocated. The selected value must be an
		even power of 2.

config ZYNQ_GMAC_NTXBUFFERS
	int "Number of TX buffers"
	default 8
	range 8 256
	---help---
		GMAC buffer memory is segmented into full Ethernet packets (size
		NET_BUFSIZE bytes).  This setting provides the number of such packets
		that can be in flight.  This is also equal to the number of TX
		descriptors that will be allocated.

config ZYNQ_GMAC_RXDMA_BUFSIZE
	int "RX DMA buffer size"
	default 128
	range 64 10240
	---help---
		DMA receive buffer size in external AMBA (AHB/AXI) system memory.
		The value defined by these bits determines the size of buffer to
		use in main system memory when writing received data. The value
		must be defined as multiples of 64 bytes, i.e. 64, 128, 256...

config ZYNQ_GMAC_PREALLOCATE
	bool "Preallocate buffers"
	default n
	---help---
		Buffer and descriptor may either be allocated from the memory
		pool or pre-allocated to lie in .bss.  This option selects pre-
		allocated buffer memory.

config ZYNQ_GMAC_NBC
	bool "No Broadcast"
	default n
	---help---
		when set to logic one, frames addressed to the broadcast address of
		all ones will not be accepted.

config ZYNQ_GMAC_PHYADDR
	int "PHY address"
	default 1
	---help---
		The 5-bit address of the PHY on the board.  Default: 1

config ZYNQ_ENET_PHYINIT
	bool "Board-specific PHY Initialization for ENET"
	default y
	---help---
		Some boards require specialized initialization of the PHY before it
		can be used.  This may include such things as configuring GPIOs,
		resetting the PHY, etc.  If CONFIG_ZYNQ_ENET_PHYINIT is defined in
		the configuration then the board specific logic must provide
		zynq_phy_boardinitialize();  The ZYNQ ENET driver will call this
		function one time before it first uses the PHY.

config ZYNQ_GMAC_AUTONEG
	bool "Use autonegotiation"
	default y
	---help---
		Use PHY autonegotiation to determine speed and mode

if !ZYNQ_GMAC_AUTONEG

config ZYNQ_GMAC_ETHFD
	bool "Full duplex"
	default n
	---help---
		If ZYNQ_GMAC_AUTONEG is not defined, then this may be defined to
		select full duplex mode. Default: half-duplex

choice
	prompt "GMAC Speed"
	default ZYNQ_GMAC_ETH100MBPS
	---help---
		If autonegotiation is not used, then you must select the fixed speed
		of the PHY

config ZYNQ_GMAC_ETH10MBPS
	bool "10 Mbps"
	---help---
		If ZYNQ_GMAC_AUTONEG is not defined, then this may be defined to select 10 MBps
		speed.  Default: 100 Mbps

config ZYNQ_GMAC_ETH100MBPS
	bool "100 Mbps"
	---help---
		If ZYNQ_GMAC_AUTONEG is not defined, then this may be defined to select 100 MBps
		speed.  Default: 100 Mbps

config ZYNQ_GMAC_ETH1000MBPS
	bool "1000 Mbps"
	---help---
		If ZYNQ_GMAC_AUTONEG is not defined, then this may be defined to select 1000 MBps
		speed.  Default: 100 Mbps

endchoice # GMAC speed
endif # !ZYNQ_GMAC_AUTONEG
		
config ZYNQ_GMAC_REGDEBUG
	bool "Register-Level Debug"
	default n
	depends on DEBUG_NET_INFO
	---help---
		Enable very low-level register access debug.  Depends on CONFIG_DEBUG_NET_INFO.

endmenu # ZYNQ_ENET

endif # ARCH_CHIP_ZYNQ_MPSOC
```

## arch/avr/Kconfig
```kconfig
#
# For a description of the syntax of this configuration file,
# see the file kconfig-language.txt in the NuttX tools repository.
#

if ARCH_AVR

choice
	prompt "Atmel AVR chip selection"
	default ARCH_CHIP_AT32UC3

config ARCH_CHIP_ATMEGA
	bool "ATMega family"
	select ARCH_FAMILY_AVR
	select MM_SMALL
	---help---
		Atmel ATMega family of 8-bit AVRs.

config ARCH_CHIP_AT90USB
	bool "AT90USB family"
	select ARCH_FAMILY_AVR
	select MM_SMALL
	---help---
		Atmel AT90USB family of 8-bit AVRs.

config ARCH_CHIP_AVRDX
	bool "AVR 32/64/128 DA/DB core"
	select ARCH_FAMILY_AVR
	select MM_SMALL
	select ARCH_HAVE_TICKLESS
	select AVR_HAVE_FLMAP
	---help---
		Atmel/Microchip AVR 32/64/128 DA/DB core family.

config ARCH_CHIP_AT32UC3
	bool "AVR32 AT32UC3* family"
	select ARCH_FAMILY_AVR32
	---help---
		Atmel AT32UC3A/B/C family of 32-bit AVR32s.

config ARCH_CHIP_AVR_CUSTOM
	bool "Custom AVR chip"
	select ARCH_CHIP_CUSTOM
	---help---
		Select this option if there is no directory for the chip under arch/avr/src/.

endchoice

config ARCH_FAMILY_AVR
	bool
	default n
	select ARCH_HAVE_STACKCHECK
	select ARCH_LDST_16BIT_NOT_ATOMIC

config ARCH_FAMILY_AVR32
	bool
	default n

config ARCH_FAMILY
	string
	default "avr"		if ARCH_FAMILY_AVR
	default "avr32"		if ARCH_FAMILY_AVR32

config ARCH_CHIP
	string
	default "atmega"	if ARCH_CHIP_ATMEGA
	default "avrdx"		if ARCH_CHIP_AVRDX
	default "at90usb"	if ARCH_CHIP_AT90USB
	default "at32uc3"	if ARCH_CHIP_AT32UC3

source "arch/avr/src/common/Kconfig"

if ARCH_FAMILY_AVR
source "arch/avr/src/avr/Kconfig"
source "arch/avr/src/at90usb/Kconfig"
source "arch/avr/src/atmega/Kconfig"
source "arch/avr/src/avrdx/Kconfig"
endif

if ARCH_FAMILY_AVR32
source "arch/avr/src/avr32/Kconfig"
source "arch/avr/src/at32uc3/Kconfig"
endif

endif # ARCH_AVR
```

## arch/avr/src/at32uc3/Kconfig
```kconfig
#
# For a description of the syntax of this configuration file,
# see the file kconfig-language.txt in the NuttX tools repository.
#

if ARCH_CHIP_AT32UC3
comment "AT32U3 Configuration Options"

choice
	prompt "AT32U3 Processor Selection"
	default ARCH_CHIP_AT32UC3B0256

config ARCH_CHIP_AT32UC3B064
	bool "AT32UC3B064"
	select ARCH_CHIP_AT32UC3B
	select ARCH_CHIP_AT32UC3B0

config ARCH_CHIP_AT32UC3B0128
	bool "AT32UC3B0128"
	select ARCH_CHIP_AT32UC3B
	select ARCH_CHIP_AT32UC3B0

config ARCH_CHIP_AT32UC3B0256
	bool "AT32UC3B0256"
	select ARCH_CHIP_AT32UC3B
	select ARCH_CHIP_AT32UC3B0

config ARCH_CHIP_AT32UC3B0512
	bool "AT32UC3B0512"
	select ARCH_CHIP_AT32UC3B
	select ARCH_CHIP_AT32UC3B0

config ARCH_CHIP_AT32UC3B164
	bool "AT32UC3B164"
	select ARCH_CHIP_AT32UC3B
	select ARCH_CHIP_AT32UC3B1

config ARCH_CHIP_AT32UC3B1128
	bool "AT32UC3B1128"
	select ARCH_CHIP_AT32UC3B
	select ARCH_CHIP_AT32UC3B1

config ARCH_CHIP_AT32UC3B1256
	bool "AT32UC3B1256"
	select ARCH_CHIP_AT32UC3B
	select ARCH_CHIP_AT32UC3B1

config ARCH_CHIP_AT32UC3B1512
	bool "AT32UC3B1512"
	select ARCH_CHIP_AT32UC3B
	select ARCH_CHIP_AT32UC3B1

endchoice # AT32U3 Processor Selection

config ARCH_CHIP_AT32UC3A
	bool
	default n

config ARCH_CHIP_AT32UC3B
	bool
	default n

config ARCH_CHIP_AT32UC3B0
	bool
	default n

config ARCH_CHIP_AT32UC3B1
	bool
	default n

menu "AT32U3 Peripheral Selections"

config AVR32_USART0
	bool "USART0"
	default n

config AVR32_USART1
	bool "USART1"
	default n

config AVR32_USART2
	bool "USART2"
	default n
	depends on ARCH_CHIP_AT32UC3B0

endmenu # AT32U3 Peripheral Selections

if AVR32_USART0

choice
	prompt "USART0 Function"
	default AVR32_USART0_RS232

config AVR32_USART0_IRDA
	bool "USART0 is IRDA"

config AVR32_USART0_ISO786
	bool "USART0 is ISO786"

config AVR32_USART0_MAN
	bool "USART0 is Manchester"

config AVR32_USART0_MODEM
	bool "USART0 is Modem"

config AVR32_USART0_RS232
	bool "USART0 is RS-232"
	select USART0_SERIALDRIVER

config AVR32_USART0_RS485
	bool "USART0 is RS-485"

config AVR32_USART0_SPI
	bool "USART0 is SPI"
	select SPI

endchoice # USART0 Function
endif # AVR32_USART0

if AVR32_USART1

choice
	prompt "USART1 Function"
	default AVR32_USART1_RS232

config AVR32_USART1_IRDA
	bool "USART1 is IRDA"

config AVR32_USART1_ISO786
	bool "USART1 is ISO786"

config AVR32_USART1_MAN
	bool "USART1 is Manchester"

config AVR32_USART1_MODEM
	bool "USART1 is Modem"

config AVR32_USART1_RS232
	bool "USART1 is RS-232"
	select USART1_SERIALDRIVER

config AVR32_USART1_RS485
	bool "USART1 is RS-485"

config AVR32_USART1_SPI
	bool "USART1 is SPI"
	select SPI

endchoice # USART1 Function
endif # AVR32_USART1

if AVR32_USART2

choice
	prompt "USART2 Function"
	default AVR32_USART2_RS232

config AVR32_USART2_IRDA
	bool "USART2 is IRDA"

config AVR32_USART2_ISO786
	bool "USART2 is ISO786"

config AVR32_USART2_MAN
	bool "USART2 is Manchester"

config AVR32_USART2_MODEM
	bool "USART2 is Modem"

config AVR32_USART2_RS232
	bool "USART2 is RS-232"
	select USART2_SERIALDRIVER

config AVR32_USART2_RS485
	bool "USART2 is RS-485"

config AVR32_USART2_SPI
	bool "USART2 is SPI"
	select SPI

endchoice # USART2 Function
endif # AVR32_USART2

config AVR32_GPIOIRQ
	bool "GPIO IRQ support"
	default n

if AVR32_GPIOIRQ

config AVR32_GPIOIRQSETA
	hex "GPIO IRQ set A"
	default 0x0

config AVR32_GPIOIRQSETB
	hex "GPIO IRQ set B"
	default 0x0

endif # AVR32_GPIOIRQ
endif # ARCH_CHIP_AT32UC3
```

## arch/avr/src/at90usb/Kconfig
```kconfig
#
# For a description of the syntax of this configuration file,
# see the file kconfig-language.txt in the NuttX tools repository.
#

if ARCH_CHIP_AT90USB
comment "AT90USB Configuration Options"

choice
	prompt "Atmel ATmega chip selection"
	default ARCH_CHIP_AT90USB646

config ARCH_CHIP_AT90USB646
	bool "AT90USB646"
	---help---
		Atmel AT90USB646 8-bit AVR.

config ARCH_CHIP_AT90USB647
	bool "AT90USB647"
	---help---
		Atmel AT90USB647 8-bit AVR.

config ARCH_CHIP_AT90USB1286
	bool "AT90USB1286"
	---help---
		Atmel AT90USB1286 8-bit AVR.

config ARCH_CHIP_AT90USB1287
	bool "AT90USB1287"
	---help---
		Atmel AT90USB1287 8-bit AVR.

endchoice # Atmel ATmega chip selection

menu "AT90USB Peripheral Selections"

config AVR_SPI
	bool "SPI"
	default n

config AVR_USART1
	bool "USART1"
	default n
	select USART1_SERIALDRIVER

config AVR_USBDEV
	bool "USB device"
	default n

config AVR_WDT
	bool "Watchdog"
	default n

endmenu # AT90USB Peripheral Selections

config AVR_GPIOIRQ
	bool "GPIO pin interrupts"
	default n
	---help---
		Enable support for interrupting GPIO pins

endif # ARCH_CHIP_AT90USB
```

## arch/avr/src/atmega/Kconfig
```kconfig
#
# For a description of the syntax of this configuration file,
# see the file kconfig-language.txt in the NuttX tools repository.
#

if ARCH_CHIP_ATMEGA
comment "ATMega Configuration Options"

choice
	prompt "Atmel ATmega chip selection"
	default ARCH_CHIP_ATMEGA128

config ARCH_CHIP_ATMEGA128
	bool "ATMega128"
	---help---
		Atmel ATMega128 8-bit AVR.

config ARCH_CHIP_ATMEGA1284P
	bool "ATMega1284P"
	---help---
		Atmel ATMega1284P 8-bit AVR.

config ARCH_CHIP_ATMEGA2560
	bool "ATMega2560"
	---help---
		Atmel ATMega2560 8-bit AVR.

endchoice # ATMega Configuration Options

menu "ATMega Peripheral Selections"

config AVR_USART0
	bool "USART0"
	select USART0_SERIALDRIVER
	select ARCH_HAVE_SERIAL_TERMIOS

config AVR_USART1
	bool "USART1"
	select USART1_SERIALDRIVER
	select ARCH_HAVE_SERIAL_TERMIOS

endmenu # ATMega Peripheral Selections
endif
```
