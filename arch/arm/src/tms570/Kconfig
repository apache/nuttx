## arch/arm64/src/bcm2711/Kconfig
```kconfig
#
# For a description of the syntax of this configuration file,
# see the file kconfig-language.txt in the NuttX tools repository.
#

if ARCH_CHIP_BCM2711

comment "BCM2711 configuration options"

#####################################################################
# Peripheral selection
#####################################################################

menu "Broadcom BCM2711 Peripheral Selection"

config BCM2711_LOW_PERIPHERAL
	bool "BCM2711 Low Peripheral Mode"
	default y
	---help---
		Use the Broadcom BCM2711 in low peripheral addressing mode.

#####################################################################
# I2C Configuration (master)
#####################################################################

config BCM2711_I2C
	bool "I2C Master"
	select I2C
	---help---
		Support for I2C in master mode.

if BCM2711_I2C

config BCM2711_I2C0
	bool "I2C0"
	default n
	---help---
		Enable the I2C0 interface.
		See board selection menu to configure the pins used by I2C0.

config BCM2711_I2C1
	bool "I2C1"
	default n
	---help---
		Enable the I2C1 interface.
		See board selection menu to configure the pins used by I2C1.

config BCM2711_I2C2
	bool "I2C2"
	default n
	---help---
		Enable the I2C2 interface.
		See board selection menu to configure the pins used by I2C2.

config BCM2711_I2C3
	bool "I2C3"
	default n
	---help---
		Enable the I2C3 interface.
		See board selection menu to configure the pins used by I2C3.

config BCM2711_I2C4
	bool "I2C4"
	default n
	---help---
		Enable the I2C4 interface.
		See board selection menu to configure the pins used by I2C4.

config BCM2711_I2C5
	bool "I2C5"
	default n
	---help---
		Enable the I2C5 interface.
		See board selection menu to configure the pins used by I2C5.

config BCM2711_I2C6
	bool "I2C6"
	default n
	---help---
		Enable the I2C6 interface.
		See board selection menu to configure the pins used by I2C6.

config BCM2711_I2C_DRIVER
	bool "I2C character driver"
	default n
	select I2C_DRIVER
	---help---
		Support for the I2C character driver at /dev/i2c[N]. Can be used
		for I2C bus transfers from application code. This driver is intended
		for testing, not for use in any real driver application.

endif # BCM2711_I2C

#####################################################################
# SPI Configuration
#####################################################################

config BCM2711_SPI
	bool "SPI support"
	select SPI
	---help---
		Support for SPI interfaces.

if BCM2711_SPI

config BCM2711_SPI0
	bool "SPI0"
	depends on BCM2711_SPI
	default n
	---help---
		Enable the SPI0 interface.

if BCM2711_SPI0

config BCM2711_SPI0_CE0
	int "CE0 GPIO"
	depends on BCM2711_SPI0
	default 8
	---help---
		The GPIO pin for the chip enable 0 signal (8, 36, 43)

config BCM2711_SPI0_CE1
	int "CE1 GPIO"
	depends on BCM2711_SPI0
	default 7
	---help---
		The GPIO pin for the chip enable 1 signal (7, 35, 44)

config BCM2711_SPI0_MISO
	int "MISO GPIO"
	depends on BCM2711_SPI0
	default 9
	---help---
		The GPIO pin for the MISO signal (9, 37, 40)

config BCM2711_SPI0_MOSI
	int "MOSI GPIO"
	depends on BCM2711_SPI0
	default 10
	---help---
		The GPIO pin for the MOSI signal (10, 38, 41)

config BCM2711_SPI0_SCLK
	int "SCLK GPIO"
	depends on BCM2711_SPI0
	default 11
	---help---
		The GPIO pin for the SCLK signal (11, 39, 42)

endif

config BCM2711_SPI1
	bool "SPI1"
	depends on BCM2711_SPI
	default n
	---help---
		Enable the SPI1 interface (auxiliary).

config BCM2711_SPI2
	bool "SPI2"
	default n
	---help---
		Enable the SPI2 interface (auxiliary).

config BCM2711_SPI3
	bool "SPI3"
	depends on BCM2711_SPI
	default n
	---help---
		Enable the SPI3 interface.

config BCM2711_SPI4
	bool "SPI4"
	depends on BCM2711_SPI
	default n
	---help---
		Enable the SPI4 interface.

config BCM2711_SPI5
	bool "SPI5"
	depends on BCM2711_SPI
	default n
	---help---
		Enable the SPI5 interface.

config BCM2711_SPI6
	bool "SPI6"
	depends on BCM2711_SPI
	default n
	---help---
		Enable the SPI6 interface.

endif # BCM2711_SPI

endmenu # Broadcom BCM2711 Peripheral Selection

endif # ARCH_CHIP_BCM2711
```

## arch/arm64/src/fvp-v8r/Kconfig
```kconfig
#
# For a description of the syntax of this configuration file,
# see the file kconfig-language.txt in the NuttX tools repository.
#

if ARCH_CHIP_FVP_ARMV8R

menu "FVP ARMv8-R Virt Chip Selection"

choice
	prompt "FVP Core Configuration"
	default ARCH_CHIP_FVP_R82

config ARCH_CHIP_FVP_R82
	bool "FVP virtual Processor (Cortex-r82)"
	select ARCH_HAVE_MULTICPU
	select ARCH_SET_VMPIDR_EL2

endchoice # FVP Chip Selection

endmenu # "FVP Chip Selection"

#####################################################################
#  UART Configuration
#####################################################################

menu "FVP ARMv8-R Peripheral Selection"

config FVP_ARMV8R_UART0
	bool "UART0"
	default n
	select UART_PL011
	select UART0_SERIALDRIVER
	select ARCH_HAVE_SERIAL_TERMIOS
	---help---
		Select to enable support for UART0.

config FVP_ARMV8R_UART1
	bool "UART1"
	default y
	select UART_PL011
	select UART1_SERIALDRIVER
	select ARCH_HAVE_SERIAL_TERMIOS
	---help---
		Select to enable support for UART1.

config FVP_ARMV8R_UART2
	bool "UART2"
	default n
	select UART_PL011
	select UART2_SERIALDRIVER
	select ARCH_HAVE_SERIAL_TERMIOS
	---help---
		Select to enable support for UART2.

config FVP_ARMV8R_UART3
	bool "UART3"
	default n
	select UART_PL011
	select UART3_SERIALDRIVER
	select ARCH_HAVE_SERIAL_TERMIOS
	---help---
		Select to enable support for UART3.

endmenu # FVP ARMv8-R Peripheral Selection

endif # ARCH_CHIP_FVP_ARMV8R
```

## arch/arm64/src/goldfish/Kconfig
```kconfig
#
# For a description of the syntax of this configuration file,
# see the file kconfig-language.txt in the NuttX tools repository.
#

if ARCH_CHIP_GOLDFISH

config GOLDFISH_RTC_PL031_BASE
	hex "GOLDFISH RTC PL031 BASE"
	default 0x09010000
	depends on RTC_PL031

config GOLDFISH_RTC_PL031_IRQ
	hex "GOLDFISH RTC PL031 IRQ"
	default 0x22
	depends on RTC_PL031

endif # ARCH_CHIP_GOLDFISH
```

## arch/arm64/src/imx8/Kconfig
```kconfig
#
# For a description of the syntax of this configuration file,
# see the file kconfig-language.txt in the NuttX tools repository.
#

if ARCH_CHIP_IMX8

menu "i.MX8 Chip Selection"

choice
	prompt "i.MX8 Core Configuration"
	default ARCH_CHIP_IMX8_QUADMAX

config ARCH_CHIP_IMX8_QUADMAX
	bool "i.MX8 QuadMax Application Processor"
	select ARCH_HAVE_MULTICPU
	select ARMV8A_HAVE_GICv3
	select ARCH_CORTEX_A53

endchoice # i.MX8 Chip Selection

endmenu # "i.MX8 Chip Selection"

menu "i.MX8 Peripheral Selection"
config IMX8_UART1
	bool "UART1"
	default n
	select UART1_SERIALDRIVER
endmenu # iMX Peripheral Selection

endif # ARCH_CHIP_IMX8
```
