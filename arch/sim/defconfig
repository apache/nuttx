## arch/sim/defconfig
```kconfig
############################################################
# defconfig
#
#   Copyright (C) 2007 Gregory Nutt. All rights reserved.
#   Author: Gregory Nutt <spudmonkey@racsa.co.cr>
#
# Redistribution and use in source and binary forms, with or without
# modification, are permitted provided that the following conditions
# are met:
#
# 1. Redistributions of source code must retain the above copyright
#    notice, this list of conditions and the following disclaimer.
# 2. Redistributions in binary form must reproduce the above copyright
#    notice, this list of conditions and the following disclaimer in
#    the documentation and/or other materials provided with the
#    distribution.
# 3. Neither the name Gregory Nutt nor the names of its contributors may be
#    used to endorse or promote products derived from this software
#    without specific prior written permission.
#
# THIS SOFTWARE IS PROVIDED BY THE COPYRIGHT HOLDERS AND CONTRIBUTORS
# "AS IS" AND ANY EXPRESS OR IMPLIED WARRANTIES, INCLUDING, BUT NOT
# LIMITED TO, THE IMPLIED WARRANTIES OF MERCHANTABILITY AND FITNESS
# FOR A PARTICULAR PURPOSE ARE DISCLAIMED. IN NO EVENT SHALL THE
# COPYRIGHT OWNER OR CONTRIBUTORS BE LIABLE FOR ANY DIRECT, INDIRECT,
# INCIDENTAL, SPECIAL, EXEMPLARY, OR CONSEQUENTIAL DAMAGES (INCLUDING,
# BUT NOT LIMITED TO, PROCUREMENT OF SUBSTITUTE GOODS OR SERVICES; LOSS
# OF USE, DATA, OR PROFITS; OR BUSINESS INTERRUPTION) HOWEVER CAUSED
# AND ON ANY THEORY OF LIABILITY, WHETHER IN CONTRACT, STRICT
# LIABILITY, OR TORT (INCLUDING NEGLIGENCE OR OTHERWISE) ARISING IN
# ANY WAY OUT OF THE USE OF THIS SOFTWARE, EVEN IF ADVISED OF THE
# POSSIBILITY OF SUCH DAMAGE.
#
############################################################
#
# architecture selection
#
# CONFIG_ARCH - identifies the arch subdirectory
# CONFIG_ARCH_name - for use in C code
#
CONFIG_ARCH=sim
CONFIG_ARCH_SIM=y

#
# General OS setup
#
# CONFIG_EXAMPLE - identifies the subdirectgory in examples
#   that will be used in the build
# CONFIG_DEBUG - enables built-in debug options
# CONFIG_DEBUG_VERBOSE - enables verbose debug output
# CONFIG_HAVE_LOWPUTC - architecture supports low-level, boot
#   time console output
# CONFIG_RR_INTERVAL - The round robin timeslice will be set
#   this number of milliseconds;  Round robin scheduling can
#   be disabled by setting this value to zero.
# CONFIG_SCHED_INSTRUMENTATION - enables instrumentation in 
#   scheduler to monitor system performance
# CONFIG_TASK_NAME_SIZE - Spcifies that maximum size of a
#   task name to save in the TCB.  Useful if scheduler
#   instrumentation is selected.  Set to zero to disable.
# CONFIG_JULIAN_TIME - Enables Julian time conversions
# CONFIG_START_YEAR, CONFIG_START_MONTH, CONFIG_START_DAY -
#   Used to initialize the internal time logic.
# CONFIG_DEV_CONSOLE - Set if architecture-specific logic
#   provides /dev/console.  Enables stdout, stderr, stdin.
#
CONFIG_EXAMPLE=ostest
CONFIG_DEBUG=y
CONFIG_DEBUG_VERBOSE=y
CONFIG_ARCH_LOWPUTC=y
CONFIG_RR_INTERVAL=200
CONFIG_SCHED_INSTRUMENTATION=n
CONFIG_TASK_NAME_SIZE=32
CONFIG_START_YEAR=2007
CONFIG_START_MONTH=2
CONFIG_START_DAY=13
CONFIG_JULIAN_TIME=n
CONFIG_DEV_CONSOLE=y

#
# Allow for artchitecture optimized implementations
#
# The architecture can provide optimized versions of the
# following to improve sysem performance
#
CONFIG_ARCH_MEMCPY=n
CONFIG_ARCH_MEMCMP=n
CONFIG_ARCH_MEMMOVE=n
CONFIG_ARCH_MEMSET=n
CONFIG_ARCH_STRCMP=n
CONFIG_ARCH_STRCPY=n
CONFIG_ARCH_STRNCPY=n
CONFIG_ARCH_STRLEN=n
CONFIG_ARCH_BZERO=n
CONFIG_ARCH_KMALLOC=n
CONFIG_ARCH_KZMALLOC=n
CONFIG_ARCH_KFREE=n

#
# General Compile environment setup
#
# CONFIG_HAVE_INLINE - enable if your compiler supports
#   inline functions
# CONFIG_HAVE_DOUBLE - enable if your compiler supports type
#   double.
# CONFIG_HAVE_LONG_LONG - enable if your architecture supports
#   long long types and if you plan to use them
# CONFIG_CAN_PASS_STRUCTS - enable if your compiler supports
#   passing structures and unions as values
#
CONFIG_HAVE_INLINE=y
CONFIG_HAVE_DOUBLE=y
CONFIG_HAVE_LONG_LONG=n
CONFIG_CAN_PASS_STRUCTS=y

#
# General build options
#
# CONFIG_RRLOAD_BINY - make the rrload binary format used with
#   BSPs from www.ridgerun.com
CONFIG_RRLOAD_BINARY=n

#
# Sizes of configurable things (0 disables)
#
# CONFIG_NPTHREAD_KEYS - The number of items of thread-
#   specific data that can be retained
# CONFIG_NFILE_DESCRIPTORS - The maximum number of file
#   descriptors (one for each open)
# CONFIG_NFILE_STREAMS - The maximum number of streams that
#   can be fopen'ed
# CONFIG_STDIO_BUFFER_SIZE - Size of the buffer to allocate
#   on fopen. (Only if CONFIG_NFILE_STREAMS > 0)
# CONFIG_NUNGET_CHARS - Number of characters that can be
#   buffered by ungetc() (Only if CONFIG_NFILE_STREAMS > 0)
# CONFIG_PREALLOC_MQ_MSGS - The number of pre-allocated message
#   structures.  The system manages a pool of preallocated
#   message structures to minimize dynamic allocations
# CONFIG_MQ_MAXMSGSIZE - Message structures are allocated with
#   a fixed payload size given by this settin (does not include
#   other message structure overhead.
# CONFIG_PREALLOC_WDOGS - The number of pre-allocated watchdog
#   structures.  The system manages a pool of preallocated
#   watchdog structures to minimize dynamic allocations
#
CONFIG_NPTHREAD_KEYS=4
CONFIG_NFILE_DESCRIPTORS=32
CONFIG_NFILE_STREAMS=16
CONFIG_STDIO_BUFFER_SIZE=1024
CONFIG_NUNGET_CHARS=2
CONFIG_PREALLOC_MQ_MSGS=32
CONFIG_MQ_MAXMSGSIZE=32
CONFIG_PREALLOC_WDOGS=32

#
# Stack and heap information
#
# CONFIG_BOOT_FROM_FLASH - Some configurations support XIP
#   operation from FLASH.
# CONFIG_STACK_POINTER - The initial stack pointer
# CONFIG_PROC_STACK_SIZE - The size of the initial stack
# CONFIG_PTHREAD_STACK_MIN - Minimum pthread stack size
# CONFIG_PTHREAD_STACK_DEFAULT - Default pthread stack size
# CONFIG_HEAP_BASE - The beginning of the heap
# CONFIG_HEAP_SIZE - The size of the heap
#
CONFIG_BOOT_FROM_FLASH=n
CONFIG_PROC_STACK_SIZE=0x00001000
CONFIG_PTHREAD_STACK_MIN=256
CONFIG_PTHREAD_STACK_DEFAULT=8192
CONFIG_HEAP_BASE=
CONFIG_HEAP_SIZE=
```

## arch/sparc/Kconfig
```kconfig
#
# For a description of the syntax of this configuration file,
# see the file kconfig-language.txt in the NuttX tools repository.
#

if ARCH_SPARC
choice
	prompt "SPARC chip selection"
	default ARCH_CHIP_BM3803

config ARCH_CHIP_BM3803
	bool "BM3803"
	select ARCH_SPARC_V8
	select ARCH_HAVE_MATH_H
	select ARCH_HAVE_RESET
	select ARCH_HAVE_IRQPRIO
	select ARCH_VECNOTIRQ
	select ARCH_HAVE_RAMFUNCS
	select ARCH_HAVE_TICKLESS
	select ARCH_HAVE_SERIAL_TERMIOS
	---help---
		Microchip BM3803 (ARCH_SPARC_V8)

config ARCH_CHIP_BM3823
	bool "BM3823"
	select ARCH_SPARC_V8
	select ARCH_HAVE_MATH_H
	select ARCH_HAVE_IRQPRIO
	select ARCH_VECNOTIRQ
	select ARCH_HAVE_RAMFUNCS
	select ARCH_HAVE_SERIAL_TERMIOS
	---help---
		Microchip BM3823 (ARCH_SPARC_V8)

endchoice

config ARCH_SPARC_V8
	bool
	default n
	select ARCH_HAVE_STACKCHECK

config ARCH_FAMILY
	string
	default "sparc_v8"	if ARCH_SPARC_V8

config ARCH_CHIP
	string
	default "bm3803"	if ARCH_CHIP_BM3803
	default "bm3823"	if ARCH_CHIP_BM3823

source arch/sparc/src/sparc_v8/Kconfig
source arch/sparc/src/bm3803/Kconfig
source arch/sparc/src/bm3823/Kconfig

endif
```

## arch/sparc/src/bm3803/Kconfig
```kconfig
#
# For a description of the syntax of this configuration file,
# see the file kconfig-language.txt in the NuttX tools repository.
#

if ARCH_CHIP_BM3803
comment "BM3803 Configuration Options"

menu "BM3803 Peripheral Support"

config BM3803_WDG
	bool "Watchdog timer (WDT)"
	default n
	select WATCHDOG

config BM3803_TIM1
	bool "Timer 1 (T1)"
	default n

config BM3803_TIM2
	bool "Timer 2 (T2)"
	default n

config BM3803_UART1
	bool "UART1"
	default n
	select UART1_SERIALDRIVER
	select ARCH_HAVE_SERIAL_TERMIOS

config BM3803_UART2
	bool "UART2"
	default n
	select UART2_SERIALDRIVER
	select ARCH_HAVE_SERIAL_TERMIOS

config BM3803_UART3
	bool "UART3"
	default n
	select UART3_SERIALDRIVER
	select ARCH_HAVE_SERIAL_TERMIOS

endmenu # BM3803 Peripheral Selections

menuconfig BM3803_GPIOIRQ
	bool "GPIO Interrupt Support"
	default n
	---help---
		Build in support for interrupts based on GPIO inputs from IOPorts

if BM3803_GPIOIRQ

config BM3803_GPIOIRQ_PORT4
	bool "I/O PORT4 Interrupt Support"
	default n

config BM3803_GPIOIRQ_PORT5
	bool "I/O PORT5 Interrupt Support"
	default n

config BM3803_GPIOIRQ_PORT6
	bool "I/O PORT6 Interrupt Support"
	default n
config BM3803_GPIOIRQ_PORT7
	bool "I/O PORT7 Interrupt Support"
	default n

endif # BM3803_GPIOIRQ

menu "Timer Configuration"

if SCHED_TICKLESS

config BM3803_ONESHOT
	bool
	default y

config BM3803_FREERUN
	bool
	default y

config BM3803_TICKLESS_ONESHOT
	int "Tickless one-shot timer channel"
	default 1
	range 1 2
	depends on BM3803_ONESHOT
	---help---
		If the Tickless OS feature is enabled, then one clock must be
		assigned to provide the one-shot timer needed by the OS.

config BM3803_TICKLESS_FREERUN
	int "Tickless free-running timer channel"
	default 2
	range 1 2
	depends on BM3803_FREERUN
	---help---
		If the Tickless OS feature is enabled, then one clock must be
		assigned to provide the free-running timer needed by the OS.

endif # SCHED_TICKLESS

if !SCHED_TICKLESS

config BM3803_ONESHOT
	bool "TIM one-shot wrapper"
	default n
	---help---
		Enable a wrapper around the low level timer/counter functions to
		support one-shot timer.

config BM3803_FREERUN
	bool "TIM free-running wrapper"
	default n
	---help---
		Enable a wrapper around the low level timer/counter functions to
		support a free-running timer.

endif # !SCHED_TICKLESS

endmenu # Timer Configuration

endif
```

## arch/sparc/src/bm3823/Kconfig
```kconfig
#
# For a description of the syntax of this configuration file,
# see the file kconfig-language.txt in the NuttX tools repository.
#

if ARCH_CHIP_BM3823
comment "BM3823 Configuration Options"

menu "BM3823 Peripheral Support"

config BM3823_WDT
	bool "Watchdog timer (WDT)"
	default n

config BM3823_T1
	bool "Timer 1 (T1)"
	default n

config BM3823_T2
	bool "Timer 2 (T2)"
	default n

config BM3823_UART1
	bool "UART1"
	default n
	select UART1_SERIALDRIVER
	select ARCH_HAVE_SERIAL_TERMIOS

config BM3823_UART2
	bool "UART2"
	default n
	select UART2_SERIALDRIVER
	select ARCH_HAVE_SERIAL_TERMIOS

config BM3823_UART3
	bool "UART3"
	default n
	select UART3_SERIALDRIVER
	select ARCH_HAVE_SERIAL_TERMIOS

endmenu # BM3823 Peripheral Selections
endif
```

## arch/sparc/src/s698pm/Kconfig
```kconfig
#
# For a description of the syntax of this configuration file,
# see the file kconfig-language.txt in the NuttX tools repository.
#

if ARCH_CHIP_S698PM
comment "S698PM Configuration Options"

menu "S698PM Peripheral Support"

config S698PM_WDG
	bool "Watchdog timer (WDT)"
	default n
	select WATCHDOG

config S698PM_TIM1
	bool "Timer 1 (T1)"
	default n

config S698PM_TIM2
	bool "Timer 2 (T2)"
	default n

config S698PM_TIM3
	bool "Timer 3 (T3)"
	default n

config S698PM_TIM4
	bool "Timer 4 (T4)"
	default n

config S698PM_UART1
	bool "UART1"
	default n
	select UART1_SERIALDRIVER
	select ARCH_HAVE_SERIAL_TERMIOS

config S698PM_UART2
	bool "UART2"
	default n
	select UART2_SERIALDRIVER
	select ARCH_HAVE_SERIAL_TERMIOS

config S698PM_UART3
	bool "UART3"
	default n
	select UART3_SERIALDRIVER
	select ARCH_HAVE_SERIAL_TERMIOS

config S698PM_UART4
	bool "UART4"
	default n
	select UART4_SERIALDRIVER
	select ARCH_HAVE_SERIAL_TERMIOS

endmenu # S698PM Peripheral Selections

menuconfig S698PM_GPIOIRQ
	bool "GPIO Interrupt Support"
	default n
	---help---
		Build in support for interrupts based on GPIO inputs from IOPorts

if S698PM_GPIOIRQ

config S698PM_GPIOIRQ_PORT4
	bool "I/O PORT4 Interrupt Support"
	default n

config S698PM_GPIOIRQ_PORT5
	bool "I/O PORT5 Interrupt Support"
	default n

config S698PM_GPIOIRQ_PORT6
	bool "I/O PORT6 Interrupt Support"
	default n
config S698PM_GPIOIRQ_PORT7
	bool "I/O PORT7 Interrupt Support"
	default n

endif # S698PM_GPIOIRQ

menu "Timer Configuration"

if SCHED_TICKLESS

config S698PM_ONESHOT
	bool
	default y

config S698PM_FREERUN
	bool
	default y

config S698PM_TICKLESS_ONESHOT
	int "Tickless one-shot timer channel"
	default 1
	range 1 2
	depends on S698PM_ONESHOT
	---help---
		If the Tickless OS feature is enabled, then one clock must be
		assigned to provide the one-shot timer needed by the OS.

config S698PM_TICKLESS_FREERUN
	int "Tickless free-running timer channel"
	default 2
	range 1 2
	depends on S698PM_FREERUN
	---help---
		If the Tickless OS feature is enabled, then one clock must be
		assigned to provide the free-running timer needed by the OS.

endif # SCHED_TICKLESS

if !SCHED_TICKLESS

config S698PM_ONESHOT
	bool "TIM one-shot wrapper"
	default n
	---help---
		Enable a wrapper around the low level timer/counter functions to
		support one-shot timer.

config S698PM_FREERUN
	bool "TIM free-running wrapper"
	default n
	---help---
		Enable a wrapper around the low level timer/counter functions to
		support a free-running timer.

endif # !SCHED_TICKLESS

endmenu # Timer Configuration

endif
```

## arch/sparc/src/sparc_v8/Kconfig
```kconfig
#
# For a description of the syntax of this configuration file,
# see the file kconfig-language.txt in the NuttX tools repository.
#

if ARCH_SPARC_V8
comment "SPARC Configuration Options"

choice
	prompt "Toolchain"
	default SPARC_TOOLCHAIN_CODEREDW if TOOLCHAIN_WINDOWS
	default SPARC_TOOLCHAIN_BUILDROOT if !TOOLCHAIN_WINDOWS

config SPARC_TOOLCHAIN_BUILDROOT
	bool "Buildroot (Cygwin or Linux)"
	depends on !WINDOWS_NATIVE
	select ARCH_TOOLCHAIN_GNU
	---help---
		There is a buildroot version for the SPARC boards here:
		https://www.gaisler.com/anonftp/bcc/bin/linux/. See
		the following section for details on building this toolchain.

config SPARC_TOOLCHAIN_CODEREDW
	bool "CodeRed for Windows"
	depends on TOOLCHAIN_WINDOWS
	select ARCH_TOOLCHAIN_GNU
	---help---
		none.
endchoice # Toolchain

endif # ARCH_FAMILY_SPARC
```

## arch/tricore/src/tc3x/Kconfig
```kconfig
#
# For a description of the syntax of this configuration file,
# see the file kconfig-language.txt in the NuttX tools repository.
#

comment "Infineon AURIX TC3X Chip"

choice
	prompt "Infineon AURIX TC3X Chip selection"
	default TC3X_CHIP_TC375

config TC3X_CHIP_TC375
	bool "TC375 SoC"
	---help---
		Infineon AURIX TC375.

endchoice
```

## arch/tricore/src/tc4x/Kconfig
```kconfig
#
# For a description of the syntax of this configuration file,
# see the file kconfig-language.txt in the NuttX tools repository.
#

comment "Infineon AURIX TC4X Chip"

choice
	prompt "Infineon AURIX TC4X Chip selection"
	default TC4X_CHIP_TC4D7

config TC4X_CHIP_TC4D7
	bool "TC4D7 SoC"
	---help---
		Infineon AURIX TC4D7.

endchoice
```
