## arch/x86/Kconfig
```kconfig
#
# For a description of the syntax of this configuration file,
# see the file kconfig-language.txt in the NuttX tools repository.
#

if ARCH_X86
comment "x86 Configuration Options"

choice
	prompt "x86 chip selection"
	default ARCH_I486

config ARCH_I486
	bool "i486"
	select ARCH_X86_HAVE_32BIT
	---help---
		Intel i486 architecture

config ARCH_CHIP_X86_CUSTOM
	bool "Custom x86 chip"
	select ARCH_CHIP_CUSTOM
	---help---
		Select this option if there is no directory for the chip under arch/x86/src/.

endchoice

config ARCH_CHIP_QEMU
	bool "Qemu x86 emulation"
	default n
	---help---
		Intel i486 architecture

config ARCH_CHIP
	string
	default "qemu" if ARCH_CHIP_QEMU

config ARCH_X86_HAVE_32BIT
	bool
	default n

config ARCH_X86_M32
	bool "Build 32-bit system with a 64-bit machine"
	default n
	depends on ARCH_X86_HAVE_32BIT
	---help---
		If you are building for a 32-bit target using a native 64-bit
		toolchain, then you need to add compilation options to select the
		32-bit target.  Selecting this option will add the -m32 option to
		the compiler command line.

source arch/x86/src/common/Kconfig
if ARCH_I486
source arch/x86/src/i486/Kconfig
endif # ARCH_I486
if ARCH_CHIP_QEMU
source arch/x86/src/qemu/Kconfig
endif # ARCH_CHIP_QEMU
endif # ARCH_X86
```

## arch/x86/src/qemu/Kconfig
```kconfig
#
# For a description of the syntax of this configuration file,
# see the file kconfig-language.txt in the NuttX tools repository.
#

if ARCH_CHIP_QEMU
comment "QEMU Configuration Options"

config QEMU_KEYPAD
	bool "QEMU Keypad"
	default n
	---help---
		Enable support for the QEMU keypad.  See qemu_keypad.h for
		interfaces.

config QEMU_VGA
	bool "QEMU VGA"
	default n
	---help---
		Enable support for the QEMU VGA.  See qemu_vga.h for interfaces.

		NOTE:  This VGA driver exports a character driver that can be used
		to write into the VGA framebuffer. It does *NOT* support a NuttX
		framebuffer interfaces and, hence, cannot be used with the NuttX
		graphics subsystem.  Such a conversion to the standard NuttX
		framebuffer interface would, however, not be a big job.

config QEMU_GPIOIRQ
	bool "GPIO interrupt support"
	default n
	depends on EXPERIMENTAL
	---help---
		Enable support for GPIO interrupts (not implemented)

endif
```

## arch/x86_64/Kconfig
```kconfig
#
# For a description of the syntax of this configuration file,
# see the file kconfig-language.txt in the NuttX tools repository.
#

if ARCH_X86_64
comment "x86_64 Configuration Options"

config ARCH
	string
	default "x86_64"

choice
	prompt "x86_64 arch selection"
	default ARCH_INTEL64

config ARCH_INTEL64
	bool "Intel x86_64"
	select ARCH_HAVE_MMU
	select ARCH_USE_MMU
	select ARCH_HAVE_ADDRENV
	select ARCH_NEED_ADDRENV_MAPPING
	select ARCH_HAVE_TICKLESS
	select ARCH_HAVE_STACKCHECK
	select ARCH_HAVE_RNG
	select ARCH_HAVE_RESET
	select ARCH_HAVE_MMX
	select ARCH_HAVE_SSE
	select ARCH_HAVE_SSE2
	select ARCH_HAVE_SSE3
	select ARCH_HAVE_SSSE3
	select ARCH_HAVE_SSE41
	select ARCH_HAVE_SSE42
	select ARCH_HAVE_SSE4A
	select ARCH_HAVE_FMA if ARCH_X86_64_HAVE_XSAVE
	select ARCH_HAVE_AVX if ARCH_X86_64_HAVE_XSAVE
	select ARCH_HAVE_AVX512 if ARCH_X86_64_HAVE_XSAVE
	select ARCH_ICACHE
	select ARCH_DCACHE
	select ARCH_HAVE_IRQTRIGGER
	---help---
		Intel x86_64 architecture

config ARCH_CHIP_X86_64_CUSTOM
	bool "Custom x86_64 chip"
	select ARCH_CHIP_CUSTOM
	---help---
		Select this option if there is no directory for the chip under arch/x86_64/src/.

endchoice

if SCHED_BACKTRACE
choice
	prompt "Choose x86_64 unwinder"
	default X86_64_UNWINDER_FRAME_POINTER
	---help---
		This determines which method will be used for unwinding nuttx stack
		traces for debug.

config X86_64_UNWINDER_FRAME_POINTER
	bool "Frame pointer unwinder"
	select FRAME_POINTER
	---help---
		This option enables the frame pointer unwinder for unwinding
		nuttx stack traces.

endchoice # Choose x86_64 unwinder
endif

# CPU features

config ARCH_HAVE_MMX
	bool
	default n

config ARCH_HAVE_SSE
	bool
	default y

config ARCH_HAVE_SSE2
	bool
	default y

config ARCH_HAVE_SSE3
	bool
	default n

config ARCH_HAVE_SSSE3
	bool
	default n

config ARCH_HAVE_SSE41
	bool
	default n

config ARCH_HAVE_SSE42
	bool
	default n

config ARCH_HAVE_SSE4A
	bool
	default n

config ARCH_HAVE_FMA
	bool
	default n

config ARCH_HAVE_AVX
	bool
	default n

config ARCH_HAVE_AVX512
	bool
	default n

source "arch/x86_64/src/common/Kconfig"

if ARCH_INTEL64
source "arch/x86_64/src/intel64/Kconfig"

config ARCH_CHIP
	string
	default "intel64"

endif # ARCH_INTEL64

config ARCH_MULTIBOOT1
	bool "Enable ELF32/Multiboot1"
	default n
	---help---
		This enables generating `nuttx32` and allows x86 QEMU
		`-kernel` boot in multiboot1 protocol.

config ARCH_MULTIBOOT2
	bool "Append multiboot2 header"
	default y
	---help---
		Include a multiboot2 header.  This also provides information to the
		system to enable certain features like the low level framebuffer.

if ARCH_MULTIBOOT2

config MULTBOOT2_FB_TERM
	bool "Multiboot2 framebuffer terminal"
	default n
	depends on NXFONTS
	---help---
		Enable a framebuffer terminal for early debug printing

config MULTBOOT2_FB
	bool "Multiboot2 framebuffer"
	default n
	---help---
		Enable a framebuffer support

if MULTBOOT2_FB

config MULTBOOT2_FB_WIDTH
	int "Multiboot2 framebuffer width"
	default 1024
	---help---
		Requested framebuffer width

config MULTBOOT2_FB_HEIGHT
	int "Multiboot2 framebuffer height"
	default 768
	---help---
		Requested framebuffer height

config MULTBOOT2_FB_DEEPTH
	int "Multiboot2 framebuffer deepth"
	default 32
	---help---
		Requested framebuffer deepth

endif # MULTBOOT2_FB

endif # ARCH_MULTIBOOT2

config ARCH_PVHBOOT
	bool "Append Xen PVH ELF Note"
	default y
	---help---
		This allows x86 QEMU `-kernel` boot in PVH protocol.

endif # ARCH_X86_64
```

## arch/x86_64/src/common/Kconfig
```kconfig
#
# For a description of the syntax of this configuration file,
# see the file kconfig-language.txt in the NuttX tools repository.
#

if ARCH_X86_64
comment "Common Configuration Options"

config ARCH_X86_64_PGPOOL_SIZE
	int "Page pool size"
	depends on !ARCH_PGPOOL_MAPPING && MM_PGALLOC
	default 8192000
	---help---
		Page pool size if ARCH_PGPOOL_MAPPING is not enabled

config ARCH_X86_64_ACPI
	bool "ACPI support"
	default y
	---help---
		Select to enable ACPI parser.

if ARCH_X86_64_ACPI

config ARCH_X86_64_ACPI_DUMP
	bool "ACPI dump"
	default DEBUG_FEATURES
	---help---
		Select to dump ACPI tables.

config ARCH_X86_64_ACPI_BIOS
	bool "Look for ACPI RSDP in BIOS legacy region"
	default y
	---help---
		Look for RSDP in BIOS legacy region (0x000e0000-0x000fffff).

endif # ARCH_X86_64_ACPI

choice
	prompt "x86_64 Idle Loop Options"
	default ARCH_X86_64_IDLE_DEFAULT

config ARCH_X86_64_IDLE_DEFAULT
	bool "Idle Loop - HLT"
	---help---
		Use HLT instruction in IDLE loop.

config ARCH_X86_64_IDLE_NOP
	bool "Idle Loop - NOP"
	---help---
		Use NOP instruction in IDLE loop.
		This can prevent VM exit in some virtualized environments,
		thereby improving real-time performance.

config ARCH_X86_64_IDLE_MWAIT
	bool "Idle Loop - MWAIT"
	---help---
		Use MONITOR/MWAIT instruction in IDLE loop.

endchoice # x86_64 Idle Loop Options

config ARCH_X86_64_IDLE_MWAIT_ECX
	hex "Idle MWAIT ECX value"
	default 0x0
	range 0x0 0xF
	depends on ARCH_X86_64_IDLE_MWAIT
	---help---
		MWAIT ECX indicates the C-States
		(0x0 for C1, 0x1 for C1E and so on).

config ARCH_X86_64_HAVE_XSAVE
	bool "XSAVE support"
	default y
	---help---
		Select to enable the use of XSAVE and FPU/SSE/AVX functions
		of x86_64

config ARCH_X86_64_MMX
	bool "MMX support"
	depends on ARCH_HAVE_MMX
	default y

config ARCH_X86_64_SSE
	bool "SSE support"
	depends on ARCH_HAVE_SSE
	default y

config ARCH_X86_64_SSE2
	bool "SSE2 support"
	depends on ARCH_HAVE_SSE2
	default y

config ARCH_X86_64_SSE3
	bool "SSE3 support"
	depends on ARCH_HAVE_SSE3
	default n

config ARCH_X86_64_SSSE3
	bool "SSSE3 support"
	depends on ARCH_HAVE_SSSE3
	default n

config ARCH_X86_64_SSE41
	bool "SSE41 support"
	depends on ARCH_HAVE_SSE41
	default n

config ARCH_X86_64_SSE42
	bool "SSE42 support"
	depends on ARCH_HAVE_SSE42
	default n

config ARCH_X86_64_SSE4A
	bool "SSE4A support"
	depends on ARCH_HAVE_SSE4A
	default n

config ARCH_X86_64_FMA
	bool "FMA support"
	depends on ARCH_HAVE_FMA && ARCH_X86_64_AVX
	default n

config ARCH_X86_64_AVX
	bool "AVX support"
	depends on ARCH_HAVE_AVX
	default n

config ARCH_X86_64_AVX512
	bool "AVX512 support"
	depends on ARCH_HAVE_AVX512
	default n

if ARCH_X86_64_AVX512

config ARCH_X86_64_AVX512PF
	bool "AVX512 Prefetch Instructions (AVX512PF)"
	default n

config ARCH_X86_64_AVX512ER
	bool "AVX512 Exponential and Reciprocal Instructions (AVX512ER)"
	default n

config ARCH_X86_64_AVX512CD
	bool "AVX512 Conflict Detection Instructions (AVX512CD)"
	default n

config ARCH_X86_64_AVX512VL
	bool "AVX512 Vector Length Extensions (AVX512VL)"
	default n

config ARCH_X86_64_AVX512BW
	bool "AVX512 Byte and Word Instructions (AVX512BW)"
	default n

config ARCH_X86_64_AVX512DQ
	bool "AVX512 Doubleword and Quadword Instructions (AVX512DQ)"
	default n

config ARCH_X86_64_AVX512IFMA
	bool "AVX512 Integer Fused Multiply-Add Instructions (AVX512IFMA)"
	default n

config ARCH_X86_64_AVX512VBMI
	bool "AVX512 Vector Bit Manipulation Instructions (AVX512VBMI)"
	default n

endif # ARCH_X86_64_AVX512

endif
```

## arch/x86_64/src/intel64/Kconfig
```kconfig
#
# For a description of the syntax of this configuration file,
# see the file kconfig-language.txt in the NuttX tools repository.
#

if ARCH_INTEL64
comment "intel64 Configuration Options"

choice
	prompt "Intel64 Chip Selection"
	default ARCH_CHIP_INTEL64_QEMU

config ARCH_CHIP_INTEL64_QEMU
	bool "Intel64 QEMU"

config ARCH_CHIP_INTEL64_CUSTOM
	bool "Custom Intel64 chip"

endchoice # "Intel64 Chip Selection"

config ARCH_INTEL64_HAVE_TSC
	bool

config ARCH_INTEL64_CACHE_LINESIZE
	int "Cache line size (hardcoded)"
	depends on ARCH_DCACHE || ARCH_ICACHE
	default 64
	---help---
		Cache line size. If set to 0, we read the value from CPUID,
		(Probably) all new Intel CPUs have this value equal to 64.

config ARCH_INTEL64_DCACHE_SIZE
	int "Data cache line size (L1d)"
	depends on ARCH_DCACHE
	default 0
	---help---
		Data cache line size (L1d). If set to 0, we read the value from CPUID.

config ARCH_INTEL64_ICACHE_SIZE
	int "Instruction cache line size (L1i)"
	depends on ARCH_ICACHE
	default 0
	---help---
		Instruction cache line size (L1i). If set to 0, we read the value from CPUID.

config ARCH_INTEL64_HAVE_CLWB
	bool "CLWB support"
	default n
	---help---
		Select to enable the use of CLWB to write back cache line

choice
	prompt "System Timer Source"
	default ARCH_INTEL64_TSC_DEADLINE
	---help---
		Choose which hardware resource will drive NuttX
		system time

config ARCH_INTEL64_TSC_DEADLINE
	bool "TSC DEADLINE timer support"
	select ARCH_INTEL64_HAVE_TSC
	---help---
		Select to enable the use of TSC DEADLINE timer of x86_64

config ARCH_INTEL64_TSC
	bool "TSC APIC timer support"
	select ARCH_INTEL64_HAVE_TSC
	---help---
		Select to enable the use of TSC APIC timer of x86_64

config ARCH_INTEL64_HPET_ALARM
	bool "HPET timer alarm support"
	depends on ALARM_ARCH
	---help---
		With this option you can enable ALARM_ARCH features that works on top of
		the HPET timer instance. This is an alternative method to TSC timer to
		provide the system clock.

endchoice # System Timer Source

if ARCH_INTEL64_TSC_DEADLINE

config ARCH_INTEL64_CORE_FREQ_KHZ
	int "CPU Core frequency in kHz"
	default 2000000
	---help---
		The CPU Core frequency (without Turbo boost). This is used
		to set the TSC deadline timer frequency. If set to 0 we try to get
		frequency from CPUID.

endif

if ARCH_INTEL64_TSC

config ARCH_INTEL64_APIC_FREQ_KHZ
	int "APIC timer frequency in kHz"
	default 2000000
	---help---
		The APIC timer frequency. This is used to set the APIC timer
		frequency in case of no TSC DEADLINE timer is available.

endif

config INTEL64_HPET
	bool "HPET timer support"
	default n
	---help---
		Select to enable the HPET timer support

if INTEL64_HPET

config INTEL64_HPET_BASE
	hex "HPET timer base address"
	default 0xfed00000
	---help---
		Configure base address for HPET. In the future, we can get this address from
		the ACPI table if ACPI support is enabled.

config INTEL64_HPET_32BIT
	bool "HPET is 32bit"
	default n
	---help---
		Configure HPET in 32-bit mode.

config INTEL64_HPET_FSB
	bool "HPET use FSB for interrupt"
	default n
	---help---
		Use FSB for interrupt (works like MSI interrupts).

config ARCH_INTEL64_HPET_ALARM_CHAN
	int "HPET timer alarm channel"
	depends on ARCH_INTEL64_HPET_ALARM
	default 0

config INTEL64_HPET_CHANNELS
	int "HPET timer supported channels"
	default 2
	range 1 3
	---help---
		Configure the number of supported HPET channles (called HPET timers
		in HPET spec). We use HPET legacy replacement for interrupts which
		means that Timer 0 and Timer 1 interrupts are hardcoded, but Timer 2
		needs additional attention to configure interrupt routing.
		Timer 2 will most likely not work with QEMU.

config INTEL64_HPET_MIN_DELAY
	int "HPET minimum supported delay in micro-seconds"
	default 1000
	---help---
		HPET use free runnin up-counter and a comparators which generate events
		only on a equal event. This can results in event miss if we set too small
		delay. In that case we must set a minimum value for delay that always work.
		For the QEMU target this value should be as high as 1000, but for real
		hardware it may go much lower (for i7-1255U CPU it works with values <10).

endif # INTEL64_HPET

config INTEL64_ONESHOT
	bool "Oneshot timer support"
	select INTEL64_HPET
	default n
	---help---
		Select to enable the oneshot timer support

if INTEL64_ONESHOT

config INTEL64_ONESHOT_MAXTIMERS
	int "Maximum number of oneshot timers"
	default 1
	range 1 3
	---help---
		Determines the maximum number of oneshot timers that can be
		supported.

endif

config ARCH_INTEL64_HAVE_PCID
	bool "PCID support"
	default y
	---help---
		Select to enable the use of PCID to reduce TLB flush

config ARCH_INTEL64_HAVE_RDRAND
	bool "RDRAND support"
	default y
	---help---
		Select to enable the use of RDRAND for /dev/random

config ARCH_INTEL64_DISABLE_INT_INIT
	bool "Disable Initialization of 8259/APIC/IO-APIC"
	default n
	---help---
		Select to disable all initialization related to interrupt
		controllers. This is necessary if those are already
		initialized, i.e. Jailhouse system.

config ARCH_INTEL64_DISABLE_CET
	bool "Disable CET completely"
	---help---
		Intel CET (Control-flow Enforcement Technology) is a hardware
		enhancement aimed at mitigating the Retpoline vulnerability.
		It inserts the endbr64 instruction at the beginning of functions,
		which may impact CPU branch prediction performance.

config ARCH_INTEL64_DISABLE_VECTORIZE
	bool "Disable vectorize completely"
	---help---
		Disable the compiler from vectorizing code optimization during compilation

endif
```
