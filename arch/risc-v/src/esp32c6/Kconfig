## arch/risc-v/src/hpm6000/Kconfig
```kconfig
#
# For a description of the syntax of this configuration file,
# see the file kconfig-language.txt in the NuttX tools repository.
#

comment "HPM6000 Configuration Options"

choice
	prompt "HPM6000 Chip Selection"
	default ARCH_CHIP_HPM6360IPA
	depends on ARCH_CHIP_HPM6000

config ARCH_CHIP_HPM6360IPA
	bool "HPM6360IPA"
	select ARCH_FAMILY_HPM6360

endchoice # HPM6000 Chip Selection

# HPM6000 Families

config ARCH_FAMILY_HPM6360
	bool
	default n
	select ARCH_FAMILY_HPM6300

# Peripheral support

menu "HPM6000 Peripheral Selection"

config HPM_ENET
	bool "Ethernet"
	default n

menu "Watchdog"

config HPM_WDOG0
	bool "WathDog"
	default n

config HPM_WDOG1
	bool "WathDog"
	default n

config HPM_WDOG2
	bool "WathDog"
	default n

endmenu # Watchdog

menu "UART Peripherals"

config HPM_UART0
	bool "UART0"
	default n
	select UART0_SERIALDRIVER
	select ARCH_HAVE_SERIAL_TERMIOS
	select HPM_HAVE_UART

config HPM_UART1
	bool "UART1"
	default n
	select UART1_SERIALDRIVER
	select ARCH_HAVE_SERIAL_TERMIOS
	select HPM_HAVE_UART

config HPM_UART2
	bool "UART2"
	default n
	select UART2_SERIALDRIVER
	select ARCH_HAVE_SERIAL_TERMIOS
	select HPM_HAVE_UART

config HPM_UART3
	bool "UART3"
	default n
	select UART3_SERIALDRIVER
	select ARCH_HAVE_SERIAL_TERMIOS
	select HPM_HAVE_UART

config HPM_UART4
	bool "UART4"
	default n
	select UART4_SERIALDRIVER
	select ARCH_HAVE_SERIAL_TERMIOS
	select HPM_HAVE_UART

config HPM_UART5
	bool "UART5"
	default n
	select UART5_SERIALDRIVER
	select ARCH_HAVE_SERIAL_TERMIOS
	select HPM_HAVE_UART

config HPM_UART6
	bool "UART6"
	default n
	select UART6_SERIALDRIVER
	select ARCH_HAVE_SERIAL_TERMIOS
	select HPM_HAVE_UART

config HPM_UART7
	bool "UART7"
	default n
	select UART7_SERIALDRIVER
	select ARCH_HAVE_SERIAL_TERMIOS
	select HPM_HAVE_UART

config HPM_PUART
	bool "PUART"
	default n
	select PUART_SERIALDRIVER
	select ARCH_HAVE_SERIAL_TERMIOS
	select HPM_HAVE_UART

endmenu # UART Peripherals
endmenu # HPM6000 Peripheral Selection
```

## arch/risc-v/src/hpm6750/Kconfig
```kconfig
#
# For a description of the syntax of this configuration file,
# see the file kconfig-language.txt in the NuttX tools repository.
#

comment "HPM6750 Configuration Options"

menu "HPM6750 Peripheral Support"

# These "hidden" settings determine whether a peripheral option is available
# for the selected MCU

config HPM6750_HAVE_UART0
	bool
	default y
	select UART0_SERIALDRIVER
	select ARCH_HAVE_SERIAL_TERMIOS

# These are the peripheral selections proper

config HPM6750_UART0
	bool "UART0"
	default y
	select ARCH_HAVE_UART0
	select ARCH_HAVE_SERIAL_TERMIOS
	select HPM6750_UART

endmenu
```

## arch/risc-v/src/hpmicro/Kconfig
```kconfig
#
# For a description of the syntax of this configuration file,
# see the file kconfig-language.txt in the NuttX tools repository.
#

comment "HPMicro Configuration Options"

choice
	prompt "HPMicro Chip Selection"
	default ARCH_CHIP_HPM6750

config ARCH_CHIP_HPM6750
	bool "HPM6750"
	select ARCH_RV32
	select ARCH_RV_ISA_M
	select ARCH_RV_ISA_A
	select ARCH_RV_ISA_C
	select ONESHOT
	select ALARM_ARCH

config ARCH_CHIP_HPM6360
	bool "HPM6360"
	select ARCH_RV32
	select ARCH_RV_ISA_M
	select ARCH_RV_ISA_A
	select ARCH_RV_ISA_C
	select ONESHOT
	select ALARM_ARCH

endchoice # ESP32-C3 Chip Selection

if ARCH_CHIP_HPM6750
source "arch/risc-v/src/hpmicro/hpm6750/Kconfig"
endif
```

## arch/risc-v/src/hpmicro/hpm6750/Kconfig
```kconfig
#
# For a description of the syntax of this configuration file,
# see the file kconfig-language.txt in the NuttX tools repository.
#

menu "HPM6750 Peripheral Support"

config HPM_FEMC
	bool "FEMC"
	select HPM_FEMC_DRV
	default n

config HPM_SDP
	bool "SDP"
	select HPM_SDP_DRV
	default n

config HPM_LCDC
	bool "LCDC"
	select HPM_LCDC_DRV
	default n

config HPM_I2C0
	bool "I2C0"
	select HPM_I2C_DRV
	default n

config HPM_I2C1
	bool "I2C1"
	select HPM_I2C_DRV
	default n

config HPM_UART0
	bool "UART0"
	select HPM_UART_DRV
	select ARCH_HAVE_UART0
	select UART0_SERIALDRIVER
	select ARCH_HAVE_SERIAL_TERMIOS
	default y

endmenu
```

## arch/risc-v/src/jh7100/Kconfig
```kconfig
#
# For a description of the syntax of this configuration file,
# see the file kconfig-language.txt in the NuttX tools repository.
#

comment "jh7100 Configuration Options"

config jh7100_ENABLE_DPFPU
	bool "jh7100 DP_FPU Support"
	default n
	select ARCH_HAVE_FPU
	select ARCH_HAVE_DPFPU
	---help---
		Enable the RISC-V Double-Precision Floating Point Unit (DP-FPU).

menu "jh7100 Peripheral Support"

# These "hidden" settings determine whether a peripheral option is available
# for the selected MCU

config jh7100_HAVE_UART0
	bool
	default y
	select UART0_SERIALDRIVER
	select ARCH_HAVE_SERIAL_TERMIOS

# These are the peripheral selections proper

config JH7100_UART0
	bool "UART0"
	default y
	select ARCH_HAVE_UART0
	select ARCH_HAVE_SERIAL_TERMIOS
	select JH7100_UART

endmenu

menu "jh7100 Others"

config JH7100_WITH_QEMU
	bool "qemu support"
	default n

endmenu
```

## arch/risc-v/src/k210/Kconfig
```kconfig
#
# For a description of the syntax of this configuration file,
# see the file kconfig-language.txt in the NuttX tools repository.
#

comment "K210 Configuration Options"

menu "K210 Peripheral Support"

# These "hidden" settings determine whether a peripheral option is available
# for the selected MCU

config K210_HAVE_UART0
	bool
	default y
	select UART0_SERIALDRIVER
	select ARCH_HAVE_SERIAL_TERMIOS

# These are the peripheral selections proper

config K210_UART0
	bool "UART0"
	default y
	select ARCH_HAVE_UART0
	select ARCH_HAVE_SERIAL_TERMIOS
	select K210_UART

config K210_WDT
	bool
	select WATCHDOG

config K210_WDT0
	bool "WDT0"
	default n
	select K210_WDT

config K210_WDT1
	bool "WDT1"
	default n
	select K210_WDT

endmenu

config K210_CPU_FREQ
	int "K210 CPU target frequency (Hz)"
	default 400000000
	range 40000000 600000000
	depends on ARCH_CHIP_K210
	---help---
		Set the K210 CPU target frequency in Hz.
		Default is 400000000 (400 MHz).
		Valid range: 40000000-600000000 Hz (40-600 MHz).

menu "K210 Others"

config K210_WITH_QEMU
	bool "qemu support"
	default n

endmenu
```

## arch/risc-v/src/k230/Kconfig
```kconfig
#
# For a description of the syntax of this configuration file,
# see the file kconfig-language.txt in the NuttX tools repository.
#

if RPTUN

config K230_RPTUN_MASTER
	bool "RPTUN master node"
	default y if RPTUN_LOADER
	default n

config K230_RPTUN_SHM_ADDR
	hex "RPTUN share memory address"
	default 0x80200000
	---help---
		 RPTUN shared memory start address.

config K230_RPTUN_SHM_SIZE
	int "RPTUN share memory size"
	default 32768
	---help---
		 RPTUN shared memory size in bytes.

config K230_RPTUN_IPI_DEV
	int "IPI device num for RPTUN purpose"
	default 0
	---help---
		Choose the IPI device for RPTUN purpose, should be within 0..3

endif # RPTUN

config K230_IPI
	bool "Enable K230 IPI driver"
	default y if RPTUN
	default n

if K230_IPI

config K230_IPI_RESET_UPON_INIT
	bool "Reset K230 mailbox device upon initialization"
	default n
	---help---
		Reset whole K230 mailbox device upon k230_ipi_init.

endif # K230_IPI
```

## arch/risc-v/src/litex/Kconfig
```kconfig
#
# For a description of the syntax of this configuration file,
# see the file kconfig-language.txt in the NuttX tools repository.
#

comment "LITEX Configuration Options"

config LITEX_SYS_CORE_FREQ_HZ
	int "Risc-V system core frequency (Hz)"
	default 100000000
	---help---
		This value should match default frequency of the FPGA fabric system clock.

menu "LITEX Peripheral Support"

# These "hidden" settings determine whether a peripheral option is available
# for the selected MCU

config LITEX_USE_CUSTOM_MEMORY_MAP
	bool "Custom peripheral memory mapping"
	default n
	---help---
		Use a custom memory map for the peripheral base addresses defined in
		arch/risc-v/src/litex/hardware/litex_memorymap.h.

if LITEX_USE_CUSTOM_MEMORY_MAP

config LITEX_CUSTOM_MEMORY_MAP_PATH
	string "Path to custom memory map include file."
	default ""
	---help---
		Specify the path to the file containing the peripheral memory mapping.
		The path specified must be relative to arch/risc-v/src/litex/hardware/litex_memorymap.h.
		The file must redefine any symbols which are intended to be overridden.

endif

config LITEX_USE_CUSTOM_IRQ_DEFINITIONS
	bool "Custom IRQ mapping"
	default n
	---help---
		Use custom definitions for risc-v IRQ numbers and sequence.
		Allowing for the definitions in arch/risc-v/include/litex/irq.h to be overridden.

if LITEX_USE_CUSTOM_IRQ_DEFINITIONS

config LITEX_CUSTOM_IRQ_DEFINITIONS_PATH
	string "Path to custom IRQ mapping include file."
	default ""
	---help---
		Specify the path to the file containing the custom IRQ definitions.
		The path specified must be relative to arch/risc-v/include/litex/irq.
		The file must redefine any symbols which are intended to be overridden.

endif

config LITEX_GPIO
	bool "GPIO"
	default n
	---help---
		Select if gateware configuration has a GPIO interface available.


if LITEX_GPIO

config LITEX_GPIO_IRQ
	bool "Enable GPIO IRQ"
	default n
	---help---
		Select if gateware configuration has support for GPIO IRQ events.

endif

config LITEX_HAVE_UART0
	bool
	default y
	select UART0_SERIALDRIVER
	select ARCH_HAVE_SERIAL_TERMIOS

# These are the peripheral selections proper

config LITEX_UART0
	bool "UART0"
	default y
	select ARCH_HAVE_UART0
	select ARCH_HAVE_SERIAL_TERMIOS
	select LITEX_UART

config LITEX_SDIO
	bool "SDIO"
	default n
	select SCHED_HPWORK
	select MMCSD
	select MMCSD_SDIO
	select SDIO_BLOCKSETUP
	select ARCH_HAVE_SDIO
	select SDIO_DMA

config LITEX_SDIO1
	bool "Enable SDIO1"
	default y if LITEX_SDIO
	select LITEX_SDIO_DMA
	depends on LITEX_SDIO

config LITEX_PWM
	bool "Enable PWM controller"
	default n

if LITEX_SDIO1

config LITEX_IDMODE_FREQ
	int "ID mode frequency"
	default 400000
	---help---
		Initial, ID mode SD frequency

config LITEX_MMCXFR_FREQ
	int "MMC transfer frequency"
	default 25000000
	---help---
		Frequency to use for transferring data to/from an MMC card

config LITEX_SD4BIT_FREQ
	int "SD 4-bit transfer frequency"
	default 50000000
	---help---
		Frequency to use for transferring data to/from an SD card using all four data lines.

endif

config LITEX_ETHMAC
	bool "ETHMAC"
	default n
	select ARCH_HAVE_PHY
	select ARCH_HAVE_NETDEV_STATISTICS
	select NET
	select NETDEVICES

endmenu

menu "LITEX EMAC device driver options"
	depends on LITEX_ETHMAC

config LITEX_EMAC_PHYADDR
	int "PHY address"
	default 1
	---help---
		The 5-bit address of the PHY on the board.  Default: 1

endmenu # PHY interface

menu "LITEX MMU options"
	depends on ARCH_USE_MMU

config LITEX_MMU_IO_BASE
	hex "IO base address."
	default 0x80000000
	---help---
		The base address for the IO MMU mapping.

config LITEX_MMU_IO_SIZE
	hex "IO base address."
	default 0x7F000000
	---help---
		The size for the IO MMU mapping.

config LITEX_MMU_L1_SIZE
	int "L1 page table size."
	default 1024
	---help---
		The size of the L1 page table. Each entry in the page table represents a 4MB L1 page.

config LITEX_MMU_L2_SIZE
	int "L2 page table size."
	default 4096
	---help---
		The size of the L2 page table. Each entry in the page table represents a 4kB L1 page.

endmenu # LITEX MMU options
```

## arch/risc-v/src/mindgrove/Kconfig
```kconfig
#
# For a description of the syntax of this configuration file,
# see the file kconfig-language.txt in the NuttX tools repository.
#

# comment "Mindgrove Configuration Options"

# menu "Mindgrove Peripheral Support"

# # These "hidden" settings determine whether a peripheral option is available
# # for the selected MCU

config MINDGROVE_HAVE_UART0
	bool
	default y
	select UART0_SERIALDRIVER
	select ARCH_HAVE_SERIAL_TERMIOS

config MINDGROVE_UART0
	bool "UART0"
	default y
	select ARCH_HAVE_UART0
	select ARCH_HAVE_SERIAL_TERMIOS
	select MINDGROVE_UART

config MINDGROVE_HAVE_UART1
    bool
    default y
    select UART1_SERIALDRIVER
    select ARCH_HAVE_SERIAL_TERMIOS

config MINDGROVE_UART1
    bool "UART1"
    default y
    select ARCH_HAVE_UART1
    select ARCH_HAVE_SERIAL_TERMIOS
    select MINDGROVE_UART

config MINDGROVE_HAVE_UART2
    bool
    default y
    select UART2_SERIALDRIVER
    select ARCH_HAVE_SERIAL_TERMIOS

config MINDGROVE_UART2
    bool "UART2"
    default y
    select ARCH_HAVE_UART2
    select ARCH_HAVE_SERIAL_TERMIOS
    select MINDGROVE_UART
    
config MINDGROVE_SPI
    bool
    default n
    select SPI
    select SPI_CS_CONTROL
    select SPI_EXCHANGE
    select SPI_HWFEATURES     # This "unlocks" the feature you need
    select SPI_CHARACTER    # Ensures the /dev/spiX driver is built

config MINDGROVE_HAVE_SPI0
    bool
    default y
    select ARCH_HAVE_SPI

config MINDGROVE_SPI0
    bool "SPI0"
    default y
    select MINDGROVE_SPI
    select SPI_DRIVER

config MINDGROVE_HAVE_SPI1
    bool
    default y
    select ARCH_HAVE_SPI

config MINDGROVE_SPI1
    bool "SPI1"
    default y
    select MINDGROVE_SPI
    select SPI_DRIVER

config MINDGROVE_HAVE_SPI2
    bool
    default y
    select ARCH_HAVE_SPI

config MINDGROVE_SPI2
    bool "SPI2"
    default y
    select MINDGROVE_SPI
    select SPI_DRIVER

config MINDGROVE_HAVE_SPI3
    bool
    default y
    select ARCH_HAVE_SPI

config MINDGROVE_SPI3
    bool "SPI3"
    default y
    select MINDGROVE_SPI
    select SPI_DRIVER

# endmenu
```
