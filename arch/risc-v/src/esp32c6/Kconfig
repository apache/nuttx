## arch/risc-v/src/nuttsbi/Kconfig
```kconfig
# S-mode requires a Supervisor Binary Interface (SBI) in order to access
# M-mode ISA. A minimalistic SBI is provided here natively.

config NUTTSBI
	bool "Use NuttX native SBI"
	default n
	depends on ARCH_RISCV && ARCH_USE_S_MODE
	---help---
		Use NuttX minimalistic SBI

if NUTTSBI

config NUTTSBI_HART_CNT
	int "Amount of harts in SoC"
	default 1

config NUTTSBI_MTIME_BASE
	hex "MTIME base address"
	default 0
	---help---
		Sets the address of mtime memory mapped register

config NUTTSBI_MTIMECMP_BASE
	hex "MTIMECMP base address"
	default 0
	---help---
		Sets the address of mtimecmp memory mapped register

endif
```

## arch/risc-v/src/opensbi/Kconfig
```kconfig
#
# For a description of the syntax of this configuration file,
# see the file kconfig-language.txt in the NuttX tools repository.
#

config OPENSBI
	bool "OpenSBI support"
	depends on ARCH_RISCV && ALLOW_BSD_COMPONENTS
	default n
	---help---
		Enable or disable Open Source Supervisor Binary Interface (OpenSBI) features
		for RISC-V.

config OPENSBI_DOMAINS
	bool "Support multiple OpenSBI boot domains"
	depends on OPENSBI
	default n
```

## arch/risc-v/src/qemu-rv/Kconfig
```kconfig
#
# For a description of the syntax of this configuration file,
# see the file kconfig-language.txt in the NuttX tools repository.
#

if ARCH_CHIP_QEMU_RV
comment "QEMU RISC-V Options"

choice
	prompt "QEMU Chip Selection"
	default ARCH_CHIP_QEMU_RV32

config ARCH_CHIP_QEMU_RV32
	bool "QEMU RV32"
	select ARCH_RV32

config ARCH_CHIP_QEMU_RV64
	bool "QEMU RV64"
	select ARCH_RV64

endchoice

config ARCH_CHIP_QEMU_RV_ISA_M
	bool "Standard Extension for Integer Multiplication and Division"
	default n
	select ARCH_RV_ISA_M

config ARCH_CHIP_QEMU_RV_ISA_A
	bool "Standard Extension for Atomic Instructions"
	default n
	select ARCH_RV_ISA_A

config ARCH_CHIP_QEMU_RV_ISA_C
	bool "Standard Extension for Compressed Instructions"
	default n
	select ARCH_RV_ISA_C

config ARCH_CHIP_QEMU_RV_ISA_V
	bool "Standard Extension for Vector Instructions"
	default n
	select ARCH_RV_ISA_V

config ARCH_CHIP_QEMU_RV_CLUSTER
	bool "Enable cluster support"
	default y if RPTUN
	default n

if ARCH_CHIP_QEMU_RV_CLUSTER

config ARCH_CHIP_QEMU_RV_PLIC
	hex "Base address of PLIC device"
	default 0xc000000

config ARCH_CHIP_QEMU_RV_CLINT
	hex "Base address of CLINT device"
	default 0x2000000

config ARCH_CHIP_QEMU_RV_ACLINT
	hex "Base address of ACLINT device"
	default 0x2f00000

endif # ARCH_CHIP_QEMU_RV_CLUSTER

if RPTUN

config QEMU_RPTUN_MASTER
	bool "RPTUN master node"
	default n

config QEMU_RPTUN_SHM_BASE
	hex "RPTUN share memory base"
	default 0x80ff8000
	---help---
		For master node, this is base of all RPTUN shared
		memory blocks, one for each remote node. To avoid
		overlapping of RPTUN memory with NuttX memory,
		memory configs of NuttX for master node shall be
		carefully checked.
		For remote node, this is base of its block.
		RPTUN memory preparation is done by master node.

config QEMU_RPTUN_SHM_SIZE
	int "RPTUN share memory block size"
	default 32768
	---help---
		The size of RPTUN shared memory block between two
		peers. There are multiple blocks at the master node.

config QEMU_RPTUN_MASTER_IPI
	hex "RPTUN master's IPI address"
	default 0x2000000
	depends on !QEMU_RPTUN_MASTER
	---help---
		The IPI address of master node, used by remote RPTUN
		nodes to notify master.

config QEMU_RPTUN_REMOTE_NUM
	int "Number of remote nodes"
	depends on QEMU_RPTUN_MASTER
	default 1

config QEMU_RPTUN_REMOTE_IPIS
	string "RPTUN remote IPI addresses"
	depends on QEMU_RPTUN_MASTER
	default "0x2010000"
	---help---
		A comma separated list of IPI addresses for remote
		nodes, addresses shall be in hex with leading 0x and
		only the first RPTUM_REMOTE_NUM entries be used.

endif # RPTUN

endif # ARCH_CHIP_QEMU_RV
```

## arch/risc-v/src/qemu-rv32/Kconfig
```kconfig
#
# For a description of the syntax of this configuration file,
# see the file kconfig-language.txt in the NuttX tools repository.
#

if ARCH_CHIP_QEMU_RV32
comment "QEMU RV32 Options"

config ARCH_CHIP_QEMU_RV32_ISA_M
    bool "Standard Extension for Integer Multiplication and Division"
    default y
    select ARCH_RV_ISA_M

config ARCH_CHIP_QEMU_RV32_ISA_A
    bool "Standard Extension for Atomic Instructions"
    default y
    select ARCH_RV_ISA_A

config ARCH_CHIP_QEMU_RV32_ISA_C
    bool "Standard Extension for Compressed Instructions"
    default y
    select ARCH_RV_ISA_C

endif
```

## arch/risc-v/src/rv32im/Kconfig
```kconfig
#
# For a description of the syntax of this configuration file,
# see the file kconfig-language.txt in the NuttX tools repository.
#

comment "RV32IM Configuration Options"

config RV32IM_SYSTEM_CSRRS_SUPPORT
	bool "Supports RV core feature identification via CSRRS opcode"
	default n
	---help---
		Specifies if the architecture supports the SYSTEM opcode for reading
		Control Status Registers to obtain the RV core option flags.

config RV32IM_CUSTOM_IRQ_SUPPORT
	bool "Has custom implementation for IRQ handling"
	default n
	---help---
		Allows overriding the standard IRQ processing as described
		in the RISC-V architecture documents.  This allows architecture
		specific code to support non-standard IRQ processing in the core.
```

## arch/risc-v/src/rv32m1/Kconfig
```kconfig
#
# For a description of the syntax of this configuration file,
# see the file kconfig-language.txt in the NuttX tools repository.
#

comment "RV32M1 Configuration Options"

choice
	prompt "RV32M1 Chip Selection"
	default ARCH_CHIP_RV32M1_RI5CY
	depends on ARCH_CHIP_RV32M1

config ARCH_CHIP_RV32M1_RI5CY
	bool "RV32M1_RI5CY"
	select RV32M1_HAVE_ITCM
	select RV32M1_HAVE_TSTMR
	---help---
		RV32M1 RI5CY, RV32IMC 256KB SRAM, 1MB FLASH.

endchoice

menu "RV32M1 Peripheral Support"

# These "hidden" settings determine whether a peripheral option is available
# for the selected MCU

config RV32M1_HAVE_LPUART0
	bool
	default y

config RV32M1_HAVE_LPUART1
	bool
	default y

config RV32M1_HAVE_LPUART2
	bool
	default y

config RV32M1_HAVE_LPUART3
	bool
	default y

config RV32M1_HAVE_ITCM
	bool
	default n

config RV32M1_HAVE_TSTMR
	bool
	default y

config RV32M1_LPUART
	bool
	default n

config RV32M1_SERIALDRIVER
	bool
	default n

# These are the peripheral selections proper

config RV32M1_LPUART0
	bool "LPUART0"
	default n
	depends on RV32M1_HAVE_LPUART0
	select RV32M1_LPUART

config RV32M1_LPUART1
	bool "LPUART1"
	default n
	depends on RV32M1_HAVE_LPUART1
	select RV32M1_LPUART

config RV32M1_LPUART2
	bool "LPUART2"
	default n
	depends on RV32M1_HAVE_LPUART2
	select RV32M2_LPUART

config RV32M1_LPUART3
	bool "LPUART3"
	default n
	depends on RV32M1_HAVE_LPUART3
	select RV32M2_LPUART

config RV32M1_ITCM
	bool "ITCM"
	default n
	depends on RV32M1_HAVE_ITCM

config RV32M1_TSTMR
	bool "TSTMR"
	default n
	depends on RV32M1_HAVE_TSTMR

menu "LPUART Configuration"
	depends on RV32M1_LPUART

comment "LPUART Device Configuration"

choice
	prompt "LPUART0 Driver Configuration"
	default RV32M1_LPUART0_SERIALDRIVER
	depends on RV32M1_LPUART0

config RV32M1_LPUART0_SERIALDRIVER
	bool "Standard serial driver"
	select ARCH_HAVE_SERIAL_TERMIOS
	select RV32M1_SERIALDRIVER
	select LPUART0_SERIALDRIVER

endchoice # LPUART0 Driver Configuration

if RV32M1_LPUART0_SERIALDRIVER

endif # RV32M1_LPUART0_SERIALDRIVER

choice
	prompt "LPUART1 Driver Configuration"
	default RV32M1_LPUART1_SERIALDRIVER
	depends on RV32M1_LPUART1

config RV32M1_LPUART1_SERIALDRIVER
	bool "Standard serial driver"
	select ARCH_HAVE_SERIAL_TERMIOS
	select RV32M1_SERIALDRIVER
	select LPUART1_SERIALDRIVER

endchoice # LPUART1 Driver Configuration

if RV32M1_LPUART1_SERIALDRIVER

endif # RV32M1_LPUART1_SERIALDRIVER

choice
	prompt "LPUART2 Driver Configuration"
	default RV32M1_LPUART2_SERIALDRIVER
	depends on RV32M1_LPUART2

config RV32M1_LPUART2_SERIALDRIVER
	bool "Standard serial driver"
	select ARCH_HAVE_SERIAL_TERMIOS
	select RV32M1_SERIALDRIVER
	select LPUART2_SERIALDRIVER

endchoice # LPUART2 Driver Configuration

if RV32M1_LPUART2_SERIALDRIVER

endif # RV32M1_LPUART2_SERIALDRIVER

choice
	prompt "LPUART3 Driver Configuration"
	default RV32M1_LPUART3_SERIALDRIVER
	depends on RV32M1_LPUART3

config RV32M1_LPUART3_SERIALDRIVER
	bool "Standard serial driver"
	select ARCH_HAVE_SERIAL_TERMIOS
	select RV32M1_SERIALDRIVER
	select LPUART3_SERIALDRIVER

endchoice # LPUART3 Driver Configuration

if RV32M1_LPUART3_SERIALDRIVER

endif # RV32M1_LPUART3_SERIALDRIVER

endmenu # LPUART Configuration Menu

endmenu
```

## arch/risc-v/src/rv64gc/Kconfig
```kconfig
#
# For a description of the syntax of this configuration file,
# see the file kconfig-language.txt in the NuttX tools repository.
#

comment "RV64GC Configuration Options"

choice
	prompt "Toolchain Selection"
	default RV64GC_TOOLCHAIN_GNU_RVGW if TOOLCHAIN_WINDOWS
	default RV64GC_TOOLCHAIN_GNU_RVGL if !TOOLCHAIN_WINDOWS

config RV64GC_TOOLCHAIN_GNU_RVGL
	bool "Generic GNU RVG toolchain under Linux (or other POSIX environment)"
	select ARCH_TOOLCHAIN_GNU
	---help---
		This option should work for any modern GNU toolchain (GCC 5.2 or newer)
		configured for riscv64-unknown-elf.

config RV64GC_TOOLCHAIN_GNU_RVGW
	bool "Generic GNU RVG toolchain under Windows"
	depends on TOOLCHAIN_WINDOWS
	select CYGWIN_WINTOOL if WINDOWS_CYGWIN
	select ARCH_TOOLCHAIN_GNU
	---help---
		This option should work for any modern GNU toolchain (GCC 5.2 or newer)
		configured for riscv64-unknown-elf.

endchoice
```

## arch/sh/src/m16c/Kconfig
```kconfig
#
# For a description of the syntax of this configuration file,
# see the file kconfig-language.txt in the NuttX tools repository.
#

if ARCH_M16C

config M16C_UART0
	bool "UART0"
	select UART0_SERIALDRIVER
	default n

config M16C_UART1
	bool "UART1"
	select UART1_SERIALDRIVER
	default n

config M16C_UART2
	bool "UART2"
	select UART2_SERIALDRIVER
	default n

endif
```
